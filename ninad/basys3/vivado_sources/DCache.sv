// Generated by CIRCT firtool-1.75.0

// Users can define 'STOP_COND' to add an extra gate to stop conditions.
`ifndef STOP_COND_
  `ifdef STOP_COND
    `define STOP_COND_ (`STOP_COND)
  `else  // STOP_COND
    `define STOP_COND_ 1
  `endif // STOP_COND
`endif // not def STOP_COND_

// Users can define 'ASSERT_VERBOSE_COND' to add an extra gate to assert error printing.
`ifndef ASSERT_VERBOSE_COND_
  `ifdef ASSERT_VERBOSE_COND
    `define ASSERT_VERBOSE_COND_ (`ASSERT_VERBOSE_COND)
  `else  // ASSERT_VERBOSE_COND
    `define ASSERT_VERBOSE_COND_ 1
  `endif // ASSERT_VERBOSE_COND
`endif // not def ASSERT_VERBOSE_COND_

// Include register initializers in init blocks unless synthesis is set
`ifndef RANDOMIZE
  `ifdef RANDOMIZE_REG_INIT
    `define RANDOMIZE
  `endif // RANDOMIZE_REG_INIT
`endif // not def RANDOMIZE
`ifndef SYNTHESIS
  `ifndef ENABLE_INITIAL_REG_
    `define ENABLE_INITIAL_REG_
  `endif // not def ENABLE_INITIAL_REG_
`endif // not def SYNTHESIS

// Standard header to adapt well known macros for register randomization.

// RANDOM may be set to an expression that produces a 32-bit random unsigned value.
`ifndef RANDOM
  `define RANDOM $random
`endif // not def RANDOM

// Users can define INIT_RANDOM as general code that gets injected into the
// initializer block for modules with registers.
`ifndef INIT_RANDOM
  `define INIT_RANDOM
`endif // not def INIT_RANDOM

// If using random initialization, you can also define RANDOMIZE_DELAY to
// customize the delay used, otherwise 0.002 is used.
`ifndef RANDOMIZE_DELAY
  `define RANDOMIZE_DELAY 0.002
`endif // not def RANDOMIZE_DELAY

// Define INIT_RANDOM_PROLOG_ for use in our modules below.
`ifndef INIT_RANDOM_PROLOG_
  `ifdef RANDOMIZE
    `ifdef VERILATOR
      `define INIT_RANDOM_PROLOG_ `INIT_RANDOM
    `else  // VERILATOR
      `define INIT_RANDOM_PROLOG_ `INIT_RANDOM #`RANDOMIZE_DELAY begin end
    `endif // VERILATOR
  `else  // RANDOMIZE
    `define INIT_RANDOM_PROLOG_
  `endif // RANDOMIZE
`endif // not def INIT_RANDOM_PROLOG_
module DCache(	// @[generators/rocket-chip/src/main/scala/rocket/DCache.scala:99:7]
  input         clock,	// @[generators/rocket-chip/src/main/scala/rocket/DCache.scala:99:7]
  input         reset,	// @[generators/rocket-chip/src/main/scala/rocket/DCache.scala:99:7]
  input         auto_out_a_ready,	// @[generators/diplomacy/diplomacy/src/diplomacy/lazymodule/LazyModuleImp.scala:107:25]
  output        auto_out_a_valid,	// @[generators/diplomacy/diplomacy/src/diplomacy/lazymodule/LazyModuleImp.scala:107:25]
  output [2:0]  auto_out_a_bits_opcode,	// @[generators/diplomacy/diplomacy/src/diplomacy/lazymodule/LazyModuleImp.scala:107:25]
  output [2:0]  auto_out_a_bits_param,	// @[generators/diplomacy/diplomacy/src/diplomacy/lazymodule/LazyModuleImp.scala:107:25]
  output [3:0]  auto_out_a_bits_size,	// @[generators/diplomacy/diplomacy/src/diplomacy/lazymodule/LazyModuleImp.scala:107:25]
  output [31:0] auto_out_a_bits_address,	// @[generators/diplomacy/diplomacy/src/diplomacy/lazymodule/LazyModuleImp.scala:107:25]
  output [7:0]  auto_out_a_bits_mask,	// @[generators/diplomacy/diplomacy/src/diplomacy/lazymodule/LazyModuleImp.scala:107:25]
  output [63:0] auto_out_a_bits_data,	// @[generators/diplomacy/diplomacy/src/diplomacy/lazymodule/LazyModuleImp.scala:107:25]
  output        auto_out_d_ready,	// @[generators/diplomacy/diplomacy/src/diplomacy/lazymodule/LazyModuleImp.scala:107:25]
  input         auto_out_d_valid,	// @[generators/diplomacy/diplomacy/src/diplomacy/lazymodule/LazyModuleImp.scala:107:25]
  input  [2:0]  auto_out_d_bits_opcode,	// @[generators/diplomacy/diplomacy/src/diplomacy/lazymodule/LazyModuleImp.scala:107:25]
  input  [3:0]  auto_out_d_bits_size,	// @[generators/diplomacy/diplomacy/src/diplomacy/lazymodule/LazyModuleImp.scala:107:25]
  input         auto_out_d_bits_denied,	// @[generators/diplomacy/diplomacy/src/diplomacy/lazymodule/LazyModuleImp.scala:107:25]
  input  [63:0] auto_out_d_bits_data,	// @[generators/diplomacy/diplomacy/src/diplomacy/lazymodule/LazyModuleImp.scala:107:25]
  output        io_cpu_req_ready,	// @[generators/rocket-chip/src/main/scala/rocket/HellaCache.scala:243:14]
  input         io_cpu_req_valid,	// @[generators/rocket-chip/src/main/scala/rocket/HellaCache.scala:243:14]
  input  [31:0] io_cpu_req_bits_addr,	// @[generators/rocket-chip/src/main/scala/rocket/HellaCache.scala:243:14]
  input  [6:0]  io_cpu_req_bits_tag,	// @[generators/rocket-chip/src/main/scala/rocket/HellaCache.scala:243:14]
  input  [4:0]  io_cpu_req_bits_cmd,	// @[generators/rocket-chip/src/main/scala/rocket/HellaCache.scala:243:14]
  input  [1:0]  io_cpu_req_bits_size,	// @[generators/rocket-chip/src/main/scala/rocket/HellaCache.scala:243:14]
  input         io_cpu_req_bits_signed,	// @[generators/rocket-chip/src/main/scala/rocket/HellaCache.scala:243:14]
  input  [1:0]  io_cpu_req_bits_dprv,	// @[generators/rocket-chip/src/main/scala/rocket/HellaCache.scala:243:14]
  input         io_cpu_req_bits_dv,	// @[generators/rocket-chip/src/main/scala/rocket/HellaCache.scala:243:14]
  input         io_cpu_req_bits_no_xcpt,	// @[generators/rocket-chip/src/main/scala/rocket/HellaCache.scala:243:14]
  input         io_cpu_s1_kill,	// @[generators/rocket-chip/src/main/scala/rocket/HellaCache.scala:243:14]
  input  [31:0] io_cpu_s1_data_data,	// @[generators/rocket-chip/src/main/scala/rocket/HellaCache.scala:243:14]
  input  [3:0]  io_cpu_s1_data_mask,	// @[generators/rocket-chip/src/main/scala/rocket/HellaCache.scala:243:14]
  output        io_cpu_s2_nack,	// @[generators/rocket-chip/src/main/scala/rocket/HellaCache.scala:243:14]
  output        io_cpu_resp_valid,	// @[generators/rocket-chip/src/main/scala/rocket/HellaCache.scala:243:14]
  output [31:0] io_cpu_resp_bits_addr,	// @[generators/rocket-chip/src/main/scala/rocket/HellaCache.scala:243:14]
  output [6:0]  io_cpu_resp_bits_tag,	// @[generators/rocket-chip/src/main/scala/rocket/HellaCache.scala:243:14]
  output [4:0]  io_cpu_resp_bits_cmd,	// @[generators/rocket-chip/src/main/scala/rocket/HellaCache.scala:243:14]
  output [1:0]  io_cpu_resp_bits_size,	// @[generators/rocket-chip/src/main/scala/rocket/HellaCache.scala:243:14]
  output        io_cpu_resp_bits_signed,	// @[generators/rocket-chip/src/main/scala/rocket/HellaCache.scala:243:14]
  output [1:0]  io_cpu_resp_bits_dprv,	// @[generators/rocket-chip/src/main/scala/rocket/HellaCache.scala:243:14]
  output        io_cpu_resp_bits_dv,	// @[generators/rocket-chip/src/main/scala/rocket/HellaCache.scala:243:14]
  output [31:0] io_cpu_resp_bits_data,	// @[generators/rocket-chip/src/main/scala/rocket/HellaCache.scala:243:14]
  output [3:0]  io_cpu_resp_bits_mask,	// @[generators/rocket-chip/src/main/scala/rocket/HellaCache.scala:243:14]
  output        io_cpu_resp_bits_replay,	// @[generators/rocket-chip/src/main/scala/rocket/HellaCache.scala:243:14]
  output        io_cpu_resp_bits_has_data,	// @[generators/rocket-chip/src/main/scala/rocket/HellaCache.scala:243:14]
  output [31:0] io_cpu_resp_bits_data_word_bypass,	// @[generators/rocket-chip/src/main/scala/rocket/HellaCache.scala:243:14]
  output [31:0] io_cpu_resp_bits_data_raw,	// @[generators/rocket-chip/src/main/scala/rocket/HellaCache.scala:243:14]
  output [31:0] io_cpu_resp_bits_store_data,	// @[generators/rocket-chip/src/main/scala/rocket/HellaCache.scala:243:14]
  output        io_cpu_replay_next,	// @[generators/rocket-chip/src/main/scala/rocket/HellaCache.scala:243:14]
  output        io_cpu_s2_xcpt_ma_ld,	// @[generators/rocket-chip/src/main/scala/rocket/HellaCache.scala:243:14]
  output        io_cpu_s2_xcpt_ma_st,	// @[generators/rocket-chip/src/main/scala/rocket/HellaCache.scala:243:14]
  output        io_cpu_s2_xcpt_pf_ld,	// @[generators/rocket-chip/src/main/scala/rocket/HellaCache.scala:243:14]
  output        io_cpu_s2_xcpt_pf_st,	// @[generators/rocket-chip/src/main/scala/rocket/HellaCache.scala:243:14]
  output        io_cpu_s2_xcpt_ae_ld,	// @[generators/rocket-chip/src/main/scala/rocket/HellaCache.scala:243:14]
  output        io_cpu_s2_xcpt_ae_st,	// @[generators/rocket-chip/src/main/scala/rocket/HellaCache.scala:243:14]
  output        io_cpu_ordered,	// @[generators/rocket-chip/src/main/scala/rocket/HellaCache.scala:243:14]
  output        io_cpu_perf_grant,	// @[generators/rocket-chip/src/main/scala/rocket/HellaCache.scala:243:14]
  output        io_ptw_req_bits_bits_need_gpa,	// @[generators/rocket-chip/src/main/scala/rocket/HellaCache.scala:243:14]
  output        io_ptw_req_bits_bits_stage2,	// @[generators/rocket-chip/src/main/scala/rocket/HellaCache.scala:243:14]
  input         io_ptw_status_debug,	// @[generators/rocket-chip/src/main/scala/rocket/HellaCache.scala:243:14]
  input         io_ptw_pmp_0_cfg_l,	// @[generators/rocket-chip/src/main/scala/rocket/HellaCache.scala:243:14]
  input  [1:0]  io_ptw_pmp_0_cfg_a,	// @[generators/rocket-chip/src/main/scala/rocket/HellaCache.scala:243:14]
  input         io_ptw_pmp_0_cfg_x,	// @[generators/rocket-chip/src/main/scala/rocket/HellaCache.scala:243:14]
  input         io_ptw_pmp_0_cfg_w,	// @[generators/rocket-chip/src/main/scala/rocket/HellaCache.scala:243:14]
  input         io_ptw_pmp_0_cfg_r,	// @[generators/rocket-chip/src/main/scala/rocket/HellaCache.scala:243:14]
  input  [29:0] io_ptw_pmp_0_addr,	// @[generators/rocket-chip/src/main/scala/rocket/HellaCache.scala:243:14]
  input  [31:0] io_ptw_pmp_0_mask,	// @[generators/rocket-chip/src/main/scala/rocket/HellaCache.scala:243:14]
  input         io_ptw_pmp_1_cfg_l,	// @[generators/rocket-chip/src/main/scala/rocket/HellaCache.scala:243:14]
  input  [1:0]  io_ptw_pmp_1_cfg_a,	// @[generators/rocket-chip/src/main/scala/rocket/HellaCache.scala:243:14]
  input         io_ptw_pmp_1_cfg_x,	// @[generators/rocket-chip/src/main/scala/rocket/HellaCache.scala:243:14]
  input         io_ptw_pmp_1_cfg_w,	// @[generators/rocket-chip/src/main/scala/rocket/HellaCache.scala:243:14]
  input         io_ptw_pmp_1_cfg_r,	// @[generators/rocket-chip/src/main/scala/rocket/HellaCache.scala:243:14]
  input  [29:0] io_ptw_pmp_1_addr,	// @[generators/rocket-chip/src/main/scala/rocket/HellaCache.scala:243:14]
  input  [31:0] io_ptw_pmp_1_mask,	// @[generators/rocket-chip/src/main/scala/rocket/HellaCache.scala:243:14]
  input         io_ptw_pmp_2_cfg_l,	// @[generators/rocket-chip/src/main/scala/rocket/HellaCache.scala:243:14]
  input  [1:0]  io_ptw_pmp_2_cfg_a,	// @[generators/rocket-chip/src/main/scala/rocket/HellaCache.scala:243:14]
  input         io_ptw_pmp_2_cfg_x,	// @[generators/rocket-chip/src/main/scala/rocket/HellaCache.scala:243:14]
  input         io_ptw_pmp_2_cfg_w,	// @[generators/rocket-chip/src/main/scala/rocket/HellaCache.scala:243:14]
  input         io_ptw_pmp_2_cfg_r,	// @[generators/rocket-chip/src/main/scala/rocket/HellaCache.scala:243:14]
  input  [29:0] io_ptw_pmp_2_addr,	// @[generators/rocket-chip/src/main/scala/rocket/HellaCache.scala:243:14]
  input  [31:0] io_ptw_pmp_2_mask,	// @[generators/rocket-chip/src/main/scala/rocket/HellaCache.scala:243:14]
  input         io_ptw_pmp_3_cfg_l,	// @[generators/rocket-chip/src/main/scala/rocket/HellaCache.scala:243:14]
  input  [1:0]  io_ptw_pmp_3_cfg_a,	// @[generators/rocket-chip/src/main/scala/rocket/HellaCache.scala:243:14]
  input         io_ptw_pmp_3_cfg_x,	// @[generators/rocket-chip/src/main/scala/rocket/HellaCache.scala:243:14]
  input         io_ptw_pmp_3_cfg_w,	// @[generators/rocket-chip/src/main/scala/rocket/HellaCache.scala:243:14]
  input         io_ptw_pmp_3_cfg_r,	// @[generators/rocket-chip/src/main/scala/rocket/HellaCache.scala:243:14]
  input  [29:0] io_ptw_pmp_3_addr,	// @[generators/rocket-chip/src/main/scala/rocket/HellaCache.scala:243:14]
  input  [31:0] io_ptw_pmp_3_mask,	// @[generators/rocket-chip/src/main/scala/rocket/HellaCache.scala:243:14]
  input         io_ptw_pmp_4_cfg_l,	// @[generators/rocket-chip/src/main/scala/rocket/HellaCache.scala:243:14]
  input  [1:0]  io_ptw_pmp_4_cfg_a,	// @[generators/rocket-chip/src/main/scala/rocket/HellaCache.scala:243:14]
  input         io_ptw_pmp_4_cfg_x,	// @[generators/rocket-chip/src/main/scala/rocket/HellaCache.scala:243:14]
  input         io_ptw_pmp_4_cfg_w,	// @[generators/rocket-chip/src/main/scala/rocket/HellaCache.scala:243:14]
  input         io_ptw_pmp_4_cfg_r,	// @[generators/rocket-chip/src/main/scala/rocket/HellaCache.scala:243:14]
  input  [29:0] io_ptw_pmp_4_addr,	// @[generators/rocket-chip/src/main/scala/rocket/HellaCache.scala:243:14]
  input  [31:0] io_ptw_pmp_4_mask,	// @[generators/rocket-chip/src/main/scala/rocket/HellaCache.scala:243:14]
  input         io_ptw_pmp_5_cfg_l,	// @[generators/rocket-chip/src/main/scala/rocket/HellaCache.scala:243:14]
  input  [1:0]  io_ptw_pmp_5_cfg_a,	// @[generators/rocket-chip/src/main/scala/rocket/HellaCache.scala:243:14]
  input         io_ptw_pmp_5_cfg_x,	// @[generators/rocket-chip/src/main/scala/rocket/HellaCache.scala:243:14]
  input         io_ptw_pmp_5_cfg_w,	// @[generators/rocket-chip/src/main/scala/rocket/HellaCache.scala:243:14]
  input         io_ptw_pmp_5_cfg_r,	// @[generators/rocket-chip/src/main/scala/rocket/HellaCache.scala:243:14]
  input  [29:0] io_ptw_pmp_5_addr,	// @[generators/rocket-chip/src/main/scala/rocket/HellaCache.scala:243:14]
  input  [31:0] io_ptw_pmp_5_mask,	// @[generators/rocket-chip/src/main/scala/rocket/HellaCache.scala:243:14]
  input         io_ptw_pmp_6_cfg_l,	// @[generators/rocket-chip/src/main/scala/rocket/HellaCache.scala:243:14]
  input  [1:0]  io_ptw_pmp_6_cfg_a,	// @[generators/rocket-chip/src/main/scala/rocket/HellaCache.scala:243:14]
  input         io_ptw_pmp_6_cfg_x,	// @[generators/rocket-chip/src/main/scala/rocket/HellaCache.scala:243:14]
  input         io_ptw_pmp_6_cfg_w,	// @[generators/rocket-chip/src/main/scala/rocket/HellaCache.scala:243:14]
  input         io_ptw_pmp_6_cfg_r,	// @[generators/rocket-chip/src/main/scala/rocket/HellaCache.scala:243:14]
  input  [29:0] io_ptw_pmp_6_addr,	// @[generators/rocket-chip/src/main/scala/rocket/HellaCache.scala:243:14]
  input  [31:0] io_ptw_pmp_6_mask,	// @[generators/rocket-chip/src/main/scala/rocket/HellaCache.scala:243:14]
  input         io_ptw_pmp_7_cfg_l,	// @[generators/rocket-chip/src/main/scala/rocket/HellaCache.scala:243:14]
  input  [1:0]  io_ptw_pmp_7_cfg_a,	// @[generators/rocket-chip/src/main/scala/rocket/HellaCache.scala:243:14]
  input         io_ptw_pmp_7_cfg_x,	// @[generators/rocket-chip/src/main/scala/rocket/HellaCache.scala:243:14]
  input         io_ptw_pmp_7_cfg_w,	// @[generators/rocket-chip/src/main/scala/rocket/HellaCache.scala:243:14]
  input         io_ptw_pmp_7_cfg_r,	// @[generators/rocket-chip/src/main/scala/rocket/HellaCache.scala:243:14]
  input  [29:0] io_ptw_pmp_7_addr,	// @[generators/rocket-chip/src/main/scala/rocket/HellaCache.scala:243:14]
  input  [31:0] io_ptw_pmp_7_mask	// @[generators/rocket-chip/src/main/scala/rocket/HellaCache.scala:243:14]
);

  wire             io_cpu_s2_xcpt_ma_st_0;	// @[generators/rocket-chip/src/main/scala/rocket/DCache.scala:931:24]
  wire             io_cpu_s2_xcpt_ma_ld_0;	// @[generators/rocket-chip/src/main/scala/rocket/DCache.scala:931:24]
  wire             io_cpu_s2_xcpt_ae_st_0;	// @[generators/rocket-chip/src/main/scala/rocket/DCache.scala:931:24]
  wire             io_cpu_s2_xcpt_ae_ld_0;	// @[generators/rocket-chip/src/main/scala/rocket/DCache.scala:931:24]
  wire             io_cpu_s2_xcpt_pf_st_0;	// @[generators/rocket-chip/src/main/scala/rocket/DCache.scala:931:24]
  wire             io_cpu_s2_xcpt_pf_ld_0;	// @[generators/rocket-chip/src/main/scala/rocket/DCache.scala:931:24]
  wire             _GEN;	// @[generators/rocket-chip/src/main/scala/rocket/DCache.scala:719:26, :750:68, :753:29, :755:32]
  wire             _GEN_0;	// @[generators/rocket-chip/src/main/scala/rocket/DCache.scala:750:31]
  wire             s1_nack;	// @[generators/rocket-chip/src/main/scala/rocket/DCache.scala:286:75, :444:{24,82,92}, :569:{36,46}]
  wire [3:0]       dataArb_io_in_1_bits_eccMask;	// @[generators/rocket-chip/src/main/scala/rocket/DCache.scala:555:47]
  wire [1:0]       dataArb_io_in_1_bits_wordMask;	// @[generators/rocket-chip/src/main/scala/rocket/DCache.scala:553:55]
  wire [13:0]      _dataArb_io_in_0_bits_wordMask_wordMask_T;	// @[generators/rocket-chip/src/main/scala/rocket/DCache.scala:547:36]
  wire             dataArb_io_in_0_valid;	// @[generators/rocket-chip/src/main/scala/rocket/DCache.scala:515:44]
  wire             pstore_drain;	// @[generators/rocket-chip/src/main/scala/rocket/DCache.scala:515:44]
  wire             metaArb_io_in_2_valid;	// @[generators/rocket-chip/src/main/scala/rocket/DCache.scala:444:62]
  wire [1:0]       dataArb_io_in_3_bits_wordMask;	// @[generators/rocket-chip/src/main/scala/rocket/DCache.scala:244:34]
  wire [13:0]      dataArb_io_in_3_bits_addr;	// @[generators/rocket-chip/src/main/scala/rocket/DCache.scala:243:30]
  wire             dataArb_io_in_3_valid;	// @[generators/rocket-chip/src/main/scala/rocket/DCache.scala:240:46]
  wire [31:0]      _amoalus_0_io_out_unmasked;	// @[generators/rocket-chip/src/main/scala/rocket/DCache.scala:980:26]
  wire [63:0]      _data_io_resp_0;	// @[generators/rocket-chip/src/main/scala/rocket/DCache.scala:143:20]
  wire             _tlb_pma_io_resp_r;	// @[generators/rocket-chip/src/main/scala/rocket/TLB.scala:422:19]
  wire             _tlb_pma_io_resp_w;	// @[generators/rocket-chip/src/main/scala/rocket/TLB.scala:422:19]
  wire             _tlb_pma_io_resp_pp;	// @[generators/rocket-chip/src/main/scala/rocket/TLB.scala:422:19]
  wire             _tlb_pma_io_resp_al;	// @[generators/rocket-chip/src/main/scala/rocket/TLB.scala:422:19]
  wire             _tlb_pma_io_resp_aa;	// @[generators/rocket-chip/src/main/scala/rocket/TLB.scala:422:19]
  wire             _tlb_pma_io_resp_eff;	// @[generators/rocket-chip/src/main/scala/rocket/TLB.scala:422:19]
  wire             _tlb_pmp_io_r;	// @[generators/rocket-chip/src/main/scala/rocket/TLB.scala:416:19]
  wire             _tlb_pmp_io_w;	// @[generators/rocket-chip/src/main/scala/rocket/TLB.scala:416:19]
  wire             _GEN_1 = dataArb_io_in_0_valid | _GEN;	// @[generators/rocket-chip/src/main/scala/rocket/DCache.scala:515:44, :719:26, :750:68, :753:29, :755:32, src/main/scala/chisel3/util/Arbiter.scala:145:26, :147:19]
  wire             dataArb__grant_T = dataArb_io_in_0_valid | _GEN;	// @[generators/rocket-chip/src/main/scala/rocket/DCache.scala:515:44, :719:26, :750:68, :753:29, :755:32, src/main/scala/chisel3/util/Arbiter.scala:45:68]
  wire             dataArb_io_out_valid = dataArb__grant_T | dataArb_io_in_3_valid;	// @[generators/rocket-chip/src/main/scala/rocket/DCache.scala:240:46, src/main/scala/chisel3/util/Arbiter.scala:45:68, :154:31]
  reg              s1_valid;	// @[generators/rocket-chip/src/main/scala/rocket/DCache.scala:180:25]
  wire             s1_valid_masked = s1_valid & ~io_cpu_s1_kill;	// @[generators/rocket-chip/src/main/scala/rocket/DCache.scala:180:25, :184:{34,37}]
  reg  [31:0]      s1_vaddr;	// @[generators/rocket-chip/src/main/scala/rocket/DCache.scala:194:25]
  reg  [6:0]       s1_req_tag;	// @[generators/rocket-chip/src/main/scala/rocket/DCache.scala:194:25]
  reg  [4:0]       s1_req_cmd;	// @[generators/rocket-chip/src/main/scala/rocket/DCache.scala:194:25]
  reg  [1:0]       s1_req_size;	// @[generators/rocket-chip/src/main/scala/rocket/DCache.scala:194:25]
  reg              s1_req_signed;	// @[generators/rocket-chip/src/main/scala/rocket/DCache.scala:194:25]
  reg  [1:0]       s1_req_dprv;	// @[generators/rocket-chip/src/main/scala/rocket/DCache.scala:194:25]
  reg              s1_req_dv;	// @[generators/rocket-chip/src/main/scala/rocket/DCache.scala:194:25]
  reg              s1_req_no_xcpt;	// @[generators/rocket-chip/src/main/scala/rocket/DCache.scala:194:25]
  reg  [31:0]      s1_tlb_req_vaddr;	// @[generators/rocket-chip/src/main/scala/rocket/DCache.scala:206:29]
  reg  [1:0]       s1_tlb_req_size;	// @[generators/rocket-chip/src/main/scala/rocket/DCache.scala:206:29]
  reg  [4:0]       s1_tlb_req_cmd;	// @[generators/rocket-chip/src/main/scala/rocket/DCache.scala:206:29]
  reg  [1:0]       s1_tlb_req_prv;	// @[generators/rocket-chip/src/main/scala/rocket/DCache.scala:206:29]
  wire             _io_cpu_perf_canAcceptLoadThenLoad_T_1 = s1_req_cmd == 5'h0;	// @[generators/rocket-chip/src/main/scala/rocket/DCache.scala:194:25, generators/rocket-chip/src/main/scala/util/package.scala:17:47]
  wire             _io_cpu_perf_canAcceptLoadThenLoad_T_2 = s1_req_cmd == 5'h10;	// @[generators/rocket-chip/src/main/scala/rocket/DCache.scala:194:25, generators/rocket-chip/src/main/scala/util/package.scala:17:47]
  wire             _io_cpu_perf_canAcceptLoadThenLoad_T_3 = s1_req_cmd == 5'h6;	// @[generators/rocket-chip/src/main/scala/rocket/DCache.scala:194:25, generators/rocket-chip/src/main/scala/util/package.scala:17:47]
  wire             _io_cpu_perf_canAcceptLoadThenLoad_T_29 = s1_req_cmd == 5'h7;	// @[generators/rocket-chip/src/main/scala/rocket/DCache.scala:194:25, generators/rocket-chip/src/main/scala/util/package.scala:17:47]
  wire             _io_cpu_perf_canAcceptLoadThenLoad_T_31 = s1_req_cmd == 5'h4;	// @[generators/rocket-chip/src/main/scala/rocket/DCache.scala:194:25, generators/rocket-chip/src/main/scala/util/package.scala:17:47]
  wire             _io_cpu_perf_canAcceptLoadThenLoad_T_32 = s1_req_cmd == 5'h9;	// @[generators/rocket-chip/src/main/scala/rocket/DCache.scala:194:25, generators/rocket-chip/src/main/scala/util/package.scala:17:47]
  wire             _io_cpu_perf_canAcceptLoadThenLoad_T_33 = s1_req_cmd == 5'hA;	// @[generators/rocket-chip/src/main/scala/rocket/DCache.scala:194:25, generators/rocket-chip/src/main/scala/util/package.scala:17:47]
  wire             _io_cpu_perf_canAcceptLoadThenLoad_T_34 = s1_req_cmd == 5'hB;	// @[generators/rocket-chip/src/main/scala/rocket/DCache.scala:194:25, generators/rocket-chip/src/main/scala/util/package.scala:17:47]
  wire             _io_cpu_perf_canAcceptLoadThenLoad_T_38 = s1_req_cmd == 5'h8;	// @[generators/rocket-chip/src/main/scala/rocket/DCache.scala:194:25, generators/rocket-chip/src/main/scala/util/package.scala:17:47]
  wire             _io_cpu_perf_canAcceptLoadThenLoad_T_39 = s1_req_cmd == 5'hC;	// @[generators/rocket-chip/src/main/scala/rocket/DCache.scala:194:25, generators/rocket-chip/src/main/scala/util/package.scala:17:47]
  wire             _io_cpu_perf_canAcceptLoadThenLoad_T_40 = s1_req_cmd == 5'hD;	// @[generators/rocket-chip/src/main/scala/rocket/DCache.scala:194:25, generators/rocket-chip/src/main/scala/util/package.scala:17:47]
  wire             _io_cpu_perf_canAcceptLoadThenLoad_T_41 = s1_req_cmd == 5'hE;	// @[generators/rocket-chip/src/main/scala/rocket/DCache.scala:194:25, generators/rocket-chip/src/main/scala/util/package.scala:17:47]
  wire             _io_cpu_perf_canAcceptLoadThenLoad_T_42 = s1_req_cmd == 5'hF;	// @[generators/rocket-chip/src/main/scala/rocket/DCache.scala:194:25, generators/rocket-chip/src/main/scala/util/package.scala:17:47]
  wire             s1_read = _io_cpu_perf_canAcceptLoadThenLoad_T_1 | _io_cpu_perf_canAcceptLoadThenLoad_T_2 | _io_cpu_perf_canAcceptLoadThenLoad_T_3 | _io_cpu_perf_canAcceptLoadThenLoad_T_29 | _io_cpu_perf_canAcceptLoadThenLoad_T_31 | _io_cpu_perf_canAcceptLoadThenLoad_T_32 | _io_cpu_perf_canAcceptLoadThenLoad_T_33 | _io_cpu_perf_canAcceptLoadThenLoad_T_34 | _io_cpu_perf_canAcceptLoadThenLoad_T_38 | _io_cpu_perf_canAcceptLoadThenLoad_T_39 | _io_cpu_perf_canAcceptLoadThenLoad_T_40 | _io_cpu_perf_canAcceptLoadThenLoad_T_41 | _io_cpu_perf_canAcceptLoadThenLoad_T_42;	// @[generators/rocket-chip/src/main/scala/rocket/Consts.scala:87:44, :89:68, generators/rocket-chip/src/main/scala/util/package.scala:17:47, :82:59]
  wire             _io_cpu_perf_canAcceptLoadThenLoad_T_26 = s1_req_cmd == 5'h1;	// @[generators/rocket-chip/src/main/scala/rocket/Consts.scala:90:32, generators/rocket-chip/src/main/scala/rocket/DCache.scala:194:25]
  wire             _io_cpu_perf_canAcceptLoadThenLoad_T_51 = s1_req_cmd == 5'h11;	// @[generators/rocket-chip/src/main/scala/rocket/Consts.scala:90:49, generators/rocket-chip/src/main/scala/rocket/DCache.scala:194:25]
  wire             s1_write = _io_cpu_perf_canAcceptLoadThenLoad_T_26 | _io_cpu_perf_canAcceptLoadThenLoad_T_51 | _io_cpu_perf_canAcceptLoadThenLoad_T_29 | _io_cpu_perf_canAcceptLoadThenLoad_T_31 | _io_cpu_perf_canAcceptLoadThenLoad_T_32 | _io_cpu_perf_canAcceptLoadThenLoad_T_33 | _io_cpu_perf_canAcceptLoadThenLoad_T_34 | _io_cpu_perf_canAcceptLoadThenLoad_T_38 | _io_cpu_perf_canAcceptLoadThenLoad_T_39 | _io_cpu_perf_canAcceptLoadThenLoad_T_40 | _io_cpu_perf_canAcceptLoadThenLoad_T_41 | _io_cpu_perf_canAcceptLoadThenLoad_T_42;	// @[generators/rocket-chip/src/main/scala/rocket/Consts.scala:87:44, :90:{32,42,49,59,76}, generators/rocket-chip/src/main/scala/util/package.scala:17:47, :82:59]
  reg              s1_flush_valid;	// @[generators/rocket-chip/src/main/scala/rocket/DCache.scala:213:27]
  reg              cached_grant_wait;	// @[generators/rocket-chip/src/main/scala/rocket/DCache.scala:221:34]
  wire             _io_cpu_req_ready_T_4 = ~cached_grant_wait & ~s1_nack;	// @[generators/rocket-chip/src/main/scala/rocket/DCache.scala:185:41, :221:34, :231:{54,73}, :286:75, :444:{24,82,92}, :569:{36,46}]
  reg              uncachedInFlight_0;	// @[generators/rocket-chip/src/main/scala/rocket/DCache.scala:234:33]
  reg  [31:0]      uncachedReqs_0_addr;	// @[generators/rocket-chip/src/main/scala/rocket/DCache.scala:235:25]
  reg  [6:0]       uncachedReqs_0_tag;	// @[generators/rocket-chip/src/main/scala/rocket/DCache.scala:235:25]
  reg  [1:0]       uncachedReqs_0_size;	// @[generators/rocket-chip/src/main/scala/rocket/DCache.scala:235:25]
  reg              uncachedReqs_0_signed;	// @[generators/rocket-chip/src/main/scala/rocket/DCache.scala:235:25]
  wire             _pstore_drain_opportunistic_T = io_cpu_req_bits_cmd == 5'h0;	// @[generators/rocket-chip/src/main/scala/util/package.scala:17:47]
  wire             _pstore_drain_opportunistic_T_1 = io_cpu_req_bits_cmd == 5'h10;	// @[generators/rocket-chip/src/main/scala/util/package.scala:17:47]
  wire             _pstore_drain_opportunistic_T_2 = io_cpu_req_bits_cmd == 5'h6;	// @[generators/rocket-chip/src/main/scala/util/package.scala:17:47]
  wire             _pstore_drain_opportunistic_T_28 = io_cpu_req_bits_cmd == 5'h7;	// @[generators/rocket-chip/src/main/scala/util/package.scala:17:47]
  wire             _pstore_drain_opportunistic_T_30 = io_cpu_req_bits_cmd == 5'h4;	// @[generators/rocket-chip/src/main/scala/util/package.scala:17:47]
  wire             _pstore_drain_opportunistic_T_31 = io_cpu_req_bits_cmd == 5'h9;	// @[generators/rocket-chip/src/main/scala/util/package.scala:17:47]
  wire             _pstore_drain_opportunistic_T_32 = io_cpu_req_bits_cmd == 5'hA;	// @[generators/rocket-chip/src/main/scala/util/package.scala:17:47]
  wire             _pstore_drain_opportunistic_T_33 = io_cpu_req_bits_cmd == 5'hB;	// @[generators/rocket-chip/src/main/scala/util/package.scala:17:47]
  wire             _pstore_drain_opportunistic_T_37 = io_cpu_req_bits_cmd == 5'h8;	// @[generators/rocket-chip/src/main/scala/util/package.scala:17:47]
  wire             _pstore_drain_opportunistic_T_38 = io_cpu_req_bits_cmd == 5'hC;	// @[generators/rocket-chip/src/main/scala/util/package.scala:17:47]
  wire             _pstore_drain_opportunistic_T_39 = io_cpu_req_bits_cmd == 5'hD;	// @[generators/rocket-chip/src/main/scala/util/package.scala:17:47]
  wire             _pstore_drain_opportunistic_T_40 = io_cpu_req_bits_cmd == 5'hE;	// @[generators/rocket-chip/src/main/scala/util/package.scala:17:47]
  wire             _pstore_drain_opportunistic_T_41 = io_cpu_req_bits_cmd == 5'hF;	// @[generators/rocket-chip/src/main/scala/util/package.scala:17:47]
  wire             _pstore_drain_opportunistic_T_25 = io_cpu_req_bits_cmd == 5'h1;	// @[generators/rocket-chip/src/main/scala/util/package.scala:17:47]
  wire             _pstore_drain_opportunistic_res_T_1 = io_cpu_req_bits_cmd == 5'h3;	// @[generators/rocket-chip/src/main/scala/util/package.scala:17:47]
  wire             _dataArb_io_in_3_valid_res_T_2 = _pstore_drain_opportunistic_T_25 | _pstore_drain_opportunistic_res_T_1;	// @[generators/rocket-chip/src/main/scala/util/package.scala:17:47, :82:59]
  wire             _pstore_drain_opportunistic_T_50 = io_cpu_req_bits_cmd == 5'h11;	// @[generators/rocket-chip/src/main/scala/rocket/Consts.scala:90:49]
  assign dataArb_io_in_3_valid = io_cpu_req_valid & ~_dataArb_io_in_3_valid_res_T_2;	// @[generators/rocket-chip/src/main/scala/rocket/DCache.scala:240:46, :1183:15, generators/rocket-chip/src/main/scala/util/package.scala:82:59]
  assign dataArb_io_in_3_bits_addr = io_cpu_req_bits_addr[13:0];	// @[generators/rocket-chip/src/main/scala/rocket/DCache.scala:243:30]
  assign dataArb_io_in_3_bits_wordMask = {io_cpu_req_bits_addr[2], ~(io_cpu_req_bits_addr[2])};	// @[generators/rocket-chip/src/main/scala/rocket/DCache.scala:244:34, :248:43, :249:22]
  wire             _GEN_2 = dataArb__grant_T & (_pstore_drain_opportunistic_T | _pstore_drain_opportunistic_T_1 | _pstore_drain_opportunistic_T_2 | _pstore_drain_opportunistic_T_28 | _pstore_drain_opportunistic_T_30 | _pstore_drain_opportunistic_T_31 | _pstore_drain_opportunistic_T_32 | _pstore_drain_opportunistic_T_33 | _pstore_drain_opportunistic_T_37 | _pstore_drain_opportunistic_T_38 | _pstore_drain_opportunistic_T_39 | _pstore_drain_opportunistic_T_40 | _pstore_drain_opportunistic_T_41);	// @[generators/rocket-chip/src/main/scala/rocket/Consts.scala:87:44, :89:68, generators/rocket-chip/src/main/scala/rocket/DCache.scala:256:33, generators/rocket-chip/src/main/scala/util/package.scala:17:47, :82:59, src/main/scala/chisel3/util/Arbiter.scala:45:68]
  reg              s1_did_read;	// @[generators/rocket-chip/src/main/scala/rocket/DCache.scala:257:30]
  reg  [1:0]       s1_read_mask;	// @[generators/rocket-chip/src/main/scala/rocket/DCache.scala:258:31]
  wire [1:0]       _s1_mask_xwr_T = {s1_vaddr[0] | (|s1_req_size), ~(s1_vaddr[0])};	// @[generators/rocket-chip/src/main/scala/rocket/AMOALU.scala:20:{27,42,53}, :21:22, :22:16, generators/rocket-chip/src/main/scala/rocket/DCache.scala:194:25]
  wire [3:0]       s1_mask_xwr = {(s1_vaddr[1] ? _s1_mask_xwr_T : 2'h0) | {2{s1_req_size[1]}}, s1_vaddr[1] ? 2'h0 : _s1_mask_xwr_T};	// @[generators/rocket-chip/src/main/scala/rocket/AMOALU.scala:20:{22,27,42,47,53}, :21:22, :22:16, generators/rocket-chip/src/main/scala/rocket/DCache.scala:194:25]
  reg              s2_valid;	// @[generators/rocket-chip/src/main/scala/rocket/DCache.scala:329:25]
  wire             s2_valid_no_xcpt = s2_valid & {io_cpu_s2_xcpt_ma_ld_0, io_cpu_s2_xcpt_ma_st_0, io_cpu_s2_xcpt_pf_ld_0, io_cpu_s2_xcpt_pf_st_0, io_cpu_s2_xcpt_ae_ld_0, io_cpu_s2_xcpt_ae_st_0} == 6'h0;	// @[generators/rocket-chip/src/main/scala/rocket/DCache.scala:329:25, :330:{35,54,61}, :931:24]
  reg              s2_not_nacked_in_s1;	// @[generators/rocket-chip/src/main/scala/rocket/DCache.scala:333:36]
  wire             s2_valid_masked = s2_valid_no_xcpt & s2_not_nacked_in_s1;	// @[generators/rocket-chip/src/main/scala/rocket/DCache.scala:330:35, :333:36, :335:42]
  reg  [31:0]      s2_req_addr;	// @[generators/rocket-chip/src/main/scala/rocket/DCache.scala:337:19]
  reg  [6:0]       s2_req_tag;	// @[generators/rocket-chip/src/main/scala/rocket/DCache.scala:337:19]
  reg  [4:0]       s2_req_cmd;	// @[generators/rocket-chip/src/main/scala/rocket/DCache.scala:337:19]
  reg  [1:0]       s2_req_size;	// @[generators/rocket-chip/src/main/scala/rocket/DCache.scala:337:19]
  reg              s2_req_signed;	// @[generators/rocket-chip/src/main/scala/rocket/DCache.scala:337:19]
  reg  [1:0]       s2_req_dprv;	// @[generators/rocket-chip/src/main/scala/rocket/DCache.scala:337:19]
  reg              s2_req_dv;	// @[generators/rocket-chip/src/main/scala/rocket/DCache.scala:337:19]
  reg              s2_req_no_xcpt;	// @[generators/rocket-chip/src/main/scala/rocket/DCache.scala:337:19]
  reg              s2_tlb_xcpt_pf_ld;	// @[generators/rocket-chip/src/main/scala/rocket/DCache.scala:340:24]
  reg              s2_tlb_xcpt_pf_st;	// @[generators/rocket-chip/src/main/scala/rocket/DCache.scala:340:24]
  reg              s2_tlb_xcpt_ae_ld;	// @[generators/rocket-chip/src/main/scala/rocket/DCache.scala:340:24]
  reg              s2_tlb_xcpt_ae_st;	// @[generators/rocket-chip/src/main/scala/rocket/DCache.scala:340:24]
  reg              s2_tlb_xcpt_ma_ld;	// @[generators/rocket-chip/src/main/scala/rocket/DCache.scala:340:24]
  reg              s2_tlb_xcpt_ma_st;	// @[generators/rocket-chip/src/main/scala/rocket/DCache.scala:340:24]
  reg              s2_pma_cacheable;	// @[generators/rocket-chip/src/main/scala/rocket/DCache.scala:341:19]
  reg  [31:0]      s2_uncached_resp_addr;	// @[generators/rocket-chip/src/main/scala/rocket/DCache.scala:342:34]
  reg  [31:0]      s2_vaddr_r;	// @[generators/rocket-chip/src/main/scala/rocket/DCache.scala:349:31]
  wire             _metaArb_io_in_3_bits_data_c_cat_T_48 = s2_req_cmd == 5'h6;	// @[generators/rocket-chip/src/main/scala/rocket/DCache.scala:337:19, generators/rocket-chip/src/main/scala/util/package.scala:17:47]
  wire             _io_cpu_store_pending_T_3 = s2_req_cmd == 5'h7;	// @[generators/rocket-chip/src/main/scala/rocket/DCache.scala:337:19, generators/rocket-chip/src/main/scala/util/package.scala:17:47]
  wire             _io_cpu_store_pending_T_5 = s2_req_cmd == 5'h4;	// @[generators/rocket-chip/src/main/scala/rocket/DCache.scala:337:19, generators/rocket-chip/src/main/scala/util/package.scala:17:47]
  wire             _io_cpu_store_pending_T_6 = s2_req_cmd == 5'h9;	// @[generators/rocket-chip/src/main/scala/rocket/DCache.scala:337:19, generators/rocket-chip/src/main/scala/util/package.scala:17:47]
  wire             _io_cpu_store_pending_T_7 = s2_req_cmd == 5'hA;	// @[generators/rocket-chip/src/main/scala/rocket/DCache.scala:337:19, generators/rocket-chip/src/main/scala/util/package.scala:17:47]
  wire             _io_cpu_store_pending_T_8 = s2_req_cmd == 5'hB;	// @[generators/rocket-chip/src/main/scala/rocket/DCache.scala:337:19, generators/rocket-chip/src/main/scala/util/package.scala:17:47]
  wire             _io_cpu_store_pending_T_12 = s2_req_cmd == 5'h8;	// @[generators/rocket-chip/src/main/scala/rocket/DCache.scala:337:19, generators/rocket-chip/src/main/scala/util/package.scala:17:47]
  wire             _io_cpu_store_pending_T_13 = s2_req_cmd == 5'hC;	// @[generators/rocket-chip/src/main/scala/rocket/DCache.scala:337:19, generators/rocket-chip/src/main/scala/util/package.scala:17:47]
  wire             _io_cpu_store_pending_T_14 = s2_req_cmd == 5'hD;	// @[generators/rocket-chip/src/main/scala/rocket/DCache.scala:337:19, generators/rocket-chip/src/main/scala/util/package.scala:17:47]
  wire             _io_cpu_store_pending_T_15 = s2_req_cmd == 5'hE;	// @[generators/rocket-chip/src/main/scala/rocket/DCache.scala:337:19, generators/rocket-chip/src/main/scala/util/package.scala:17:47]
  wire             _io_cpu_store_pending_T_16 = s2_req_cmd == 5'hF;	// @[generators/rocket-chip/src/main/scala/rocket/DCache.scala:337:19, generators/rocket-chip/src/main/scala/util/package.scala:17:47]
  wire             s2_read = s2_req_cmd == 5'h0 | s2_req_cmd == 5'h10 | _metaArb_io_in_3_bits_data_c_cat_T_48 | _io_cpu_store_pending_T_3 | _io_cpu_store_pending_T_5 | _io_cpu_store_pending_T_6 | _io_cpu_store_pending_T_7 | _io_cpu_store_pending_T_8 | _io_cpu_store_pending_T_12 | _io_cpu_store_pending_T_13 | _io_cpu_store_pending_T_14 | _io_cpu_store_pending_T_15 | _io_cpu_store_pending_T_16;	// @[generators/rocket-chip/src/main/scala/rocket/Consts.scala:87:44, :89:68, generators/rocket-chip/src/main/scala/rocket/DCache.scala:337:19, generators/rocket-chip/src/main/scala/util/package.scala:17:47, :82:59]
  wire             _io_cpu_store_pending_T = s2_req_cmd == 5'h1;	// @[generators/rocket-chip/src/main/scala/rocket/Consts.scala:90:32, generators/rocket-chip/src/main/scala/rocket/DCache.scala:337:19]
  wire             _io_cpu_store_pending_T_1 = s2_req_cmd == 5'h11;	// @[generators/rocket-chip/src/main/scala/rocket/Consts.scala:90:49, generators/rocket-chip/src/main/scala/rocket/DCache.scala:337:19]
  wire             s2_write = _io_cpu_store_pending_T | _io_cpu_store_pending_T_1 | _io_cpu_store_pending_T_3 | _io_cpu_store_pending_T_5 | _io_cpu_store_pending_T_6 | _io_cpu_store_pending_T_7 | _io_cpu_store_pending_T_8 | _io_cpu_store_pending_T_12 | _io_cpu_store_pending_T_13 | _io_cpu_store_pending_T_14 | _io_cpu_store_pending_T_15 | _io_cpu_store_pending_T_16;	// @[generators/rocket-chip/src/main/scala/rocket/Consts.scala:87:44, :90:{32,42,49,59,76}, generators/rocket-chip/src/main/scala/util/package.scala:17:47, :82:59]
  wire             s2_readwrite = s2_read | s2_write;	// @[generators/rocket-chip/src/main/scala/rocket/Consts.scala:87:44, :89:68, :90:{42,59,76}, generators/rocket-chip/src/main/scala/rocket/DCache.scala:352:30, generators/rocket-chip/src/main/scala/util/package.scala:82:59]
  reg  [31:0]      s2_data_r;	// @[generators/rocket-chip/src/main/scala/rocket/DCache.scala:377:18]
  reg  [31:0]      s2_data_r_1;	// @[generators/rocket-chip/src/main/scala/rocket/DCache.scala:377:18]
  reg  [1:0]       s2_hit_state_state;	// @[generators/rocket-chip/src/main/scala/rocket/DCache.scala:384:31]
  wire [3:0]       _r_T = {_io_cpu_store_pending_T | _io_cpu_store_pending_T_1 | _io_cpu_store_pending_T_3 | _io_cpu_store_pending_T_5 | _io_cpu_store_pending_T_6 | _io_cpu_store_pending_T_7 | _io_cpu_store_pending_T_8 | _io_cpu_store_pending_T_12 | _io_cpu_store_pending_T_13 | _io_cpu_store_pending_T_14 | _io_cpu_store_pending_T_15 | _io_cpu_store_pending_T_16, _io_cpu_store_pending_T | _io_cpu_store_pending_T_1 | _io_cpu_store_pending_T_3 | _io_cpu_store_pending_T_5 | _io_cpu_store_pending_T_6 | _io_cpu_store_pending_T_7 | _io_cpu_store_pending_T_8 | _io_cpu_store_pending_T_12 | _io_cpu_store_pending_T_13 | _io_cpu_store_pending_T_14 | _io_cpu_store_pending_T_15 | _io_cpu_store_pending_T_16 | s2_req_cmd == 5'h3 | _metaArb_io_in_3_bits_data_c_cat_T_48, s2_hit_state_state};	// @[generators/rocket-chip/src/main/scala/rocket/Consts.scala:87:44, :90:{32,42,49,59,76}, :91:{47,54,64}, generators/rocket-chip/src/main/scala/rocket/DCache.scala:337:19, :384:31, generators/rocket-chip/src/main/scala/tilelink/Metadata.scala:58:19, generators/rocket-chip/src/main/scala/util/package.scala:17:47, :82:59]
  wire [1:0]       _r_T_27 = {1'h0, _r_T == 4'hC};	// @[generators/rocket-chip/src/main/scala/tilelink/Metadata.scala:58:19, generators/rocket-chip/src/main/scala/util/Misc.scala:35:36, :49:20]
  wire             s2_hit = _r_T == 4'h3 | _r_T == 4'h2 | _r_T == 4'h1 | _r_T == 4'h7 | _r_T == 4'h6 | (&_r_T) | _r_T == 4'hE;	// @[generators/rocket-chip/src/main/scala/tilelink/Metadata.scala:58:19, generators/rocket-chip/src/main/scala/util/Misc.scala:35:9, :49:20]
  wire [15:0][1:0] _GEN_3 = {{2'h3}, {2'h3}, {2'h2}, {_r_T_27}, {_r_T_27}, {_r_T_27}, {_r_T_27}, {_r_T_27}, {2'h3}, {2'h2}, {2'h2}, {2'h1}, {2'h3}, {2'h2}, {2'h1}, {2'h0}};	// @[generators/rocket-chip/src/main/scala/util/Misc.scala:35:36, :49:20]
  wire             s2_valid_hit_pre_data_ecc_and_waw = s2_valid_masked & s2_hit & s2_readwrite;	// @[generators/rocket-chip/src/main/scala/rocket/DCache.scala:335:42, :352:30, :395:89, :416:89, generators/rocket-chip/src/main/scala/util/Misc.scala:35:9]
  wire             s2_valid_miss = s2_valid_masked & s2_readwrite & ~s2_hit;	// @[generators/rocket-chip/src/main/scala/rocket/DCache.scala:335:42, :352:30, :421:{39,73,76}, generators/rocket-chip/src/main/scala/util/Misc.scala:35:9]
  wire             s2_valid_cached_miss = s2_valid_miss & s2_pma_cacheable & ~uncachedInFlight_0;	// @[generators/rocket-chip/src/main/scala/rocket/DCache.scala:234:33, :341:19, :421:{39,73}, :423:{44,60,63}]
  wire             s2_valid_uncached_pending = s2_valid_miss & ~s2_pma_cacheable & ~uncachedInFlight_0;	// @[generators/rocket-chip/src/main/scala/rocket/DCache.scala:234:33, :341:19, :421:{39,73}, :422:21, :428:{49,64,67}]
  wire             s2_victim_dirty = &((|s2_hit_state_state) ? s2_hit_state_state : 2'h0);	// @[generators/rocket-chip/src/main/scala/rocket/DCache.scala:384:31, :432:28, generators/rocket-chip/src/main/scala/tilelink/Metadata.scala:50:45, generators/rocket-chip/src/main/scala/util/Misc.scala:38:9, :56:20]
  wire             io_cpu_s2_nack_0 = s2_valid_no_xcpt & ~(s2_valid_uncached_pending & auto_out_a_ready) & ~(s2_valid_masked & s2_req_cmd == 5'h17) & ~s2_valid_hit_pre_data_ecc_and_waw;	// @[generators/rocket-chip/src/main/scala/rocket/DCache.scala:330:35, :335:42, :337:19, :395:89, :416:89, :428:{49,64}, :438:57, :439:61, :442:17, :443:{38,41,64,67,86,89}]
  assign metaArb_io_in_2_valid = s2_valid_hit_pre_data_ecc_and_waw & s2_hit_state_state != _GEN_3[_r_T];	// @[generators/rocket-chip/src/main/scala/rocket/DCache.scala:384:31, :395:89, :416:89, :444:62, generators/rocket-chip/src/main/scala/tilelink/Metadata.scala:46:46, :47:40, :58:19, generators/rocket-chip/src/main/scala/util/Misc.scala:35:36, :49:20]
  reg  [4:0]       pstore1_cmd;	// @[generators/rocket-chip/src/main/scala/rocket/DCache.scala:490:30]
  reg  [31:0]      pstore1_addr;	// @[generators/rocket-chip/src/main/scala/rocket/DCache.scala:491:31]
  reg  [31:0]      pstore1_data;	// @[generators/rocket-chip/src/main/scala/rocket/DCache.scala:492:31]
  reg  [3:0]       pstore1_mask;	// @[generators/rocket-chip/src/main/scala/rocket/DCache.scala:494:31]
  reg              pstore1_rmw;	// @[generators/rocket-chip/src/main/scala/rocket/DCache.scala:496:44]
  wire             _pstore1_held_T_2 = s2_valid_hit_pre_data_ecc_and_waw & s2_write;	// @[generators/rocket-chip/src/main/scala/rocket/Consts.scala:87:44, :90:{42,59,76}, generators/rocket-chip/src/main/scala/rocket/DCache.scala:395:89, :416:89, :488:46, generators/rocket-chip/src/main/scala/util/package.scala:82:59]
  reg              pstore2_valid;	// @[generators/rocket-chip/src/main/scala/rocket/DCache.scala:499:30]
  wire             _pstore_drain_opportunistic_res_T_2 = _pstore_drain_opportunistic_T_25 | _pstore_drain_opportunistic_res_T_1;	// @[generators/rocket-chip/src/main/scala/util/package.scala:17:47, :82:59]
  reg              pstore_drain_on_miss_REG;	// @[generators/rocket-chip/src/main/scala/rocket/DCache.scala:501:56]
  reg              pstore1_held;	// @[generators/rocket-chip/src/main/scala/rocket/DCache.scala:502:29]
  wire             pstore1_valid_likely = s2_valid & s2_write | pstore1_held;	// @[generators/rocket-chip/src/main/scala/rocket/Consts.scala:87:44, :90:{42,59,76}, generators/rocket-chip/src/main/scala/rocket/DCache.scala:329:25, :502:29, :503:{39,51}, generators/rocket-chip/src/main/scala/util/package.scala:82:59]
  wire             pstore1_valid = _pstore1_held_T_2 | pstore1_held;	// @[generators/rocket-chip/src/main/scala/rocket/DCache.scala:488:46, :502:29, :505:38]
  wire             pstore_drain_structural = pstore1_valid_likely & pstore2_valid & (s1_valid & s1_write | pstore1_rmw);	// @[generators/rocket-chip/src/main/scala/rocket/Consts.scala:87:44, :90:{42,59,76}, generators/rocket-chip/src/main/scala/rocket/DCache.scala:180:25, :496:44, :499:30, :503:51, :507:{54,71,85,98}, generators/rocket-chip/src/main/scala/util/package.scala:82:59]
  wire             _dataArb_io_in_0_valid_T_4 = s2_valid_hit_pre_data_ecc_and_waw & s2_write;	// @[generators/rocket-chip/src/main/scala/rocket/Consts.scala:87:44, :90:{42,59,76}, generators/rocket-chip/src/main/scala/rocket/DCache.scala:395:89, :416:89, :504:72, generators/rocket-chip/src/main/scala/util/package.scala:82:59]
  wire             _dataArb_io_in_0_valid_T_9 = ~(io_cpu_req_valid & ~_pstore_drain_opportunistic_res_T_2) | pstore_drain_on_miss_REG;	// @[generators/rocket-chip/src/main/scala/rocket/DCache.scala:500:{36,55}, :501:56, :516:107, :1183:15, generators/rocket-chip/src/main/scala/util/package.scala:82:59]
  assign pstore_drain = pstore_drain_structural | ((_dataArb_io_in_0_valid_T_4 | pstore1_held) & ~pstore1_rmw | pstore2_valid) & _dataArb_io_in_0_valid_T_9;	// @[generators/rocket-chip/src/main/scala/rocket/DCache.scala:496:44, :499:30, :502:29, :504:{72,96}, :507:{54,71}, :515:44, :516:{41,44,58,76,107}]
  reg  [31:0]      pstore2_addr;	// @[generators/rocket-chip/src/main/scala/rocket/DCache.scala:522:31]
  reg  [7:0]       pstore2_storegen_data_r;	// @[generators/rocket-chip/src/main/scala/rocket/DCache.scala:526:22]
  reg  [7:0]       pstore2_storegen_data_r_1;	// @[generators/rocket-chip/src/main/scala/rocket/DCache.scala:526:22]
  reg  [7:0]       pstore2_storegen_data_r_2;	// @[generators/rocket-chip/src/main/scala/rocket/DCache.scala:526:22]
  reg  [7:0]       pstore2_storegen_data_r_3;	// @[generators/rocket-chip/src/main/scala/rocket/DCache.scala:526:22]
  reg  [3:0]       pstore2_storegen_mask;	// @[generators/rocket-chip/src/main/scala/rocket/DCache.scala:529:19]
  assign dataArb_io_in_0_valid = pstore_drain_structural | ((_dataArb_io_in_0_valid_T_4 | pstore1_held) & ~pstore1_rmw | pstore2_valid) & _dataArb_io_in_0_valid_T_9;	// @[generators/rocket-chip/src/main/scala/rocket/DCache.scala:496:44, :499:30, :502:29, :504:{72,96}, :507:{54,71}, :515:44, :516:{41,44,58,76,107}]
  assign _dataArb_io_in_0_bits_wordMask_wordMask_T = pstore2_valid ? pstore2_addr[13:0] : pstore1_addr[13:0];	// @[generators/rocket-chip/src/main/scala/rocket/DCache.scala:491:31, :499:30, :522:31, :547:36]
  assign dataArb_io_in_1_bits_wordMask = 2'h1 << _dataArb_io_in_0_bits_wordMask_wordMask_T[2] & {2{|dataArb_io_in_1_bits_eccMask}};	// @[generators/rocket-chip/src/main/scala/rocket/DCache.scala:547:36, :553:{55,61}, :555:47, generators/rocket-chip/src/main/scala/util/package.scala:82:59, :164:13, src/main/scala/chisel3/util/OneHot.scala:58:35]
  assign dataArb_io_in_1_bits_eccMask = pstore2_valid ? pstore2_storegen_mask : pstore1_mask;	// @[generators/rocket-chip/src/main/scala/rocket/DCache.scala:494:31, :499:30, :529:19, :555:47]
  assign s1_nack = s1_valid & s1_read & (pstore1_valid_likely & pstore1_addr[13:2] == s1_vaddr[13:2] & (s1_write ? (|(pstore1_mask & s1_mask_xwr)) : (|(pstore1_mask & s1_mask_xwr))) | pstore2_valid & pstore2_addr[13:2] == s1_vaddr[13:2] & (s1_write ? (|(pstore2_storegen_mask & s1_mask_xwr)) : (|(pstore2_storegen_mask & s1_mask_xwr)))) | io_cpu_s2_nack_0 | metaArb_io_in_2_valid;	// @[generators/rocket-chip/src/main/scala/rocket/AMOALU.scala:22:16, generators/rocket-chip/src/main/scala/rocket/Consts.scala:87:44, :89:68, :90:{42,59,76}, generators/rocket-chip/src/main/scala/rocket/DCache.scala:180:25, :194:25, :286:75, :443:{38,64,86}, :444:{24,62,82,92}, :491:31, :494:31, :499:30, :503:51, :522:31, :529:19, :559:{9,31,43,65}, :560:{8,38,66,77,92}, :562:{27,69}, :563:21, :564:31, :569:{18,36,46}, generators/rocket-chip/src/main/scala/util/package.scala:82:59]
  wire [18:0]      a_mask = {15'h0, pstore1_mask} << {15'h0, s2_req_addr[2], 3'h0};	// @[generators/rocket-chip/src/main/scala/rocket/DCache.scala:337:19, :494:31, :580:29, generators/rocket-chip/src/main/scala/util/package.scala:164:13]
  wire             get_a_mask_sub_sub_size = s2_req_size == 2'h2;	// @[generators/rocket-chip/src/main/scala/rocket/DCache.scala:337:19, generators/rocket-chip/src/main/scala/util/Misc.scala:209:26]
  wire             get_a_mask_sub_sub_0_1 = (&s2_req_size) | get_a_mask_sub_sub_size & ~(s2_req_addr[2]);	// @[generators/rocket-chip/src/main/scala/rocket/DCache.scala:337:19, generators/rocket-chip/src/main/scala/util/Misc.scala:206:21, :209:26, :211:20, :215:{29,38}, generators/rocket-chip/src/main/scala/util/package.scala:164:13]
  wire             get_a_mask_sub_sub_1_1 = (&s2_req_size) | get_a_mask_sub_sub_size & s2_req_addr[2];	// @[generators/rocket-chip/src/main/scala/rocket/DCache.scala:337:19, generators/rocket-chip/src/main/scala/util/Misc.scala:206:21, :209:26, :215:{29,38}, generators/rocket-chip/src/main/scala/util/package.scala:164:13]
  wire             get_a_mask_sub_size = s2_req_size == 2'h1;	// @[generators/rocket-chip/src/main/scala/rocket/DCache.scala:337:19, generators/rocket-chip/src/main/scala/util/Misc.scala:209:26]
  wire             get_a_mask_sub_0_2 = ~(s2_req_addr[2]) & ~(s2_req_addr[1]);	// @[generators/rocket-chip/src/main/scala/rocket/DCache.scala:337:19, generators/rocket-chip/src/main/scala/util/Misc.scala:210:26, :211:20, :214:27, generators/rocket-chip/src/main/scala/util/package.scala:164:13]
  wire             get_a_mask_sub_0_1 = get_a_mask_sub_sub_0_1 | get_a_mask_sub_size & get_a_mask_sub_0_2;	// @[generators/rocket-chip/src/main/scala/util/Misc.scala:209:26, :214:27, :215:{29,38}]
  wire             get_a_mask_sub_1_2 = ~(s2_req_addr[2]) & s2_req_addr[1];	// @[generators/rocket-chip/src/main/scala/rocket/DCache.scala:337:19, generators/rocket-chip/src/main/scala/util/Misc.scala:210:26, :211:20, :214:27, generators/rocket-chip/src/main/scala/util/package.scala:164:13]
  wire             get_a_mask_sub_1_1 = get_a_mask_sub_sub_0_1 | get_a_mask_sub_size & get_a_mask_sub_1_2;	// @[generators/rocket-chip/src/main/scala/util/Misc.scala:209:26, :214:27, :215:{29,38}]
  wire             get_a_mask_sub_2_2 = s2_req_addr[2] & ~(s2_req_addr[1]);	// @[generators/rocket-chip/src/main/scala/rocket/DCache.scala:337:19, generators/rocket-chip/src/main/scala/util/Misc.scala:210:26, :211:20, :214:27, generators/rocket-chip/src/main/scala/util/package.scala:164:13]
  wire             get_a_mask_sub_2_1 = get_a_mask_sub_sub_1_1 | get_a_mask_sub_size & get_a_mask_sub_2_2;	// @[generators/rocket-chip/src/main/scala/util/Misc.scala:209:26, :214:27, :215:{29,38}]
  wire             get_a_mask_sub_3_2 = s2_req_addr[2] & s2_req_addr[1];	// @[generators/rocket-chip/src/main/scala/rocket/DCache.scala:337:19, generators/rocket-chip/src/main/scala/util/Misc.scala:210:26, :214:27, generators/rocket-chip/src/main/scala/util/package.scala:164:13]
  wire             get_a_mask_sub_3_1 = get_a_mask_sub_sub_1_1 | get_a_mask_sub_size & get_a_mask_sub_3_2;	// @[generators/rocket-chip/src/main/scala/util/Misc.scala:209:26, :214:27, :215:{29,38}]
  wire             put_a_mask_sub_sub_size = s2_req_size == 2'h2;	// @[generators/rocket-chip/src/main/scala/rocket/DCache.scala:337:19, generators/rocket-chip/src/main/scala/util/Misc.scala:209:26]
  wire             put_a_mask_sub_sub_0_1 = (&s2_req_size) | put_a_mask_sub_sub_size & ~(s2_req_addr[2]);	// @[generators/rocket-chip/src/main/scala/rocket/DCache.scala:337:19, generators/rocket-chip/src/main/scala/util/Misc.scala:206:21, :209:26, :211:20, :215:{29,38}, generators/rocket-chip/src/main/scala/util/package.scala:164:13]
  wire             put_a_mask_sub_sub_1_1 = (&s2_req_size) | put_a_mask_sub_sub_size & s2_req_addr[2];	// @[generators/rocket-chip/src/main/scala/rocket/DCache.scala:337:19, generators/rocket-chip/src/main/scala/util/Misc.scala:206:21, :209:26, :215:{29,38}, generators/rocket-chip/src/main/scala/util/package.scala:164:13]
  wire             put_a_mask_sub_size = s2_req_size == 2'h1;	// @[generators/rocket-chip/src/main/scala/rocket/DCache.scala:337:19, generators/rocket-chip/src/main/scala/util/Misc.scala:209:26]
  wire             put_a_mask_sub_0_2 = ~(s2_req_addr[2]) & ~(s2_req_addr[1]);	// @[generators/rocket-chip/src/main/scala/rocket/DCache.scala:337:19, generators/rocket-chip/src/main/scala/util/Misc.scala:210:26, :211:20, :214:27, generators/rocket-chip/src/main/scala/util/package.scala:164:13]
  wire             put_a_mask_sub_0_1 = put_a_mask_sub_sub_0_1 | put_a_mask_sub_size & put_a_mask_sub_0_2;	// @[generators/rocket-chip/src/main/scala/util/Misc.scala:209:26, :214:27, :215:{29,38}]
  wire             put_a_mask_sub_1_2 = ~(s2_req_addr[2]) & s2_req_addr[1];	// @[generators/rocket-chip/src/main/scala/rocket/DCache.scala:337:19, generators/rocket-chip/src/main/scala/util/Misc.scala:210:26, :211:20, :214:27, generators/rocket-chip/src/main/scala/util/package.scala:164:13]
  wire             put_a_mask_sub_1_1 = put_a_mask_sub_sub_0_1 | put_a_mask_sub_size & put_a_mask_sub_1_2;	// @[generators/rocket-chip/src/main/scala/util/Misc.scala:209:26, :214:27, :215:{29,38}]
  wire             put_a_mask_sub_2_2 = s2_req_addr[2] & ~(s2_req_addr[1]);	// @[generators/rocket-chip/src/main/scala/rocket/DCache.scala:337:19, generators/rocket-chip/src/main/scala/util/Misc.scala:210:26, :211:20, :214:27, generators/rocket-chip/src/main/scala/util/package.scala:164:13]
  wire             put_a_mask_sub_2_1 = put_a_mask_sub_sub_1_1 | put_a_mask_sub_size & put_a_mask_sub_2_2;	// @[generators/rocket-chip/src/main/scala/util/Misc.scala:209:26, :214:27, :215:{29,38}]
  wire             put_a_mask_sub_3_2 = s2_req_addr[2] & s2_req_addr[1];	// @[generators/rocket-chip/src/main/scala/rocket/DCache.scala:337:19, generators/rocket-chip/src/main/scala/util/Misc.scala:210:26, :214:27, generators/rocket-chip/src/main/scala/util/package.scala:164:13]
  wire             put_a_mask_sub_3_1 = put_a_mask_sub_sub_1_1 | put_a_mask_sub_size & put_a_mask_sub_3_2;	// @[generators/rocket-chip/src/main/scala/util/Misc.scala:209:26, :214:27, :215:{29,38}]
  wire             atomics_a_mask_sub_sub_size = s2_req_size == 2'h2;	// @[generators/rocket-chip/src/main/scala/rocket/DCache.scala:337:19, generators/rocket-chip/src/main/scala/util/Misc.scala:209:26]
  wire             atomics_a_mask_sub_sub_0_1 = (&s2_req_size) | atomics_a_mask_sub_sub_size & ~(s2_req_addr[2]);	// @[generators/rocket-chip/src/main/scala/rocket/DCache.scala:337:19, generators/rocket-chip/src/main/scala/util/Misc.scala:206:21, :209:26, :211:20, :215:{29,38}, generators/rocket-chip/src/main/scala/util/package.scala:164:13]
  wire             atomics_a_mask_sub_sub_1_1 = (&s2_req_size) | atomics_a_mask_sub_sub_size & s2_req_addr[2];	// @[generators/rocket-chip/src/main/scala/rocket/DCache.scala:337:19, generators/rocket-chip/src/main/scala/util/Misc.scala:206:21, :209:26, :215:{29,38}, generators/rocket-chip/src/main/scala/util/package.scala:164:13]
  wire             atomics_a_mask_sub_size = s2_req_size == 2'h1;	// @[generators/rocket-chip/src/main/scala/rocket/DCache.scala:337:19, generators/rocket-chip/src/main/scala/util/Misc.scala:209:26]
  wire             atomics_a_mask_sub_0_2 = ~(s2_req_addr[2]) & ~(s2_req_addr[1]);	// @[generators/rocket-chip/src/main/scala/rocket/DCache.scala:337:19, generators/rocket-chip/src/main/scala/util/Misc.scala:210:26, :211:20, :214:27, generators/rocket-chip/src/main/scala/util/package.scala:164:13]
  wire             atomics_a_mask_sub_0_1 = atomics_a_mask_sub_sub_0_1 | atomics_a_mask_sub_size & atomics_a_mask_sub_0_2;	// @[generators/rocket-chip/src/main/scala/util/Misc.scala:209:26, :214:27, :215:{29,38}]
  wire             atomics_a_mask_sub_1_2 = ~(s2_req_addr[2]) & s2_req_addr[1];	// @[generators/rocket-chip/src/main/scala/rocket/DCache.scala:337:19, generators/rocket-chip/src/main/scala/util/Misc.scala:210:26, :211:20, :214:27, generators/rocket-chip/src/main/scala/util/package.scala:164:13]
  wire             atomics_a_mask_sub_1_1 = atomics_a_mask_sub_sub_0_1 | atomics_a_mask_sub_size & atomics_a_mask_sub_1_2;	// @[generators/rocket-chip/src/main/scala/util/Misc.scala:209:26, :214:27, :215:{29,38}]
  wire             atomics_a_mask_sub_2_2 = s2_req_addr[2] & ~(s2_req_addr[1]);	// @[generators/rocket-chip/src/main/scala/rocket/DCache.scala:337:19, generators/rocket-chip/src/main/scala/util/Misc.scala:210:26, :211:20, :214:27, generators/rocket-chip/src/main/scala/util/package.scala:164:13]
  wire             atomics_a_mask_sub_2_1 = atomics_a_mask_sub_sub_1_1 | atomics_a_mask_sub_size & atomics_a_mask_sub_2_2;	// @[generators/rocket-chip/src/main/scala/util/Misc.scala:209:26, :214:27, :215:{29,38}]
  wire             atomics_a_mask_sub_3_2 = s2_req_addr[2] & s2_req_addr[1];	// @[generators/rocket-chip/src/main/scala/rocket/DCache.scala:337:19, generators/rocket-chip/src/main/scala/util/Misc.scala:210:26, :214:27, generators/rocket-chip/src/main/scala/util/package.scala:164:13]
  wire             atomics_a_mask_sub_3_1 = atomics_a_mask_sub_sub_1_1 | atomics_a_mask_sub_size & atomics_a_mask_sub_3_2;	// @[generators/rocket-chip/src/main/scala/util/Misc.scala:209:26, :214:27, :215:{29,38}]
  wire             atomics_a_mask_sub_sub_size_1 = s2_req_size == 2'h2;	// @[generators/rocket-chip/src/main/scala/rocket/DCache.scala:337:19, generators/rocket-chip/src/main/scala/util/Misc.scala:209:26]
  wire             atomics_a_mask_sub_sub_0_1_1 = (&s2_req_size) | atomics_a_mask_sub_sub_size_1 & ~(s2_req_addr[2]);	// @[generators/rocket-chip/src/main/scala/rocket/DCache.scala:337:19, generators/rocket-chip/src/main/scala/util/Misc.scala:206:21, :209:26, :211:20, :215:{29,38}, generators/rocket-chip/src/main/scala/util/package.scala:164:13]
  wire             atomics_a_mask_sub_sub_1_1_1 = (&s2_req_size) | atomics_a_mask_sub_sub_size_1 & s2_req_addr[2];	// @[generators/rocket-chip/src/main/scala/rocket/DCache.scala:337:19, generators/rocket-chip/src/main/scala/util/Misc.scala:206:21, :209:26, :215:{29,38}, generators/rocket-chip/src/main/scala/util/package.scala:164:13]
  wire             atomics_a_mask_sub_size_1 = s2_req_size == 2'h1;	// @[generators/rocket-chip/src/main/scala/rocket/DCache.scala:337:19, generators/rocket-chip/src/main/scala/util/Misc.scala:209:26]
  wire             atomics_a_mask_sub_0_2_1 = ~(s2_req_addr[2]) & ~(s2_req_addr[1]);	// @[generators/rocket-chip/src/main/scala/rocket/DCache.scala:337:19, generators/rocket-chip/src/main/scala/util/Misc.scala:210:26, :211:20, :214:27, generators/rocket-chip/src/main/scala/util/package.scala:164:13]
  wire             atomics_a_mask_sub_0_1_1 = atomics_a_mask_sub_sub_0_1_1 | atomics_a_mask_sub_size_1 & atomics_a_mask_sub_0_2_1;	// @[generators/rocket-chip/src/main/scala/util/Misc.scala:209:26, :214:27, :215:{29,38}]
  wire             atomics_a_mask_sub_1_2_1 = ~(s2_req_addr[2]) & s2_req_addr[1];	// @[generators/rocket-chip/src/main/scala/rocket/DCache.scala:337:19, generators/rocket-chip/src/main/scala/util/Misc.scala:210:26, :211:20, :214:27, generators/rocket-chip/src/main/scala/util/package.scala:164:13]
  wire             atomics_a_mask_sub_1_1_1 = atomics_a_mask_sub_sub_0_1_1 | atomics_a_mask_sub_size_1 & atomics_a_mask_sub_1_2_1;	// @[generators/rocket-chip/src/main/scala/util/Misc.scala:209:26, :214:27, :215:{29,38}]
  wire             atomics_a_mask_sub_2_2_1 = s2_req_addr[2] & ~(s2_req_addr[1]);	// @[generators/rocket-chip/src/main/scala/rocket/DCache.scala:337:19, generators/rocket-chip/src/main/scala/util/Misc.scala:210:26, :211:20, :214:27, generators/rocket-chip/src/main/scala/util/package.scala:164:13]
  wire             atomics_a_mask_sub_2_1_1 = atomics_a_mask_sub_sub_1_1_1 | atomics_a_mask_sub_size_1 & atomics_a_mask_sub_2_2_1;	// @[generators/rocket-chip/src/main/scala/util/Misc.scala:209:26, :214:27, :215:{29,38}]
  wire             atomics_a_mask_sub_3_2_1 = s2_req_addr[2] & s2_req_addr[1];	// @[generators/rocket-chip/src/main/scala/rocket/DCache.scala:337:19, generators/rocket-chip/src/main/scala/util/Misc.scala:210:26, :214:27, generators/rocket-chip/src/main/scala/util/package.scala:164:13]
  wire             atomics_a_mask_sub_3_1_1 = atomics_a_mask_sub_sub_1_1_1 | atomics_a_mask_sub_size_1 & atomics_a_mask_sub_3_2_1;	// @[generators/rocket-chip/src/main/scala/util/Misc.scala:209:26, :214:27, :215:{29,38}]
  wire             atomics_a_mask_sub_sub_size_2 = s2_req_size == 2'h2;	// @[generators/rocket-chip/src/main/scala/rocket/DCache.scala:337:19, generators/rocket-chip/src/main/scala/util/Misc.scala:209:26]
  wire             atomics_a_mask_sub_sub_0_1_2 = (&s2_req_size) | atomics_a_mask_sub_sub_size_2 & ~(s2_req_addr[2]);	// @[generators/rocket-chip/src/main/scala/rocket/DCache.scala:337:19, generators/rocket-chip/src/main/scala/util/Misc.scala:206:21, :209:26, :211:20, :215:{29,38}, generators/rocket-chip/src/main/scala/util/package.scala:164:13]
  wire             atomics_a_mask_sub_sub_1_1_2 = (&s2_req_size) | atomics_a_mask_sub_sub_size_2 & s2_req_addr[2];	// @[generators/rocket-chip/src/main/scala/rocket/DCache.scala:337:19, generators/rocket-chip/src/main/scala/util/Misc.scala:206:21, :209:26, :215:{29,38}, generators/rocket-chip/src/main/scala/util/package.scala:164:13]
  wire             atomics_a_mask_sub_size_2 = s2_req_size == 2'h1;	// @[generators/rocket-chip/src/main/scala/rocket/DCache.scala:337:19, generators/rocket-chip/src/main/scala/util/Misc.scala:209:26]
  wire             atomics_a_mask_sub_0_2_2 = ~(s2_req_addr[2]) & ~(s2_req_addr[1]);	// @[generators/rocket-chip/src/main/scala/rocket/DCache.scala:337:19, generators/rocket-chip/src/main/scala/util/Misc.scala:210:26, :211:20, :214:27, generators/rocket-chip/src/main/scala/util/package.scala:164:13]
  wire             atomics_a_mask_sub_0_1_2 = atomics_a_mask_sub_sub_0_1_2 | atomics_a_mask_sub_size_2 & atomics_a_mask_sub_0_2_2;	// @[generators/rocket-chip/src/main/scala/util/Misc.scala:209:26, :214:27, :215:{29,38}]
  wire             atomics_a_mask_sub_1_2_2 = ~(s2_req_addr[2]) & s2_req_addr[1];	// @[generators/rocket-chip/src/main/scala/rocket/DCache.scala:337:19, generators/rocket-chip/src/main/scala/util/Misc.scala:210:26, :211:20, :214:27, generators/rocket-chip/src/main/scala/util/package.scala:164:13]
  wire             atomics_a_mask_sub_1_1_2 = atomics_a_mask_sub_sub_0_1_2 | atomics_a_mask_sub_size_2 & atomics_a_mask_sub_1_2_2;	// @[generators/rocket-chip/src/main/scala/util/Misc.scala:209:26, :214:27, :215:{29,38}]
  wire             atomics_a_mask_sub_2_2_2 = s2_req_addr[2] & ~(s2_req_addr[1]);	// @[generators/rocket-chip/src/main/scala/rocket/DCache.scala:337:19, generators/rocket-chip/src/main/scala/util/Misc.scala:210:26, :211:20, :214:27, generators/rocket-chip/src/main/scala/util/package.scala:164:13]
  wire             atomics_a_mask_sub_2_1_2 = atomics_a_mask_sub_sub_1_1_2 | atomics_a_mask_sub_size_2 & atomics_a_mask_sub_2_2_2;	// @[generators/rocket-chip/src/main/scala/util/Misc.scala:209:26, :214:27, :215:{29,38}]
  wire             atomics_a_mask_sub_3_2_2 = s2_req_addr[2] & s2_req_addr[1];	// @[generators/rocket-chip/src/main/scala/rocket/DCache.scala:337:19, generators/rocket-chip/src/main/scala/util/Misc.scala:210:26, :214:27, generators/rocket-chip/src/main/scala/util/package.scala:164:13]
  wire             atomics_a_mask_sub_3_1_2 = atomics_a_mask_sub_sub_1_1_2 | atomics_a_mask_sub_size_2 & atomics_a_mask_sub_3_2_2;	// @[generators/rocket-chip/src/main/scala/util/Misc.scala:209:26, :214:27, :215:{29,38}]
  wire             atomics_a_mask_sub_sub_size_3 = s2_req_size == 2'h2;	// @[generators/rocket-chip/src/main/scala/rocket/DCache.scala:337:19, generators/rocket-chip/src/main/scala/util/Misc.scala:209:26]
  wire             atomics_a_mask_sub_sub_0_1_3 = (&s2_req_size) | atomics_a_mask_sub_sub_size_3 & ~(s2_req_addr[2]);	// @[generators/rocket-chip/src/main/scala/rocket/DCache.scala:337:19, generators/rocket-chip/src/main/scala/util/Misc.scala:206:21, :209:26, :211:20, :215:{29,38}, generators/rocket-chip/src/main/scala/util/package.scala:164:13]
  wire             atomics_a_mask_sub_sub_1_1_3 = (&s2_req_size) | atomics_a_mask_sub_sub_size_3 & s2_req_addr[2];	// @[generators/rocket-chip/src/main/scala/rocket/DCache.scala:337:19, generators/rocket-chip/src/main/scala/util/Misc.scala:206:21, :209:26, :215:{29,38}, generators/rocket-chip/src/main/scala/util/package.scala:164:13]
  wire             atomics_a_mask_sub_size_3 = s2_req_size == 2'h1;	// @[generators/rocket-chip/src/main/scala/rocket/DCache.scala:337:19, generators/rocket-chip/src/main/scala/util/Misc.scala:209:26]
  wire             atomics_a_mask_sub_0_2_3 = ~(s2_req_addr[2]) & ~(s2_req_addr[1]);	// @[generators/rocket-chip/src/main/scala/rocket/DCache.scala:337:19, generators/rocket-chip/src/main/scala/util/Misc.scala:210:26, :211:20, :214:27, generators/rocket-chip/src/main/scala/util/package.scala:164:13]
  wire             atomics_a_mask_sub_0_1_3 = atomics_a_mask_sub_sub_0_1_3 | atomics_a_mask_sub_size_3 & atomics_a_mask_sub_0_2_3;	// @[generators/rocket-chip/src/main/scala/util/Misc.scala:209:26, :214:27, :215:{29,38}]
  wire             atomics_a_mask_sub_1_2_3 = ~(s2_req_addr[2]) & s2_req_addr[1];	// @[generators/rocket-chip/src/main/scala/rocket/DCache.scala:337:19, generators/rocket-chip/src/main/scala/util/Misc.scala:210:26, :211:20, :214:27, generators/rocket-chip/src/main/scala/util/package.scala:164:13]
  wire             atomics_a_mask_sub_1_1_3 = atomics_a_mask_sub_sub_0_1_3 | atomics_a_mask_sub_size_3 & atomics_a_mask_sub_1_2_3;	// @[generators/rocket-chip/src/main/scala/util/Misc.scala:209:26, :214:27, :215:{29,38}]
  wire             atomics_a_mask_sub_2_2_3 = s2_req_addr[2] & ~(s2_req_addr[1]);	// @[generators/rocket-chip/src/main/scala/rocket/DCache.scala:337:19, generators/rocket-chip/src/main/scala/util/Misc.scala:210:26, :211:20, :214:27, generators/rocket-chip/src/main/scala/util/package.scala:164:13]
  wire             atomics_a_mask_sub_2_1_3 = atomics_a_mask_sub_sub_1_1_3 | atomics_a_mask_sub_size_3 & atomics_a_mask_sub_2_2_3;	// @[generators/rocket-chip/src/main/scala/util/Misc.scala:209:26, :214:27, :215:{29,38}]
  wire             atomics_a_mask_sub_3_2_3 = s2_req_addr[2] & s2_req_addr[1];	// @[generators/rocket-chip/src/main/scala/rocket/DCache.scala:337:19, generators/rocket-chip/src/main/scala/util/Misc.scala:210:26, :214:27, generators/rocket-chip/src/main/scala/util/package.scala:164:13]
  wire             atomics_a_mask_sub_3_1_3 = atomics_a_mask_sub_sub_1_1_3 | atomics_a_mask_sub_size_3 & atomics_a_mask_sub_3_2_3;	// @[generators/rocket-chip/src/main/scala/util/Misc.scala:209:26, :214:27, :215:{29,38}]
  wire             atomics_a_mask_sub_sub_size_4 = s2_req_size == 2'h2;	// @[generators/rocket-chip/src/main/scala/rocket/DCache.scala:337:19, generators/rocket-chip/src/main/scala/util/Misc.scala:209:26]
  wire             atomics_a_mask_sub_sub_0_1_4 = (&s2_req_size) | atomics_a_mask_sub_sub_size_4 & ~(s2_req_addr[2]);	// @[generators/rocket-chip/src/main/scala/rocket/DCache.scala:337:19, generators/rocket-chip/src/main/scala/util/Misc.scala:206:21, :209:26, :211:20, :215:{29,38}, generators/rocket-chip/src/main/scala/util/package.scala:164:13]
  wire             atomics_a_mask_sub_sub_1_1_4 = (&s2_req_size) | atomics_a_mask_sub_sub_size_4 & s2_req_addr[2];	// @[generators/rocket-chip/src/main/scala/rocket/DCache.scala:337:19, generators/rocket-chip/src/main/scala/util/Misc.scala:206:21, :209:26, :215:{29,38}, generators/rocket-chip/src/main/scala/util/package.scala:164:13]
  wire             atomics_a_mask_sub_size_4 = s2_req_size == 2'h1;	// @[generators/rocket-chip/src/main/scala/rocket/DCache.scala:337:19, generators/rocket-chip/src/main/scala/util/Misc.scala:209:26]
  wire             atomics_a_mask_sub_0_2_4 = ~(s2_req_addr[2]) & ~(s2_req_addr[1]);	// @[generators/rocket-chip/src/main/scala/rocket/DCache.scala:337:19, generators/rocket-chip/src/main/scala/util/Misc.scala:210:26, :211:20, :214:27, generators/rocket-chip/src/main/scala/util/package.scala:164:13]
  wire             atomics_a_mask_sub_0_1_4 = atomics_a_mask_sub_sub_0_1_4 | atomics_a_mask_sub_size_4 & atomics_a_mask_sub_0_2_4;	// @[generators/rocket-chip/src/main/scala/util/Misc.scala:209:26, :214:27, :215:{29,38}]
  wire             atomics_a_mask_sub_1_2_4 = ~(s2_req_addr[2]) & s2_req_addr[1];	// @[generators/rocket-chip/src/main/scala/rocket/DCache.scala:337:19, generators/rocket-chip/src/main/scala/util/Misc.scala:210:26, :211:20, :214:27, generators/rocket-chip/src/main/scala/util/package.scala:164:13]
  wire             atomics_a_mask_sub_1_1_4 = atomics_a_mask_sub_sub_0_1_4 | atomics_a_mask_sub_size_4 & atomics_a_mask_sub_1_2_4;	// @[generators/rocket-chip/src/main/scala/util/Misc.scala:209:26, :214:27, :215:{29,38}]
  wire             atomics_a_mask_sub_2_2_4 = s2_req_addr[2] & ~(s2_req_addr[1]);	// @[generators/rocket-chip/src/main/scala/rocket/DCache.scala:337:19, generators/rocket-chip/src/main/scala/util/Misc.scala:210:26, :211:20, :214:27, generators/rocket-chip/src/main/scala/util/package.scala:164:13]
  wire             atomics_a_mask_sub_2_1_4 = atomics_a_mask_sub_sub_1_1_4 | atomics_a_mask_sub_size_4 & atomics_a_mask_sub_2_2_4;	// @[generators/rocket-chip/src/main/scala/util/Misc.scala:209:26, :214:27, :215:{29,38}]
  wire             atomics_a_mask_sub_3_2_4 = s2_req_addr[2] & s2_req_addr[1];	// @[generators/rocket-chip/src/main/scala/rocket/DCache.scala:337:19, generators/rocket-chip/src/main/scala/util/Misc.scala:210:26, :214:27, generators/rocket-chip/src/main/scala/util/package.scala:164:13]
  wire             atomics_a_mask_sub_3_1_4 = atomics_a_mask_sub_sub_1_1_4 | atomics_a_mask_sub_size_4 & atomics_a_mask_sub_3_2_4;	// @[generators/rocket-chip/src/main/scala/util/Misc.scala:209:26, :214:27, :215:{29,38}]
  wire             atomics_a_mask_sub_sub_size_5 = s2_req_size == 2'h2;	// @[generators/rocket-chip/src/main/scala/rocket/DCache.scala:337:19, generators/rocket-chip/src/main/scala/util/Misc.scala:209:26]
  wire             atomics_a_mask_sub_sub_0_1_5 = (&s2_req_size) | atomics_a_mask_sub_sub_size_5 & ~(s2_req_addr[2]);	// @[generators/rocket-chip/src/main/scala/rocket/DCache.scala:337:19, generators/rocket-chip/src/main/scala/util/Misc.scala:206:21, :209:26, :211:20, :215:{29,38}, generators/rocket-chip/src/main/scala/util/package.scala:164:13]
  wire             atomics_a_mask_sub_sub_1_1_5 = (&s2_req_size) | atomics_a_mask_sub_sub_size_5 & s2_req_addr[2];	// @[generators/rocket-chip/src/main/scala/rocket/DCache.scala:337:19, generators/rocket-chip/src/main/scala/util/Misc.scala:206:21, :209:26, :215:{29,38}, generators/rocket-chip/src/main/scala/util/package.scala:164:13]
  wire             atomics_a_mask_sub_size_5 = s2_req_size == 2'h1;	// @[generators/rocket-chip/src/main/scala/rocket/DCache.scala:337:19, generators/rocket-chip/src/main/scala/util/Misc.scala:209:26]
  wire             atomics_a_mask_sub_0_2_5 = ~(s2_req_addr[2]) & ~(s2_req_addr[1]);	// @[generators/rocket-chip/src/main/scala/rocket/DCache.scala:337:19, generators/rocket-chip/src/main/scala/util/Misc.scala:210:26, :211:20, :214:27, generators/rocket-chip/src/main/scala/util/package.scala:164:13]
  wire             atomics_a_mask_sub_0_1_5 = atomics_a_mask_sub_sub_0_1_5 | atomics_a_mask_sub_size_5 & atomics_a_mask_sub_0_2_5;	// @[generators/rocket-chip/src/main/scala/util/Misc.scala:209:26, :214:27, :215:{29,38}]
  wire             atomics_a_mask_sub_1_2_5 = ~(s2_req_addr[2]) & s2_req_addr[1];	// @[generators/rocket-chip/src/main/scala/rocket/DCache.scala:337:19, generators/rocket-chip/src/main/scala/util/Misc.scala:210:26, :211:20, :214:27, generators/rocket-chip/src/main/scala/util/package.scala:164:13]
  wire             atomics_a_mask_sub_1_1_5 = atomics_a_mask_sub_sub_0_1_5 | atomics_a_mask_sub_size_5 & atomics_a_mask_sub_1_2_5;	// @[generators/rocket-chip/src/main/scala/util/Misc.scala:209:26, :214:27, :215:{29,38}]
  wire             atomics_a_mask_sub_2_2_5 = s2_req_addr[2] & ~(s2_req_addr[1]);	// @[generators/rocket-chip/src/main/scala/rocket/DCache.scala:337:19, generators/rocket-chip/src/main/scala/util/Misc.scala:210:26, :211:20, :214:27, generators/rocket-chip/src/main/scala/util/package.scala:164:13]
  wire             atomics_a_mask_sub_2_1_5 = atomics_a_mask_sub_sub_1_1_5 | atomics_a_mask_sub_size_5 & atomics_a_mask_sub_2_2_5;	// @[generators/rocket-chip/src/main/scala/util/Misc.scala:209:26, :214:27, :215:{29,38}]
  wire             atomics_a_mask_sub_3_2_5 = s2_req_addr[2] & s2_req_addr[1];	// @[generators/rocket-chip/src/main/scala/rocket/DCache.scala:337:19, generators/rocket-chip/src/main/scala/util/Misc.scala:210:26, :214:27, generators/rocket-chip/src/main/scala/util/package.scala:164:13]
  wire             atomics_a_mask_sub_3_1_5 = atomics_a_mask_sub_sub_1_1_5 | atomics_a_mask_sub_size_5 & atomics_a_mask_sub_3_2_5;	// @[generators/rocket-chip/src/main/scala/util/Misc.scala:209:26, :214:27, :215:{29,38}]
  wire             atomics_a_mask_sub_sub_size_6 = s2_req_size == 2'h2;	// @[generators/rocket-chip/src/main/scala/rocket/DCache.scala:337:19, generators/rocket-chip/src/main/scala/util/Misc.scala:209:26]
  wire             atomics_a_mask_sub_sub_0_1_6 = (&s2_req_size) | atomics_a_mask_sub_sub_size_6 & ~(s2_req_addr[2]);	// @[generators/rocket-chip/src/main/scala/rocket/DCache.scala:337:19, generators/rocket-chip/src/main/scala/util/Misc.scala:206:21, :209:26, :211:20, :215:{29,38}, generators/rocket-chip/src/main/scala/util/package.scala:164:13]
  wire             atomics_a_mask_sub_sub_1_1_6 = (&s2_req_size) | atomics_a_mask_sub_sub_size_6 & s2_req_addr[2];	// @[generators/rocket-chip/src/main/scala/rocket/DCache.scala:337:19, generators/rocket-chip/src/main/scala/util/Misc.scala:206:21, :209:26, :215:{29,38}, generators/rocket-chip/src/main/scala/util/package.scala:164:13]
  wire             atomics_a_mask_sub_size_6 = s2_req_size == 2'h1;	// @[generators/rocket-chip/src/main/scala/rocket/DCache.scala:337:19, generators/rocket-chip/src/main/scala/util/Misc.scala:209:26]
  wire             atomics_a_mask_sub_0_2_6 = ~(s2_req_addr[2]) & ~(s2_req_addr[1]);	// @[generators/rocket-chip/src/main/scala/rocket/DCache.scala:337:19, generators/rocket-chip/src/main/scala/util/Misc.scala:210:26, :211:20, :214:27, generators/rocket-chip/src/main/scala/util/package.scala:164:13]
  wire             atomics_a_mask_sub_0_1_6 = atomics_a_mask_sub_sub_0_1_6 | atomics_a_mask_sub_size_6 & atomics_a_mask_sub_0_2_6;	// @[generators/rocket-chip/src/main/scala/util/Misc.scala:209:26, :214:27, :215:{29,38}]
  wire             atomics_a_mask_sub_1_2_6 = ~(s2_req_addr[2]) & s2_req_addr[1];	// @[generators/rocket-chip/src/main/scala/rocket/DCache.scala:337:19, generators/rocket-chip/src/main/scala/util/Misc.scala:210:26, :211:20, :214:27, generators/rocket-chip/src/main/scala/util/package.scala:164:13]
  wire             atomics_a_mask_sub_1_1_6 = atomics_a_mask_sub_sub_0_1_6 | atomics_a_mask_sub_size_6 & atomics_a_mask_sub_1_2_6;	// @[generators/rocket-chip/src/main/scala/util/Misc.scala:209:26, :214:27, :215:{29,38}]
  wire             atomics_a_mask_sub_2_2_6 = s2_req_addr[2] & ~(s2_req_addr[1]);	// @[generators/rocket-chip/src/main/scala/rocket/DCache.scala:337:19, generators/rocket-chip/src/main/scala/util/Misc.scala:210:26, :211:20, :214:27, generators/rocket-chip/src/main/scala/util/package.scala:164:13]
  wire             atomics_a_mask_sub_2_1_6 = atomics_a_mask_sub_sub_1_1_6 | atomics_a_mask_sub_size_6 & atomics_a_mask_sub_2_2_6;	// @[generators/rocket-chip/src/main/scala/util/Misc.scala:209:26, :214:27, :215:{29,38}]
  wire             atomics_a_mask_sub_3_2_6 = s2_req_addr[2] & s2_req_addr[1];	// @[generators/rocket-chip/src/main/scala/rocket/DCache.scala:337:19, generators/rocket-chip/src/main/scala/util/Misc.scala:210:26, :214:27, generators/rocket-chip/src/main/scala/util/package.scala:164:13]
  wire             atomics_a_mask_sub_3_1_6 = atomics_a_mask_sub_sub_1_1_6 | atomics_a_mask_sub_size_6 & atomics_a_mask_sub_3_2_6;	// @[generators/rocket-chip/src/main/scala/util/Misc.scala:209:26, :214:27, :215:{29,38}]
  wire             atomics_a_mask_sub_sub_size_7 = s2_req_size == 2'h2;	// @[generators/rocket-chip/src/main/scala/rocket/DCache.scala:337:19, generators/rocket-chip/src/main/scala/util/Misc.scala:209:26]
  wire             atomics_a_mask_sub_sub_0_1_7 = (&s2_req_size) | atomics_a_mask_sub_sub_size_7 & ~(s2_req_addr[2]);	// @[generators/rocket-chip/src/main/scala/rocket/DCache.scala:337:19, generators/rocket-chip/src/main/scala/util/Misc.scala:206:21, :209:26, :211:20, :215:{29,38}, generators/rocket-chip/src/main/scala/util/package.scala:164:13]
  wire             atomics_a_mask_sub_sub_1_1_7 = (&s2_req_size) | atomics_a_mask_sub_sub_size_7 & s2_req_addr[2];	// @[generators/rocket-chip/src/main/scala/rocket/DCache.scala:337:19, generators/rocket-chip/src/main/scala/util/Misc.scala:206:21, :209:26, :215:{29,38}, generators/rocket-chip/src/main/scala/util/package.scala:164:13]
  wire             atomics_a_mask_sub_size_7 = s2_req_size == 2'h1;	// @[generators/rocket-chip/src/main/scala/rocket/DCache.scala:337:19, generators/rocket-chip/src/main/scala/util/Misc.scala:209:26]
  wire             atomics_a_mask_sub_0_2_7 = ~(s2_req_addr[2]) & ~(s2_req_addr[1]);	// @[generators/rocket-chip/src/main/scala/rocket/DCache.scala:337:19, generators/rocket-chip/src/main/scala/util/Misc.scala:210:26, :211:20, :214:27, generators/rocket-chip/src/main/scala/util/package.scala:164:13]
  wire             atomics_a_mask_sub_0_1_7 = atomics_a_mask_sub_sub_0_1_7 | atomics_a_mask_sub_size_7 & atomics_a_mask_sub_0_2_7;	// @[generators/rocket-chip/src/main/scala/util/Misc.scala:209:26, :214:27, :215:{29,38}]
  wire             atomics_a_mask_sub_1_2_7 = ~(s2_req_addr[2]) & s2_req_addr[1];	// @[generators/rocket-chip/src/main/scala/rocket/DCache.scala:337:19, generators/rocket-chip/src/main/scala/util/Misc.scala:210:26, :211:20, :214:27, generators/rocket-chip/src/main/scala/util/package.scala:164:13]
  wire             atomics_a_mask_sub_1_1_7 = atomics_a_mask_sub_sub_0_1_7 | atomics_a_mask_sub_size_7 & atomics_a_mask_sub_1_2_7;	// @[generators/rocket-chip/src/main/scala/util/Misc.scala:209:26, :214:27, :215:{29,38}]
  wire             atomics_a_mask_sub_2_2_7 = s2_req_addr[2] & ~(s2_req_addr[1]);	// @[generators/rocket-chip/src/main/scala/rocket/DCache.scala:337:19, generators/rocket-chip/src/main/scala/util/Misc.scala:210:26, :211:20, :214:27, generators/rocket-chip/src/main/scala/util/package.scala:164:13]
  wire             atomics_a_mask_sub_2_1_7 = atomics_a_mask_sub_sub_1_1_7 | atomics_a_mask_sub_size_7 & atomics_a_mask_sub_2_2_7;	// @[generators/rocket-chip/src/main/scala/util/Misc.scala:209:26, :214:27, :215:{29,38}]
  wire             atomics_a_mask_sub_3_2_7 = s2_req_addr[2] & s2_req_addr[1];	// @[generators/rocket-chip/src/main/scala/rocket/DCache.scala:337:19, generators/rocket-chip/src/main/scala/util/Misc.scala:210:26, :214:27, generators/rocket-chip/src/main/scala/util/package.scala:164:13]
  wire             atomics_a_mask_sub_3_1_7 = atomics_a_mask_sub_sub_1_1_7 | atomics_a_mask_sub_size_7 & atomics_a_mask_sub_3_2_7;	// @[generators/rocket-chip/src/main/scala/util/Misc.scala:209:26, :214:27, :215:{29,38}]
  wire             atomics_a_mask_sub_sub_size_8 = s2_req_size == 2'h2;	// @[generators/rocket-chip/src/main/scala/rocket/DCache.scala:337:19, generators/rocket-chip/src/main/scala/util/Misc.scala:209:26]
  wire             atomics_a_mask_sub_sub_0_1_8 = (&s2_req_size) | atomics_a_mask_sub_sub_size_8 & ~(s2_req_addr[2]);	// @[generators/rocket-chip/src/main/scala/rocket/DCache.scala:337:19, generators/rocket-chip/src/main/scala/util/Misc.scala:206:21, :209:26, :211:20, :215:{29,38}, generators/rocket-chip/src/main/scala/util/package.scala:164:13]
  wire             atomics_a_mask_sub_sub_1_1_8 = (&s2_req_size) | atomics_a_mask_sub_sub_size_8 & s2_req_addr[2];	// @[generators/rocket-chip/src/main/scala/rocket/DCache.scala:337:19, generators/rocket-chip/src/main/scala/util/Misc.scala:206:21, :209:26, :215:{29,38}, generators/rocket-chip/src/main/scala/util/package.scala:164:13]
  wire             atomics_a_mask_sub_size_8 = s2_req_size == 2'h1;	// @[generators/rocket-chip/src/main/scala/rocket/DCache.scala:337:19, generators/rocket-chip/src/main/scala/util/Misc.scala:209:26]
  wire             atomics_a_mask_sub_0_2_8 = ~(s2_req_addr[2]) & ~(s2_req_addr[1]);	// @[generators/rocket-chip/src/main/scala/rocket/DCache.scala:337:19, generators/rocket-chip/src/main/scala/util/Misc.scala:210:26, :211:20, :214:27, generators/rocket-chip/src/main/scala/util/package.scala:164:13]
  wire             atomics_a_mask_sub_0_1_8 = atomics_a_mask_sub_sub_0_1_8 | atomics_a_mask_sub_size_8 & atomics_a_mask_sub_0_2_8;	// @[generators/rocket-chip/src/main/scala/util/Misc.scala:209:26, :214:27, :215:{29,38}]
  wire             atomics_a_mask_sub_1_2_8 = ~(s2_req_addr[2]) & s2_req_addr[1];	// @[generators/rocket-chip/src/main/scala/rocket/DCache.scala:337:19, generators/rocket-chip/src/main/scala/util/Misc.scala:210:26, :211:20, :214:27, generators/rocket-chip/src/main/scala/util/package.scala:164:13]
  wire             atomics_a_mask_sub_1_1_8 = atomics_a_mask_sub_sub_0_1_8 | atomics_a_mask_sub_size_8 & atomics_a_mask_sub_1_2_8;	// @[generators/rocket-chip/src/main/scala/util/Misc.scala:209:26, :214:27, :215:{29,38}]
  wire             atomics_a_mask_sub_2_2_8 = s2_req_addr[2] & ~(s2_req_addr[1]);	// @[generators/rocket-chip/src/main/scala/rocket/DCache.scala:337:19, generators/rocket-chip/src/main/scala/util/Misc.scala:210:26, :211:20, :214:27, generators/rocket-chip/src/main/scala/util/package.scala:164:13]
  wire             atomics_a_mask_sub_2_1_8 = atomics_a_mask_sub_sub_1_1_8 | atomics_a_mask_sub_size_8 & atomics_a_mask_sub_2_2_8;	// @[generators/rocket-chip/src/main/scala/util/Misc.scala:209:26, :214:27, :215:{29,38}]
  wire             atomics_a_mask_sub_3_2_8 = s2_req_addr[2] & s2_req_addr[1];	// @[generators/rocket-chip/src/main/scala/rocket/DCache.scala:337:19, generators/rocket-chip/src/main/scala/util/Misc.scala:210:26, :214:27, generators/rocket-chip/src/main/scala/util/package.scala:164:13]
  wire             atomics_a_mask_sub_3_1_8 = atomics_a_mask_sub_sub_1_1_8 | atomics_a_mask_sub_size_8 & atomics_a_mask_sub_3_2_8;	// @[generators/rocket-chip/src/main/scala/util/Misc.scala:209:26, :214:27, :215:{29,38}]
  wire [7:0]       atomics_mask =
    _io_cpu_store_pending_T_16
      ? {atomics_a_mask_sub_3_1_8 | atomics_a_mask_sub_3_2_8 & s2_req_addr[0], atomics_a_mask_sub_3_1_8 | atomics_a_mask_sub_3_2_8 & ~(s2_req_addr[0]), atomics_a_mask_sub_2_1_8 | atomics_a_mask_sub_2_2_8 & s2_req_addr[0], atomics_a_mask_sub_2_1_8 | atomics_a_mask_sub_2_2_8 & ~(s2_req_addr[0]), atomics_a_mask_sub_1_1_8 | atomics_a_mask_sub_1_2_8 & s2_req_addr[0], atomics_a_mask_sub_1_1_8 | atomics_a_mask_sub_1_2_8 & ~(s2_req_addr[0]), atomics_a_mask_sub_0_1_8 | atomics_a_mask_sub_0_2_8 & s2_req_addr[0], atomics_a_mask_sub_0_1_8 | atomics_a_mask_sub_0_2_8 & ~(s2_req_addr[0])}
      : _io_cpu_store_pending_T_15
          ? {atomics_a_mask_sub_3_1_7 | atomics_a_mask_sub_3_2_7 & s2_req_addr[0], atomics_a_mask_sub_3_1_7 | atomics_a_mask_sub_3_2_7 & ~(s2_req_addr[0]), atomics_a_mask_sub_2_1_7 | atomics_a_mask_sub_2_2_7 & s2_req_addr[0], atomics_a_mask_sub_2_1_7 | atomics_a_mask_sub_2_2_7 & ~(s2_req_addr[0]), atomics_a_mask_sub_1_1_7 | atomics_a_mask_sub_1_2_7 & s2_req_addr[0], atomics_a_mask_sub_1_1_7 | atomics_a_mask_sub_1_2_7 & ~(s2_req_addr[0]), atomics_a_mask_sub_0_1_7 | atomics_a_mask_sub_0_2_7 & s2_req_addr[0], atomics_a_mask_sub_0_1_7 | atomics_a_mask_sub_0_2_7 & ~(s2_req_addr[0])}
          : _io_cpu_store_pending_T_14
              ? {atomics_a_mask_sub_3_1_6 | atomics_a_mask_sub_3_2_6 & s2_req_addr[0], atomics_a_mask_sub_3_1_6 | atomics_a_mask_sub_3_2_6 & ~(s2_req_addr[0]), atomics_a_mask_sub_2_1_6 | atomics_a_mask_sub_2_2_6 & s2_req_addr[0], atomics_a_mask_sub_2_1_6 | atomics_a_mask_sub_2_2_6 & ~(s2_req_addr[0]), atomics_a_mask_sub_1_1_6 | atomics_a_mask_sub_1_2_6 & s2_req_addr[0], atomics_a_mask_sub_1_1_6 | atomics_a_mask_sub_1_2_6 & ~(s2_req_addr[0]), atomics_a_mask_sub_0_1_6 | atomics_a_mask_sub_0_2_6 & s2_req_addr[0], atomics_a_mask_sub_0_1_6 | atomics_a_mask_sub_0_2_6 & ~(s2_req_addr[0])}
              : _io_cpu_store_pending_T_13
                  ? {atomics_a_mask_sub_3_1_5 | atomics_a_mask_sub_3_2_5 & s2_req_addr[0], atomics_a_mask_sub_3_1_5 | atomics_a_mask_sub_3_2_5 & ~(s2_req_addr[0]), atomics_a_mask_sub_2_1_5 | atomics_a_mask_sub_2_2_5 & s2_req_addr[0], atomics_a_mask_sub_2_1_5 | atomics_a_mask_sub_2_2_5 & ~(s2_req_addr[0]), atomics_a_mask_sub_1_1_5 | atomics_a_mask_sub_1_2_5 & s2_req_addr[0], atomics_a_mask_sub_1_1_5 | atomics_a_mask_sub_1_2_5 & ~(s2_req_addr[0]), atomics_a_mask_sub_0_1_5 | atomics_a_mask_sub_0_2_5 & s2_req_addr[0], atomics_a_mask_sub_0_1_5 | atomics_a_mask_sub_0_2_5 & ~(s2_req_addr[0])}
                  : _io_cpu_store_pending_T_12
                      ? {atomics_a_mask_sub_3_1_4 | atomics_a_mask_sub_3_2_4 & s2_req_addr[0], atomics_a_mask_sub_3_1_4 | atomics_a_mask_sub_3_2_4 & ~(s2_req_addr[0]), atomics_a_mask_sub_2_1_4 | atomics_a_mask_sub_2_2_4 & s2_req_addr[0], atomics_a_mask_sub_2_1_4 | atomics_a_mask_sub_2_2_4 & ~(s2_req_addr[0]), atomics_a_mask_sub_1_1_4 | atomics_a_mask_sub_1_2_4 & s2_req_addr[0], atomics_a_mask_sub_1_1_4 | atomics_a_mask_sub_1_2_4 & ~(s2_req_addr[0]), atomics_a_mask_sub_0_1_4 | atomics_a_mask_sub_0_2_4 & s2_req_addr[0], atomics_a_mask_sub_0_1_4 | atomics_a_mask_sub_0_2_4 & ~(s2_req_addr[0])}
                      : _io_cpu_store_pending_T_8
                          ? {atomics_a_mask_sub_3_1_3 | atomics_a_mask_sub_3_2_3 & s2_req_addr[0], atomics_a_mask_sub_3_1_3 | atomics_a_mask_sub_3_2_3 & ~(s2_req_addr[0]), atomics_a_mask_sub_2_1_3 | atomics_a_mask_sub_2_2_3 & s2_req_addr[0], atomics_a_mask_sub_2_1_3 | atomics_a_mask_sub_2_2_3 & ~(s2_req_addr[0]), atomics_a_mask_sub_1_1_3 | atomics_a_mask_sub_1_2_3 & s2_req_addr[0], atomics_a_mask_sub_1_1_3 | atomics_a_mask_sub_1_2_3 & ~(s2_req_addr[0]), atomics_a_mask_sub_0_1_3 | atomics_a_mask_sub_0_2_3 & s2_req_addr[0], atomics_a_mask_sub_0_1_3 | atomics_a_mask_sub_0_2_3 & ~(s2_req_addr[0])}
                          : _io_cpu_store_pending_T_7 ? {atomics_a_mask_sub_3_1_2 | atomics_a_mask_sub_3_2_2 & s2_req_addr[0], atomics_a_mask_sub_3_1_2 | atomics_a_mask_sub_3_2_2 & ~(s2_req_addr[0]), atomics_a_mask_sub_2_1_2 | atomics_a_mask_sub_2_2_2 & s2_req_addr[0], atomics_a_mask_sub_2_1_2 | atomics_a_mask_sub_2_2_2 & ~(s2_req_addr[0]), atomics_a_mask_sub_1_1_2 | atomics_a_mask_sub_1_2_2 & s2_req_addr[0], atomics_a_mask_sub_1_1_2 | atomics_a_mask_sub_1_2_2 & ~(s2_req_addr[0]), atomics_a_mask_sub_0_1_2 | atomics_a_mask_sub_0_2_2 & s2_req_addr[0], atomics_a_mask_sub_0_1_2 | atomics_a_mask_sub_0_2_2 & ~(s2_req_addr[0])} : _io_cpu_store_pending_T_6 ? {atomics_a_mask_sub_3_1_1 | atomics_a_mask_sub_3_2_1 & s2_req_addr[0], atomics_a_mask_sub_3_1_1 | atomics_a_mask_sub_3_2_1 & ~(s2_req_addr[0]), atomics_a_mask_sub_2_1_1 | atomics_a_mask_sub_2_2_1 & s2_req_addr[0], atomics_a_mask_sub_2_1_1 | atomics_a_mask_sub_2_2_1 & ~(s2_req_addr[0]), atomics_a_mask_sub_1_1_1 | atomics_a_mask_sub_1_2_1 & s2_req_addr[0], atomics_a_mask_sub_1_1_1 | atomics_a_mask_sub_1_2_1 & ~(s2_req_addr[0]), atomics_a_mask_sub_0_1_1 | atomics_a_mask_sub_0_2_1 & s2_req_addr[0], atomics_a_mask_sub_0_1_1 | atomics_a_mask_sub_0_2_1 & ~(s2_req_addr[0])} : _io_cpu_store_pending_T_5 ? {atomics_a_mask_sub_3_1 | atomics_a_mask_sub_3_2 & s2_req_addr[0], atomics_a_mask_sub_3_1 | atomics_a_mask_sub_3_2 & ~(s2_req_addr[0]), atomics_a_mask_sub_2_1 | atomics_a_mask_sub_2_2 & s2_req_addr[0], atomics_a_mask_sub_2_1 | atomics_a_mask_sub_2_2 & ~(s2_req_addr[0]), atomics_a_mask_sub_1_1 | atomics_a_mask_sub_1_2 & s2_req_addr[0], atomics_a_mask_sub_1_1 | atomics_a_mask_sub_1_2 & ~(s2_req_addr[0]), atomics_a_mask_sub_0_1 | atomics_a_mask_sub_0_2 & s2_req_addr[0], atomics_a_mask_sub_0_1 | atomics_a_mask_sub_0_2 & ~(s2_req_addr[0])} : 8'h0;	// @[generators/rocket-chip/src/main/scala/rocket/DCache.scala:337:19, :585:81, generators/rocket-chip/src/main/scala/util/Misc.scala:210:26, :211:20, :214:27, :215:29, :222:10, generators/rocket-chip/src/main/scala/util/package.scala:17:47]
  wire             tl_out_a_valid = s2_valid_uncached_pending | s2_valid_cached_miss & ~s2_victim_dirty;	// @[generators/rocket-chip/src/main/scala/rocket/DCache.scala:423:60, :428:{49,64}, :602:32, :604:127, :605:91, generators/rocket-chip/src/main/scala/util/Misc.scala:38:9]
  wire             _GEN_4 = s2_pma_cacheable | ~(~s2_write | _io_cpu_store_pending_T_1 | ~s2_read | _io_cpu_store_pending_T_16 | _io_cpu_store_pending_T_15 | _io_cpu_store_pending_T_14 | _io_cpu_store_pending_T_13 | _io_cpu_store_pending_T_12 | _io_cpu_store_pending_T_8 | _io_cpu_store_pending_T_7 | _io_cpu_store_pending_T_6 | _io_cpu_store_pending_T_5);	// @[generators/rocket-chip/src/main/scala/rocket/Consts.scala:87:44, :89:68, :90:{42,49,59,76}, generators/rocket-chip/src/main/scala/rocket/DCache.scala:341:19, :585:81, :606:23, :607:8, :608:8, :609:8, generators/rocket-chip/src/main/scala/util/package.scala:17:47, :82:59]
  wire             _io_errors_bus_valid_T = ~_GEN_0 & auto_out_d_valid;	// @[generators/rocket-chip/src/main/scala/rocket/DCache.scala:669:18, :720:51, :722:20, :750:{31,68}, :751:22, src/main/scala/chisel3/util/Decoupled.scala:51:35]
  wire [26:0]      _r_beats1_decode_T = 27'hFFF << auto_out_d_bits_size;	// @[generators/rocket-chip/src/main/scala/util/package.scala:244:71]
  wire [8:0]       r_beats1 = auto_out_d_bits_opcode[0] ? ~(_r_beats1_decode_T[11:3]) : 9'h0;	// @[generators/rocket-chip/src/main/scala/tilelink/Edges.scala:106:36, :221:14, generators/rocket-chip/src/main/scala/util/package.scala:244:{46,71,76}]
  reg  [8:0]       r_counter;	// @[generators/rocket-chip/src/main/scala/tilelink/Edges.scala:229:27]
  wire             d_last = r_counter == 9'h1 | r_beats1 == 9'h0;	// @[generators/rocket-chip/src/main/scala/tilelink/Edges.scala:221:14, :229:27, :232:{25,33,43}]
  wire [1:0]       _data_andMatrixOutputs_T = {auto_out_d_bits_opcode[0], ~(auto_out_d_bits_opcode[1])};	// @[generators/rocket-chip/src/main/scala/rocket/DCache.scala:654:26, src/main/scala/chisel3/util/pla.scala:78:21, :90:45, :98:53]
  wire             _GEN_5 = _io_errors_bus_valid_T & (&_data_andMatrixOutputs_T);	// @[generators/rocket-chip/src/main/scala/rocket/DCache.scala:321:32, :672:24, :673:26, src/main/scala/chisel3/util/Decoupled.scala:51:35, src/main/scala/chisel3/util/pla.scala:98:{53,70}]
  wire [1:0]       s1_data_way = _GEN_5 ? 2'h2 : 2'h1;	// @[generators/rocket-chip/src/main/scala/rocket/DCache.scala:321:32, :672:24, :673:26]
  reg              blockUncachedGrant;	// @[generators/rocket-chip/src/main/scala/rocket/DCache.scala:748:33]
  assign _GEN_0 = (&_data_andMatrixOutputs_T) & (blockUncachedGrant | s1_valid);	// @[generators/rocket-chip/src/main/scala/rocket/DCache.scala:180:25, :748:33, :750:{31,54}, src/main/scala/chisel3/util/pla.scala:98:{53,70}]
  wire             io_cpu_req_ready_0 = _GEN_0 ? ~(auto_out_d_valid | metaArb_io_in_2_valid | _GEN_2) & _io_cpu_req_ready_T_4 : ~(metaArb_io_in_2_valid | _GEN_2) & _io_cpu_req_ready_T_4;	// @[generators/rocket-chip/src/main/scala/rocket/DCache.scala:231:{20,73}, :256:{33,45,64}, :265:{34,53}, :273:{79,98}, :444:62, :750:{31,68}, :753:29, :754:26]
  assign _GEN = _GEN_0 & auto_out_d_valid;	// @[generators/rocket-chip/src/main/scala/rocket/DCache.scala:719:26, :750:{31,68}, :753:29, :755:32]
  reg              io_cpu_s2_xcpt_REG;	// @[generators/rocket-chip/src/main/scala/rocket/DCache.scala:931:32]
  assign io_cpu_s2_xcpt_pf_ld_0 = io_cpu_s2_xcpt_REG & s2_tlb_xcpt_pf_ld;	// @[generators/rocket-chip/src/main/scala/rocket/DCache.scala:340:24, :931:{24,32}]
  assign io_cpu_s2_xcpt_pf_st_0 = io_cpu_s2_xcpt_REG & s2_tlb_xcpt_pf_st;	// @[generators/rocket-chip/src/main/scala/rocket/DCache.scala:340:24, :931:{24,32}]
  assign io_cpu_s2_xcpt_ae_ld_0 = io_cpu_s2_xcpt_REG & s2_tlb_xcpt_ae_ld;	// @[generators/rocket-chip/src/main/scala/rocket/DCache.scala:340:24, :931:{24,32}]
  assign io_cpu_s2_xcpt_ae_st_0 = io_cpu_s2_xcpt_REG & s2_tlb_xcpt_ae_st;	// @[generators/rocket-chip/src/main/scala/rocket/DCache.scala:340:24, :931:{24,32}]
  assign io_cpu_s2_xcpt_ma_ld_0 = io_cpu_s2_xcpt_REG & s2_tlb_xcpt_ma_ld;	// @[generators/rocket-chip/src/main/scala/rocket/DCache.scala:340:24, :931:{24,32}]
  assign io_cpu_s2_xcpt_ma_st_0 = io_cpu_s2_xcpt_REG & s2_tlb_xcpt_ma_st;	// @[generators/rocket-chip/src/main/scala/rocket/DCache.scala:340:24, :931:{24,32}]
  reg              doUncachedResp;	// @[generators/rocket-chip/src/main/scala/rocket/DCache.scala:946:31]
  wire             io_cpu_replay_next_0 = _io_errors_bus_valid_T & (&_data_andMatrixOutputs_T);	// @[generators/rocket-chip/src/main/scala/rocket/DCache.scala:948:39, src/main/scala/chisel3/util/Decoupled.scala:51:35, src/main/scala/chisel3/util/pla.scala:98:{53,70}]
  `ifndef SYNTHESIS	// @[generators/rocket-chip/src/main/scala/rocket/DCache.scala:1184:11]
    always @(posedge clock) begin	// @[generators/rocket-chip/src/main/scala/rocket/DCache.scala:1184:11]
      if (~reset & ~(~(_pstore_drain_opportunistic_T | _pstore_drain_opportunistic_T_1 | _pstore_drain_opportunistic_T_2 | _pstore_drain_opportunistic_T_28 | _pstore_drain_opportunistic_T_30 | _pstore_drain_opportunistic_T_31 | _pstore_drain_opportunistic_T_32 | _pstore_drain_opportunistic_T_33 | _pstore_drain_opportunistic_T_37 | _pstore_drain_opportunistic_T_38 | _pstore_drain_opportunistic_T_39 | _pstore_drain_opportunistic_T_40 | _pstore_drain_opportunistic_T_41 | (_pstore_drain_opportunistic_T_25 | _pstore_drain_opportunistic_T_50 | _pstore_drain_opportunistic_T_28 | _pstore_drain_opportunistic_T_30 | _pstore_drain_opportunistic_T_31 | _pstore_drain_opportunistic_T_32 | _pstore_drain_opportunistic_T_33 | _pstore_drain_opportunistic_T_37 | _pstore_drain_opportunistic_T_38 | _pstore_drain_opportunistic_T_39 | _pstore_drain_opportunistic_T_40 | _pstore_drain_opportunistic_T_41) & _pstore_drain_opportunistic_T_50) | ~_dataArb_io_in_3_valid_res_T_2)) begin	// @[generators/rocket-chip/src/main/scala/rocket/Consts.scala:87:44, :89:68, :90:{42,49,59,76}, generators/rocket-chip/src/main/scala/rocket/DCache.scala:1183:15, :1184:{11,12,28}, :1188:21, :1189:23, generators/rocket-chip/src/main/scala/util/package.scala:17:47, :82:59]
        if (`ASSERT_VERBOSE_COND_)	// @[generators/rocket-chip/src/main/scala/rocket/DCache.scala:1184:11]
          $error("Assertion failed\n    at DCache.scala:1184 assert(!needsRead(req) || res)\n");	// @[generators/rocket-chip/src/main/scala/rocket/DCache.scala:1184:11]
        if (`STOP_COND_)	// @[generators/rocket-chip/src/main/scala/rocket/DCache.scala:1184:11]
          $fatal;	// @[generators/rocket-chip/src/main/scala/rocket/DCache.scala:1184:11]
      end
      if (~reset & ~(~(s1_valid_masked & _io_cpu_perf_canAcceptLoadThenLoad_T_51) | (&(s1_mask_xwr | ~io_cpu_s1_data_mask)))) begin	// @[generators/rocket-chip/src/main/scala/rocket/AMOALU.scala:22:16, generators/rocket-chip/src/main/scala/rocket/Consts.scala:90:49, generators/rocket-chip/src/main/scala/rocket/DCache.scala:184:34, :327:{9,10,28,53,69,71,93}]
        if (`ASSERT_VERBOSE_COND_)	// @[generators/rocket-chip/src/main/scala/rocket/DCache.scala:327:9]
          $error("Assertion failed\n    at DCache.scala:327 assert(!(s1_valid_masked && s1_req.cmd === M_PWR) || (s1_mask_xwr | ~io.cpu.s1_data.mask).andR)\n");	// @[generators/rocket-chip/src/main/scala/rocket/DCache.scala:327:9]
        if (`STOP_COND_)	// @[generators/rocket-chip/src/main/scala/rocket/DCache.scala:327:9]
          $fatal;	// @[generators/rocket-chip/src/main/scala/rocket/DCache.scala:327:9]
      end
      if (~reset & ~(~(_pstore_drain_opportunistic_T | _pstore_drain_opportunistic_T_1 | _pstore_drain_opportunistic_T_2 | _pstore_drain_opportunistic_T_28 | _pstore_drain_opportunistic_T_30 | _pstore_drain_opportunistic_T_31 | _pstore_drain_opportunistic_T_32 | _pstore_drain_opportunistic_T_33 | _pstore_drain_opportunistic_T_37 | _pstore_drain_opportunistic_T_38 | _pstore_drain_opportunistic_T_39 | _pstore_drain_opportunistic_T_40 | _pstore_drain_opportunistic_T_41 | (_pstore_drain_opportunistic_T_25 | _pstore_drain_opportunistic_T_50 | _pstore_drain_opportunistic_T_28 | _pstore_drain_opportunistic_T_30 | _pstore_drain_opportunistic_T_31 | _pstore_drain_opportunistic_T_32 | _pstore_drain_opportunistic_T_33 | _pstore_drain_opportunistic_T_37 | _pstore_drain_opportunistic_T_38 | _pstore_drain_opportunistic_T_39 | _pstore_drain_opportunistic_T_40 | _pstore_drain_opportunistic_T_41) & _pstore_drain_opportunistic_T_50) | ~_pstore_drain_opportunistic_res_T_2)) begin	// @[generators/rocket-chip/src/main/scala/rocket/Consts.scala:87:44, :89:68, :90:{42,49,59,76}, generators/rocket-chip/src/main/scala/rocket/DCache.scala:1183:15, :1184:{11,12,28}, :1188:21, :1189:23, generators/rocket-chip/src/main/scala/util/package.scala:17:47, :82:59]
        if (`ASSERT_VERBOSE_COND_)	// @[generators/rocket-chip/src/main/scala/rocket/DCache.scala:1184:11]
          $error("Assertion failed\n    at DCache.scala:1184 assert(!needsRead(req) || res)\n");	// @[generators/rocket-chip/src/main/scala/rocket/DCache.scala:1184:11]
        if (`STOP_COND_)	// @[generators/rocket-chip/src/main/scala/rocket/DCache.scala:1184:11]
          $fatal;	// @[generators/rocket-chip/src/main/scala/rocket/DCache.scala:1184:11]
      end
      if (~reset & ~(pstore1_rmw | (_dataArb_io_in_0_valid_T_4 | pstore1_held) == pstore1_valid)) begin	// @[generators/rocket-chip/src/main/scala/rocket/DCache.scala:327:9, :496:44, :502:29, :504:{72,96}, :505:38, :508:{9,22,63}]
        if (`ASSERT_VERBOSE_COND_)	// @[generators/rocket-chip/src/main/scala/rocket/DCache.scala:508:9]
          $error("Assertion failed\n    at DCache.scala:508 assert(pstore1_rmw || pstore1_valid_not_rmw(io.cpu.s2_kill) === pstore1_valid)\n");	// @[generators/rocket-chip/src/main/scala/rocket/DCache.scala:508:9]
        if (`STOP_COND_)	// @[generators/rocket-chip/src/main/scala/rocket/DCache.scala:508:9]
          $fatal;	// @[generators/rocket-chip/src/main/scala/rocket/DCache.scala:508:9]
      end
      if (~reset & ~(~auto_out_d_valid | auto_out_d_bits_opcode == 3'h1 | auto_out_d_bits_opcode == 3'h0 | auto_out_d_bits_opcode == 3'h2)) begin	// @[generators/rocket-chip/src/main/scala/rocket/DCache.scala:327:9, :652:{13,14,30}, generators/rocket-chip/src/main/scala/util/package.scala:17:47, :82:59]
        if (`ASSERT_VERBOSE_COND_)	// @[generators/rocket-chip/src/main/scala/rocket/DCache.scala:652:13]
          $error("Assertion failed\n    at DCache.scala:652 assert(!tl_out.d.valid || whole_opc.isOneOf(uncachedGrantOpcodes))\n");	// @[generators/rocket-chip/src/main/scala/rocket/DCache.scala:652:13]
        if (`STOP_COND_)	// @[generators/rocket-chip/src/main/scala/rocket/DCache.scala:652:13]
          $fatal;	// @[generators/rocket-chip/src/main/scala/rocket/DCache.scala:652:13]
      end
      if (_io_errors_bus_valid_T & d_last & ~reset & ~uncachedInFlight_0) begin	// @[generators/rocket-chip/src/main/scala/rocket/DCache.scala:234:33, :327:9, :684:28, :685:17, generators/rocket-chip/src/main/scala/tilelink/Edges.scala:232:33, src/main/scala/chisel3/util/Decoupled.scala:51:35]
        if (`ASSERT_VERBOSE_COND_)	// @[generators/rocket-chip/src/main/scala/rocket/DCache.scala:685:17]
          $error("Assertion failed: An AccessAck was unexpected by the dcache.\n    at DCache.scala:685 assert(f, \"An AccessAck was unexpected by the dcache.\") // TODO must handle Ack coming back on same cycle!\n");	// @[generators/rocket-chip/src/main/scala/rocket/DCache.scala:685:17]
        if (`STOP_COND_)	// @[generators/rocket-chip/src/main/scala/rocket/DCache.scala:685:17]
          $fatal;	// @[generators/rocket-chip/src/main/scala/rocket/DCache.scala:685:17]
      end
      if (~reset & s2_valid_masked & (_metaArb_io_in_3_bits_data_c_cat_T_48 | _io_cpu_store_pending_T_3)) begin	// @[generators/rocket-chip/src/main/scala/rocket/DCache.scala:327:9, :335:42, :934:{11,30}, generators/rocket-chip/src/main/scala/util/package.scala:17:47, :82:59]
        if (`ASSERT_VERBOSE_COND_)	// @[generators/rocket-chip/src/main/scala/rocket/DCache.scala:934:11]
          $error("Assertion failed\n    at DCache.scala:934 assert(!(s2_valid_masked && s2_req.cmd.isOneOf(M_XLR, M_XSC)))\n");	// @[generators/rocket-chip/src/main/scala/rocket/DCache.scala:934:11]
        if (`STOP_COND_)	// @[generators/rocket-chip/src/main/scala/rocket/DCache.scala:934:11]
          $fatal;	// @[generators/rocket-chip/src/main/scala/rocket/DCache.scala:934:11]
      end
      if (doUncachedResp & ~reset & s2_valid_hit_pre_data_ecc_and_waw) begin	// @[generators/rocket-chip/src/main/scala/rocket/DCache.scala:327:9, :395:89, :416:89, :946:31, :950:11]
        if (`ASSERT_VERBOSE_COND_)	// @[generators/rocket-chip/src/main/scala/rocket/DCache.scala:950:11]
          $error("Assertion failed\n    at DCache.scala:950 assert(!s2_valid_hit)\n");	// @[generators/rocket-chip/src/main/scala/rocket/DCache.scala:950:11]
        if (`STOP_COND_)	// @[generators/rocket-chip/src/main/scala/rocket/DCache.scala:950:11]
          $fatal;	// @[generators/rocket-chip/src/main/scala/rocket/DCache.scala:950:11]
      end
    end // always @(posedge)
  `endif // not def SYNTHESIS
  wire [31:0]      s2_data_word = s2_data_r | s2_data_r_1;	// @[generators/rocket-chip/src/main/scala/rocket/DCache.scala:377:18, :968:106]
  wire [15:0]      io_cpu_resp_bits_data_zeroed = s2_req_addr[1] ? s2_data_word[31:16] : s2_data_word[15:0];	// @[generators/rocket-chip/src/main/scala/rocket/AMOALU.scala:42:{24,37,55}, generators/rocket-chip/src/main/scala/rocket/DCache.scala:337:19, :968:106, generators/rocket-chip/src/main/scala/util/Misc.scala:210:26]
  wire [7:0]       io_cpu_resp_bits_data_zeroed_1 = s2_req_addr[0] ? io_cpu_resp_bits_data_zeroed[15:8] : io_cpu_resp_bits_data_zeroed[7:0];	// @[generators/rocket-chip/src/main/scala/rocket/AMOALU.scala:42:{24,37,55}, generators/rocket-chip/src/main/scala/rocket/DCache.scala:337:19, generators/rocket-chip/src/main/scala/util/Misc.scala:210:26]
  wire [31:0]      pstore1_storegen_data_mask = {{8{pstore1_mask[3]}}, {8{pstore1_mask[2]}}, {8{pstore1_mask[1]}}, {8{pstore1_mask[0]}}};	// @[generators/rocket-chip/src/main/scala/rocket/DCache.scala:494:31, :988:33]
  wire [31:0]      pstore1_storegen_data = _amoalus_0_io_out_unmasked & pstore1_storegen_data_mask | (s2_data_r | s2_data_r_1) & ~pstore1_storegen_data_mask;	// @[generators/rocket-chip/src/main/scala/rocket/DCache.scala:377:18, :969:114, :980:26, :988:33, :989:{45,52,77,79}]
  wire [31:0]      s0_req_addr = {metaArb_io_in_2_valid ? {io_cpu_req_bits_addr[31:14], s2_req_addr[13:6]} : io_cpu_req_bits_addr[31:6], io_cpu_req_bits_addr[5:0]};	// @[generators/rocket-chip/src/main/scala/rocket/DCache.scala:191:{21,84}, :243:89, :337:19, :444:62, :464:36, generators/rocket-chip/src/main/scala/rocket/HellaCache.scala:243:14, src/main/scala/chisel3/util/Arbiter.scala:145:26, :147:19]
  wire             tlb_deny_access_to_debug = ~io_ptw_status_debug & s1_tlb_req_vaddr[31:12] == 20'h0;	// @[generators/rocket-chip/src/main/scala/diplomacy/Parameters.scala:139:{41,46,59}, generators/rocket-chip/src/main/scala/rocket/DCache.scala:117:19, :206:29, generators/rocket-chip/src/main/scala/rocket/TLB.scala:428:{39,50}]
  wire [3:0]       _GEN_6 = s1_tlb_req_vaddr[3:0] & (4'h1 << s1_tlb_req_size) - 4'h1;	// @[generators/rocket-chip/src/main/scala/rocket/DCache.scala:206:29, generators/rocket-chip/src/main/scala/rocket/TLB.scala:550:{39,69}, src/main/scala/chisel3/util/OneHot.scala:58:35]
  wire             tlb__cmd_lrsc_T = s1_tlb_req_cmd == 5'h6;	// @[generators/rocket-chip/src/main/scala/rocket/DCache.scala:206:29, generators/rocket-chip/src/main/scala/util/package.scala:17:47]
  wire             tlb__cmd_lrsc_T_1 = s1_tlb_req_cmd == 5'h7;	// @[generators/rocket-chip/src/main/scala/rocket/DCache.scala:206:29, generators/rocket-chip/src/main/scala/util/package.scala:17:47]
  wire             tlb__cmd_read_T_7 = s1_tlb_req_cmd == 5'h4;	// @[generators/rocket-chip/src/main/scala/rocket/DCache.scala:206:29, generators/rocket-chip/src/main/scala/util/package.scala:17:47]
  wire             tlb__cmd_read_T_8 = s1_tlb_req_cmd == 5'h9;	// @[generators/rocket-chip/src/main/scala/rocket/DCache.scala:206:29, generators/rocket-chip/src/main/scala/util/package.scala:17:47]
  wire             tlb__cmd_read_T_9 = s1_tlb_req_cmd == 5'hA;	// @[generators/rocket-chip/src/main/scala/rocket/DCache.scala:206:29, generators/rocket-chip/src/main/scala/util/package.scala:17:47]
  wire             tlb__cmd_read_T_10 = s1_tlb_req_cmd == 5'hB;	// @[generators/rocket-chip/src/main/scala/rocket/DCache.scala:206:29, generators/rocket-chip/src/main/scala/util/package.scala:17:47]
  wire             tlb__cmd_read_T_14 = s1_tlb_req_cmd == 5'h8;	// @[generators/rocket-chip/src/main/scala/rocket/DCache.scala:206:29, generators/rocket-chip/src/main/scala/util/package.scala:17:47]
  wire             tlb__cmd_read_T_15 = s1_tlb_req_cmd == 5'hC;	// @[generators/rocket-chip/src/main/scala/rocket/DCache.scala:206:29, generators/rocket-chip/src/main/scala/util/package.scala:17:47]
  wire             tlb__cmd_read_T_16 = s1_tlb_req_cmd == 5'hD;	// @[generators/rocket-chip/src/main/scala/rocket/DCache.scala:206:29, generators/rocket-chip/src/main/scala/util/package.scala:17:47]
  wire             tlb__cmd_read_T_17 = s1_tlb_req_cmd == 5'hE;	// @[generators/rocket-chip/src/main/scala/rocket/DCache.scala:206:29, generators/rocket-chip/src/main/scala/util/package.scala:17:47]
  wire             tlb__cmd_read_T_18 = s1_tlb_req_cmd == 5'hF;	// @[generators/rocket-chip/src/main/scala/rocket/DCache.scala:206:29, generators/rocket-chip/src/main/scala/util/package.scala:17:47]
  wire             tlb_cmd_put_partial = s1_tlb_req_cmd == 5'h11;	// @[generators/rocket-chip/src/main/scala/rocket/DCache.scala:206:29, generators/rocket-chip/src/main/scala/rocket/TLB.scala:573:41]
  wire             tlb_cmd_read = s1_tlb_req_cmd == 5'h0 | s1_tlb_req_cmd == 5'h10 | tlb__cmd_lrsc_T | tlb__cmd_lrsc_T_1 | tlb__cmd_read_T_7 | tlb__cmd_read_T_8 | tlb__cmd_read_T_9 | tlb__cmd_read_T_10 | tlb__cmd_read_T_14 | tlb__cmd_read_T_15 | tlb__cmd_read_T_16 | tlb__cmd_read_T_17 | tlb__cmd_read_T_18;	// @[generators/rocket-chip/src/main/scala/rocket/Consts.scala:87:44, :89:68, generators/rocket-chip/src/main/scala/rocket/DCache.scala:206:29, generators/rocket-chip/src/main/scala/util/package.scala:17:47, :82:59]
  wire             tlb_cmd_write = s1_tlb_req_cmd == 5'h1 | tlb_cmd_put_partial | tlb__cmd_lrsc_T_1 | tlb__cmd_read_T_7 | tlb__cmd_read_T_8 | tlb__cmd_read_T_9 | tlb__cmd_read_T_10 | tlb__cmd_read_T_14 | tlb__cmd_read_T_15 | tlb__cmd_read_T_16 | tlb__cmd_read_T_17 | tlb__cmd_read_T_18;	// @[generators/rocket-chip/src/main/scala/rocket/Consts.scala:87:44, :90:{32,42,59,76}, generators/rocket-chip/src/main/scala/rocket/DCache.scala:206:29, generators/rocket-chip/src/main/scala/rocket/TLB.scala:573:41, generators/rocket-chip/src/main/scala/util/package.scala:17:47, :82:59]
  wire             tlb_ae_array = (|_GEN_6) & _tlb_pma_io_resp_eff | tlb__cmd_lrsc_T | tlb__cmd_lrsc_T_1;	// @[generators/rocket-chip/src/main/scala/rocket/TLB.scala:422:19, :550:{39,77}, :582:{8,37}, generators/rocket-chip/src/main/scala/util/package.scala:17:47, :82:59]
  wire [1:0]       s2_data_s1_word_en = io_cpu_replay_next_0 ? 2'h1 << uncachedReqs_0_addr[2] : s1_did_read ? s1_read_mask : 2'h0;	// @[generators/rocket-chip/src/main/scala/rocket/DCache.scala:235:25, :257:30, :258:31, :365:63, :375:27, :948:39, generators/rocket-chip/src/main/scala/util/package.scala:164:13, src/main/scala/chisel3/util/OneHot.scala:65:12]
  wire [1:0]       _s2_data_T_1 = s2_data_s1_word_en[0] ? s1_data_way : 2'h0;	// @[generators/rocket-chip/src/main/scala/rocket/DCache.scala:321:32, :375:27, :377:{28,39}, :672:24, :673:26]
  wire [1:0]       _s2_data_T_8 = s2_data_s1_word_en[1] ? s1_data_way : 2'h0;	// @[generators/rocket-chip/src/main/scala/rocket/DCache.scala:321:32, :375:27, :377:{28,39}, :672:24, :673:26]
  wire             s1_valid_not_nacked = s1_valid & ~s1_nack;	// @[generators/rocket-chip/src/main/scala/rocket/DCache.scala:180:25, :185:{38,41}, :286:75, :444:{24,82,92}, :569:{36,46}]
  wire [31:0]      s1_paddr = {s1_tlb_req_vaddr[31:12], s1_vaddr[11:0]};	// @[generators/rocket-chip/src/main/scala/rocket/DCache.scala:194:25, :206:29, :296:{21,99,125}]
  wire             _s2_victim_way_T = s1_valid_not_nacked | s1_flush_valid;	// @[generators/rocket-chip/src/main/scala/rocket/DCache.scala:185:38, :213:27, :343:29]
  wire             advance_pstore1 = pstore1_valid & pstore2_valid == pstore_drain;	// @[generators/rocket-chip/src/main/scala/rocket/DCache.scala:499:30, :505:38, :515:44, :520:{61,79}]
  wire             _io_cpu_perf_acquire_T = auto_out_a_ready & tl_out_a_valid;	// @[generators/rocket-chip/src/main/scala/rocket/DCache.scala:602:32, src/main/scala/chisel3/util/Decoupled.scala:51:35]
  wire             _GEN_7 = _io_cpu_perf_acquire_T & ~s2_pma_cacheable;	// @[generators/rocket-chip/src/main/scala/rocket/DCache.scala:234:33, :341:19, :422:21, :629:24, :630:24, :632:18, src/main/scala/chisel3/util/Decoupled.scala:51:35]
  always @(posedge clock) begin	// @[generators/rocket-chip/src/main/scala/rocket/DCache.scala:99:7]
    if (reset) begin	// @[generators/rocket-chip/src/main/scala/rocket/DCache.scala:99:7]
      s1_valid <= 1'h0;	// @[generators/rocket-chip/src/main/scala/rocket/DCache.scala:180:25]
      cached_grant_wait <= 1'h0;	// @[generators/rocket-chip/src/main/scala/rocket/DCache.scala:221:34]
      uncachedInFlight_0 <= 1'h0;	// @[generators/rocket-chip/src/main/scala/rocket/DCache.scala:234:33]
      s2_valid <= 1'h0;	// @[generators/rocket-chip/src/main/scala/rocket/DCache.scala:329:25]
      pstore2_valid <= 1'h0;	// @[generators/rocket-chip/src/main/scala/rocket/DCache.scala:499:30]
      pstore1_held <= 1'h0;	// @[generators/rocket-chip/src/main/scala/rocket/DCache.scala:502:29]
      r_counter <= 9'h0;	// @[generators/rocket-chip/src/main/scala/tilelink/Edges.scala:229:27]
    end
    else begin	// @[generators/rocket-chip/src/main/scala/rocket/DCache.scala:99:7]
      s1_valid <= io_cpu_req_ready_0 & io_cpu_req_valid;	// @[generators/rocket-chip/src/main/scala/rocket/DCache.scala:180:25, :273:79, :750:68, :753:29, src/main/scala/chisel3/util/Decoupled.scala:51:35]
      cached_grant_wait <= _io_cpu_perf_acquire_T & s2_pma_cacheable | cached_grant_wait;	// @[generators/rocket-chip/src/main/scala/rocket/DCache.scala:221:34, :341:19, :629:24, :630:24, src/main/scala/chisel3/util/Decoupled.scala:51:35]
      uncachedInFlight_0 <= (~_io_errors_bus_valid_T | ~d_last) & (_GEN_7 | uncachedInFlight_0);	// @[generators/rocket-chip/src/main/scala/rocket/DCache.scala:234:33, :629:24, :630:24, :632:18, :672:24, :673:26, :684:28, :686:13, generators/rocket-chip/src/main/scala/tilelink/Edges.scala:232:33, src/main/scala/chisel3/util/Decoupled.scala:51:35]
      s2_valid <= s1_valid_masked & ~(s1_req_cmd == 5'h14 | s1_req_cmd == 5'h15 | s1_req_cmd == 5'h16);	// @[generators/rocket-chip/src/main/scala/rocket/DCache.scala:184:34, :194:25, :211:{30,43,57,71,85}, :329:{25,42,45}]
      pstore2_valid <= pstore2_valid & ~pstore_drain | advance_pstore1;	// @[generators/rocket-chip/src/main/scala/rocket/DCache.scala:499:30, :515:44, :519:91, :520:61, :521:{34,51}]
      pstore1_held <= (_pstore1_held_T_2 | pstore1_held) & pstore2_valid & ~pstore_drain;	// @[generators/rocket-chip/src/main/scala/rocket/DCache.scala:488:46, :499:30, :502:29, :515:44, :519:{54,71,88,91}]
      if (_io_errors_bus_valid_T)	// @[src/main/scala/chisel3/util/Decoupled.scala:51:35]
        r_counter <= (|r_counter) ? r_counter - 9'h1 : r_beats1;	// @[generators/rocket-chip/src/main/scala/tilelink/Edges.scala:221:14, :229:27, :230:28, :231:25, :236:21]
    end
    if ((metaArb_io_in_2_valid | io_cpu_req_valid) & ~metaArb_io_in_2_valid) begin	// @[generators/rocket-chip/src/main/scala/rocket/DCache.scala:188:{40,43}, :444:62, src/main/scala/chisel3/util/Arbiter.scala:154:31]
      s1_vaddr <= s0_req_addr;	// @[generators/rocket-chip/src/main/scala/rocket/DCache.scala:191:21, :194:25]
      s1_req_tag <= io_cpu_req_bits_tag;	// @[generators/rocket-chip/src/main/scala/rocket/DCache.scala:194:25]
      s1_req_cmd <= io_cpu_req_bits_cmd;	// @[generators/rocket-chip/src/main/scala/rocket/DCache.scala:194:25]
      s1_req_size <= io_cpu_req_bits_size;	// @[generators/rocket-chip/src/main/scala/rocket/DCache.scala:194:25]
      s1_req_signed <= io_cpu_req_bits_signed;	// @[generators/rocket-chip/src/main/scala/rocket/DCache.scala:194:25]
      s1_req_dprv <= io_cpu_req_bits_dprv;	// @[generators/rocket-chip/src/main/scala/rocket/DCache.scala:194:25]
      s1_req_dv <= io_cpu_req_bits_dv;	// @[generators/rocket-chip/src/main/scala/rocket/DCache.scala:194:25]
      s1_req_no_xcpt <= io_cpu_req_bits_no_xcpt;	// @[generators/rocket-chip/src/main/scala/rocket/DCache.scala:194:25]
      s1_tlb_req_vaddr <= s0_req_addr;	// @[generators/rocket-chip/src/main/scala/rocket/DCache.scala:191:21, :206:29]
      s1_tlb_req_size <= io_cpu_req_bits_size;	// @[generators/rocket-chip/src/main/scala/rocket/DCache.scala:206:29]
      s1_tlb_req_cmd <= io_cpu_req_bits_cmd;	// @[generators/rocket-chip/src/main/scala/rocket/DCache.scala:206:29]
      s1_tlb_req_prv <= io_cpu_req_bits_dprv;	// @[generators/rocket-chip/src/main/scala/rocket/DCache.scala:206:29]
      s1_did_read <= ~dataArb__grant_T & io_cpu_req_valid & (_pstore_drain_opportunistic_T | _pstore_drain_opportunistic_T_1 | _pstore_drain_opportunistic_T_2 | _pstore_drain_opportunistic_T_28 | _pstore_drain_opportunistic_T_30 | _pstore_drain_opportunistic_T_31 | _pstore_drain_opportunistic_T_32 | _pstore_drain_opportunistic_T_33 | _pstore_drain_opportunistic_T_37 | _pstore_drain_opportunistic_T_38 | _pstore_drain_opportunistic_T_39 | _pstore_drain_opportunistic_T_40 | _pstore_drain_opportunistic_T_41 | (_pstore_drain_opportunistic_T_25 | _pstore_drain_opportunistic_T_50 | _pstore_drain_opportunistic_T_28 | _pstore_drain_opportunistic_T_30 | _pstore_drain_opportunistic_T_31 | _pstore_drain_opportunistic_T_32 | _pstore_drain_opportunistic_T_33 | _pstore_drain_opportunistic_T_37 | _pstore_drain_opportunistic_T_38 | _pstore_drain_opportunistic_T_39 | _pstore_drain_opportunistic_T_40 | _pstore_drain_opportunistic_T_41) & _pstore_drain_opportunistic_T_50);	// @[generators/rocket-chip/src/main/scala/rocket/Consts.scala:87:44, :89:68, :90:{42,49,59,76}, generators/rocket-chip/src/main/scala/rocket/DCache.scala:257:{30,54,75}, :1188:21, :1189:23, generators/rocket-chip/src/main/scala/util/package.scala:17:47, :82:59, src/main/scala/chisel3/util/Arbiter.scala:45:{68,78}]
      s1_read_mask <= dataArb_io_in_3_bits_wordMask;	// @[generators/rocket-chip/src/main/scala/rocket/DCache.scala:244:34, :258:31]
    end
    s1_flush_valid <= 1'h0;	// @[generators/rocket-chip/src/main/scala/rocket/DCache.scala:213:27]
    if (_GEN_7) begin	// @[generators/rocket-chip/src/main/scala/rocket/DCache.scala:234:33, :629:24, :630:24, :632:18]
      uncachedReqs_0_addr <= s2_req_addr;	// @[generators/rocket-chip/src/main/scala/rocket/DCache.scala:235:25, :337:19]
      uncachedReqs_0_tag <= s2_req_tag;	// @[generators/rocket-chip/src/main/scala/rocket/DCache.scala:235:25, :337:19]
      uncachedReqs_0_size <= s2_req_size;	// @[generators/rocket-chip/src/main/scala/rocket/DCache.scala:235:25, :337:19]
      uncachedReqs_0_signed <= s2_req_signed;	// @[generators/rocket-chip/src/main/scala/rocket/DCache.scala:235:25, :337:19]
    end
    s2_not_nacked_in_s1 <= ~s1_nack;	// @[generators/rocket-chip/src/main/scala/rocket/DCache.scala:185:41, :286:75, :333:36, :444:{24,82,92}, :569:{36,46}]
    if (_GEN_5) begin	// @[generators/rocket-chip/src/main/scala/rocket/DCache.scala:321:32, :343:48, :672:24, :673:26]
      s2_req_addr <= {s1_tlb_req_vaddr[31:12], s1_vaddr[11:3], uncachedReqs_0_addr[2:0]};	// @[generators/rocket-chip/src/main/scala/rocket/DCache.scala:194:25, :206:29, :235:25, :296:99, :337:19, :699:41, :700:{26,45}]
      s2_req_tag <= uncachedReqs_0_tag;	// @[generators/rocket-chip/src/main/scala/rocket/DCache.scala:235:25, :337:19]
      s2_req_cmd <= 5'h0;	// @[generators/rocket-chip/src/main/scala/rocket/DCache.scala:337:19]
      s2_req_size <= uncachedReqs_0_size;	// @[generators/rocket-chip/src/main/scala/rocket/DCache.scala:235:25, :337:19]
      s2_req_signed <= uncachedReqs_0_signed;	// @[generators/rocket-chip/src/main/scala/rocket/DCache.scala:235:25, :337:19]
    end
    else if (_s2_victim_way_T) begin	// @[generators/rocket-chip/src/main/scala/rocket/DCache.scala:343:29]
      s2_req_addr <= s1_paddr;	// @[generators/rocket-chip/src/main/scala/rocket/DCache.scala:296:21, :337:19]
      s2_req_tag <= s1_req_tag;	// @[generators/rocket-chip/src/main/scala/rocket/DCache.scala:194:25, :337:19]
      s2_req_cmd <= s1_req_cmd;	// @[generators/rocket-chip/src/main/scala/rocket/DCache.scala:194:25, :337:19]
      s2_req_size <= s1_req_size;	// @[generators/rocket-chip/src/main/scala/rocket/DCache.scala:194:25, :337:19]
      s2_req_signed <= s1_req_signed;	// @[generators/rocket-chip/src/main/scala/rocket/DCache.scala:194:25, :337:19]
    end
    if (_s2_victim_way_T) begin	// @[generators/rocket-chip/src/main/scala/rocket/DCache.scala:343:29]
      s2_req_dprv <= s1_req_dprv;	// @[generators/rocket-chip/src/main/scala/rocket/DCache.scala:194:25, :337:19]
      s2_req_dv <= s1_req_dv;	// @[generators/rocket-chip/src/main/scala/rocket/DCache.scala:194:25, :337:19]
      s2_req_no_xcpt <= s1_req_no_xcpt;	// @[generators/rocket-chip/src/main/scala/rocket/DCache.scala:194:25, :337:19]
      s2_tlb_xcpt_ae_ld <= tlb_cmd_read & (tlb_ae_array | ~(_tlb_pma_io_resp_r & ~tlb_deny_access_to_debug & _tlb_pmp_io_r));	// @[generators/rocket-chip/src/main/scala/rocket/Consts.scala:87:44, :89:68, generators/rocket-chip/src/main/scala/rocket/DCache.scala:340:24, generators/rocket-chip/src/main/scala/rocket/TLB.scala:416:19, :422:19, :428:50, :429:{30,33,55}, :582:37, :586:{24,44,46}, generators/rocket-chip/src/main/scala/util/package.scala:82:59]
      s2_tlb_xcpt_ae_st <= (tlb_cmd_write | s1_tlb_req_cmd == 5'h5 | s1_tlb_req_cmd == 5'h17) & (tlb_ae_array | ~(_tlb_pma_io_resp_w & ~tlb_deny_access_to_debug & _tlb_pmp_io_w)) | tlb_cmd_put_partial & ~_tlb_pma_io_resp_pp | (tlb__cmd_read_T_7 | tlb__cmd_read_T_8 | tlb__cmd_read_T_9 | tlb__cmd_read_T_10) & ~_tlb_pma_io_resp_al | (tlb__cmd_read_T_14 | tlb__cmd_read_T_15 | tlb__cmd_read_T_16 | tlb__cmd_read_T_17 | tlb__cmd_read_T_18) & ~_tlb_pma_io_resp_aa;	// @[generators/rocket-chip/src/main/scala/rocket/Consts.scala:87:44, :90:{42,59,76}, generators/rocket-chip/src/main/scala/rocket/DCache.scala:206:29, :340:24, generators/rocket-chip/src/main/scala/rocket/TLB.scala:416:19, :422:19, :428:50, :429:33, :430:{30,55}, :573:41, :577:35, :582:37, :588:{8,35,37,53}, :589:{8,26,53}, :590:{8,26,53}, :591:{8,29}, generators/rocket-chip/src/main/scala/util/package.scala:17:47, :82:59]
      s2_tlb_xcpt_ma_ld <= (|_GEN_6) & tlb_cmd_read;	// @[generators/rocket-chip/src/main/scala/rocket/Consts.scala:87:44, :89:68, generators/rocket-chip/src/main/scala/rocket/DCache.scala:340:24, generators/rocket-chip/src/main/scala/rocket/TLB.scala:550:{39,77}, :645:31, generators/rocket-chip/src/main/scala/util/package.scala:82:59]
      s2_tlb_xcpt_ma_st <= (|_GEN_6) & tlb_cmd_write;	// @[generators/rocket-chip/src/main/scala/rocket/Consts.scala:87:44, :90:{42,59,76}, generators/rocket-chip/src/main/scala/rocket/DCache.scala:340:24, generators/rocket-chip/src/main/scala/rocket/TLB.scala:550:{39,77}, :646:31, generators/rocket-chip/src/main/scala/util/package.scala:82:59]
      s2_vaddr_r <= s1_vaddr;	// @[generators/rocket-chip/src/main/scala/rocket/DCache.scala:194:25, :349:31]
      s2_hit_state_state <= {2{s1_tlb_req_vaddr[31] & s1_paddr < 32'h80004000}};	// @[generators/rocket-chip/src/main/scala/rocket/DCache.scala:206:29, :296:21, :301:{35,47,59}, :302:25, :384:31]
    end
    s2_tlb_xcpt_pf_ld <= ~_s2_victim_way_T & s2_tlb_xcpt_pf_ld;	// @[generators/rocket-chip/src/main/scala/rocket/DCache.scala:340:24, :343:{29,48}, :346:17]
    s2_tlb_xcpt_pf_st <= ~_s2_victim_way_T & s2_tlb_xcpt_pf_st;	// @[generators/rocket-chip/src/main/scala/rocket/DCache.scala:340:24, :343:{29,48}, :346:17]
    s2_pma_cacheable <= ~_s2_victim_way_T & s2_pma_cacheable;	// @[generators/rocket-chip/src/main/scala/rocket/DCache.scala:340:24, :341:19, :343:{29,48}, :346:17, :347:12]
    if (_GEN_5)	// @[generators/rocket-chip/src/main/scala/rocket/DCache.scala:321:32, :342:34, :672:24, :673:26]
      s2_uncached_resp_addr <= uncachedReqs_0_addr;	// @[generators/rocket-chip/src/main/scala/rocket/DCache.scala:235:25, :342:34]
    if (s1_valid | io_cpu_replay_next_0) begin	// @[generators/rocket-chip/src/main/scala/rocket/DCache.scala:180:25, :364:38, :948:39]
      s2_data_r <= (_s2_data_T_1[0] ? _data_io_resp_0[31:0] : 32'h0) | (_s2_data_T_1[1] ? auto_out_d_bits_data[31:0] : 32'h0);	// @[generators/rocket-chip/src/main/scala/rocket/DCache.scala:143:20, :377:{18,28}, generators/rocket-chip/src/main/scala/util/package.scala:212:50, src/main/scala/chisel3/util/Mux.scala:30:73, :32:36]
      s2_data_r_1 <= (_s2_data_T_8[0] ? _data_io_resp_0[63:32] : 32'h0) | (_s2_data_T_8[1] ? auto_out_d_bits_data[63:32] : 32'h0);	// @[generators/rocket-chip/src/main/scala/rocket/DCache.scala:143:20, :377:{18,28}, generators/rocket-chip/src/main/scala/util/package.scala:212:50, src/main/scala/chisel3/util/Mux.scala:30:73, :32:36]
    end
    if (s1_valid_not_nacked & s1_write) begin	// @[generators/rocket-chip/src/main/scala/rocket/Consts.scala:87:44, :90:{42,59,76}, generators/rocket-chip/src/main/scala/rocket/DCache.scala:185:38, :490:63, generators/rocket-chip/src/main/scala/util/package.scala:82:59]
      pstore1_cmd <= s1_req_cmd;	// @[generators/rocket-chip/src/main/scala/rocket/DCache.scala:194:25, :490:30]
      pstore1_addr <= s1_vaddr;	// @[generators/rocket-chip/src/main/scala/rocket/DCache.scala:194:25, :491:31]
      pstore1_data <= io_cpu_s1_data_data;	// @[generators/rocket-chip/src/main/scala/rocket/DCache.scala:492:31]
      pstore1_mask <= _io_cpu_perf_canAcceptLoadThenLoad_T_51 ? io_cpu_s1_data_mask : s1_mask_xwr;	// @[generators/rocket-chip/src/main/scala/rocket/AMOALU.scala:22:16, generators/rocket-chip/src/main/scala/rocket/Consts.scala:90:49, generators/rocket-chip/src/main/scala/rocket/DCache.scala:325:20, :494:31]
      pstore1_rmw <= _io_cpu_perf_canAcceptLoadThenLoad_T_1 | _io_cpu_perf_canAcceptLoadThenLoad_T_2 | _io_cpu_perf_canAcceptLoadThenLoad_T_3 | _io_cpu_perf_canAcceptLoadThenLoad_T_29 | _io_cpu_perf_canAcceptLoadThenLoad_T_31 | _io_cpu_perf_canAcceptLoadThenLoad_T_32 | _io_cpu_perf_canAcceptLoadThenLoad_T_33 | _io_cpu_perf_canAcceptLoadThenLoad_T_34 | _io_cpu_perf_canAcceptLoadThenLoad_T_38 | _io_cpu_perf_canAcceptLoadThenLoad_T_39 | _io_cpu_perf_canAcceptLoadThenLoad_T_40 | _io_cpu_perf_canAcceptLoadThenLoad_T_41 | _io_cpu_perf_canAcceptLoadThenLoad_T_42 | (_io_cpu_perf_canAcceptLoadThenLoad_T_26 | _io_cpu_perf_canAcceptLoadThenLoad_T_51 | _io_cpu_perf_canAcceptLoadThenLoad_T_29 | _io_cpu_perf_canAcceptLoadThenLoad_T_31 | _io_cpu_perf_canAcceptLoadThenLoad_T_32 | _io_cpu_perf_canAcceptLoadThenLoad_T_33 | _io_cpu_perf_canAcceptLoadThenLoad_T_34 | _io_cpu_perf_canAcceptLoadThenLoad_T_38 | _io_cpu_perf_canAcceptLoadThenLoad_T_39 | _io_cpu_perf_canAcceptLoadThenLoad_T_40 | _io_cpu_perf_canAcceptLoadThenLoad_T_41 | _io_cpu_perf_canAcceptLoadThenLoad_T_42) & _io_cpu_perf_canAcceptLoadThenLoad_T_51;	// @[generators/rocket-chip/src/main/scala/rocket/Consts.scala:87:44, :89:68, :90:{32,42,49,59,76}, generators/rocket-chip/src/main/scala/rocket/DCache.scala:496:44, :1188:21, :1189:23, generators/rocket-chip/src/main/scala/util/package.scala:17:47, :82:59]
    end
    pstore_drain_on_miss_REG <= io_cpu_s2_nack_0;	// @[generators/rocket-chip/src/main/scala/rocket/DCache.scala:443:{38,64,86}, :501:56]
    if (advance_pstore1) begin	// @[generators/rocket-chip/src/main/scala/rocket/DCache.scala:520:61]
      pstore2_addr <= pstore1_addr;	// @[generators/rocket-chip/src/main/scala/rocket/DCache.scala:491:31, :522:31]
      pstore2_storegen_data_r <= pstore1_storegen_data[7:0];	// @[generators/rocket-chip/src/main/scala/rocket/DCache.scala:526:{22,44}, :989:52]
      pstore2_storegen_data_r_1 <= pstore1_storegen_data[15:8];	// @[generators/rocket-chip/src/main/scala/rocket/DCache.scala:526:{22,44}, :989:52]
      pstore2_storegen_data_r_2 <= pstore1_storegen_data[23:16];	// @[generators/rocket-chip/src/main/scala/rocket/DCache.scala:526:{22,44}, :989:52]
      pstore2_storegen_data_r_3 <= pstore1_storegen_data[31:24];	// @[generators/rocket-chip/src/main/scala/rocket/DCache.scala:526:{22,44}, :989:52]
      pstore2_storegen_mask <= pstore1_mask;	// @[generators/rocket-chip/src/main/scala/rocket/DCache.scala:494:31, :529:19]
    end
    blockUncachedGrant <= _GEN ? dataArb_io_in_0_valid : dataArb_io_out_valid;	// @[generators/rocket-chip/src/main/scala/rocket/DCache.scala:515:44, :719:26, :748:33, :749:24, :750:68, :753:29, :755:32, :757:28, src/main/scala/chisel3/util/Arbiter.scala:154:31]
    io_cpu_s2_xcpt_REG <= s1_valid & ~io_cpu_s1_kill & (s1_read | s1_write | s1_req_cmd == 5'h5 & s1_req_size[0] | s1_req_cmd == 5'h17) & ~s1_req_no_xcpt & ~s1_nack;	// @[generators/rocket-chip/src/main/scala/rocket/Consts.scala:87:44, :89:68, :90:{42,59,76}, generators/rocket-chip/src/main/scala/rocket/DCache.scala:180:25, :184:37, :185:41, :194:25, :210:30, :212:{34,50,64}, :268:{38,55,69}, :271:{52,71}, :286:75, :444:{24,82,92}, :569:{36,46}, :927:35, :930:{40,65}, :931:32, generators/rocket-chip/src/main/scala/util/package.scala:82:59]
    doUncachedResp <= io_cpu_replay_next_0;	// @[generators/rocket-chip/src/main/scala/rocket/DCache.scala:946:31, :948:39]
  end // always @(posedge)
  `ifdef ENABLE_INITIAL_REG_	// @[generators/rocket-chip/src/main/scala/rocket/DCache.scala:99:7]
    `ifdef FIRRTL_BEFORE_INITIAL	// @[generators/rocket-chip/src/main/scala/rocket/DCache.scala:99:7]
      `FIRRTL_BEFORE_INITIAL	// @[generators/rocket-chip/src/main/scala/rocket/DCache.scala:99:7]
    `endif // FIRRTL_BEFORE_INITIAL
    logic [31:0] _RANDOM[0:74];	// @[generators/rocket-chip/src/main/scala/rocket/DCache.scala:99:7]
    initial begin	// @[generators/rocket-chip/src/main/scala/rocket/DCache.scala:99:7]
      `ifdef INIT_RANDOM_PROLOG_	// @[generators/rocket-chip/src/main/scala/rocket/DCache.scala:99:7]
        `INIT_RANDOM_PROLOG_	// @[generators/rocket-chip/src/main/scala/rocket/DCache.scala:99:7]
      `endif // INIT_RANDOM_PROLOG_
      `ifdef RANDOMIZE_REG_INIT	// @[generators/rocket-chip/src/main/scala/rocket/DCache.scala:99:7]
        for (logic [6:0] i = 7'h0; i < 7'h4B; i += 7'h1) begin
          _RANDOM[i] = `RANDOM;	// @[generators/rocket-chip/src/main/scala/rocket/DCache.scala:99:7]
        end	// @[generators/rocket-chip/src/main/scala/rocket/DCache.scala:99:7]
        s1_valid = _RANDOM[7'h26][1];	// @[generators/rocket-chip/src/main/scala/rocket/DCache.scala:99:7, :180:25]
        s1_vaddr = {_RANDOM[7'h29][31:24], _RANDOM[7'h2A][23:0]};	// @[generators/rocket-chip/src/main/scala/rocket/DCache.scala:99:7, :194:25]
        s1_req_tag = _RANDOM[7'h2A][30:24];	// @[generators/rocket-chip/src/main/scala/rocket/DCache.scala:99:7, :194:25]
        s1_req_cmd = {_RANDOM[7'h2A][31], _RANDOM[7'h2B][3:0]};	// @[generators/rocket-chip/src/main/scala/rocket/DCache.scala:99:7, :194:25]
        s1_req_size = _RANDOM[7'h2B][5:4];	// @[generators/rocket-chip/src/main/scala/rocket/DCache.scala:99:7, :194:25]
        s1_req_signed = _RANDOM[7'h2B][6];	// @[generators/rocket-chip/src/main/scala/rocket/DCache.scala:99:7, :194:25]
        s1_req_dprv = _RANDOM[7'h2B][8:7];	// @[generators/rocket-chip/src/main/scala/rocket/DCache.scala:99:7, :194:25]
        s1_req_dv = _RANDOM[7'h2B][9];	// @[generators/rocket-chip/src/main/scala/rocket/DCache.scala:99:7, :194:25]
        s1_req_no_xcpt = _RANDOM[7'h2B][13];	// @[generators/rocket-chip/src/main/scala/rocket/DCache.scala:99:7, :194:25]
        s1_tlb_req_vaddr = {_RANDOM[7'h2C][31:18], _RANDOM[7'h2D][17:0]};	// @[generators/rocket-chip/src/main/scala/rocket/DCache.scala:99:7, :206:29]
        s1_tlb_req_size = _RANDOM[7'h2D][20:19];	// @[generators/rocket-chip/src/main/scala/rocket/DCache.scala:99:7, :206:29]
        s1_tlb_req_cmd = _RANDOM[7'h2D][25:21];	// @[generators/rocket-chip/src/main/scala/rocket/DCache.scala:99:7, :206:29]
        s1_tlb_req_prv = _RANDOM[7'h2D][27:26];	// @[generators/rocket-chip/src/main/scala/rocket/DCache.scala:99:7, :206:29]
        s1_flush_valid = _RANDOM[7'h2D][29];	// @[generators/rocket-chip/src/main/scala/rocket/DCache.scala:99:7, :206:29, :213:27]
        cached_grant_wait = _RANDOM[7'h30][26];	// @[generators/rocket-chip/src/main/scala/rocket/DCache.scala:99:7, :221:34]
        uncachedInFlight_0 = _RANDOM[7'h32][11];	// @[generators/rocket-chip/src/main/scala/rocket/DCache.scala:99:7, :234:33]
        uncachedReqs_0_addr = {_RANDOM[7'h32][31:12], _RANDOM[7'h33][11:0]};	// @[generators/rocket-chip/src/main/scala/rocket/DCache.scala:99:7, :234:33, :235:25]
        uncachedReqs_0_tag = _RANDOM[7'h33][18:12];	// @[generators/rocket-chip/src/main/scala/rocket/DCache.scala:99:7, :235:25]
        uncachedReqs_0_size = _RANDOM[7'h33][25:24];	// @[generators/rocket-chip/src/main/scala/rocket/DCache.scala:99:7, :235:25]
        uncachedReqs_0_signed = _RANDOM[7'h33][26];	// @[generators/rocket-chip/src/main/scala/rocket/DCache.scala:99:7, :235:25]
        s1_did_read = _RANDOM[7'h35][6];	// @[generators/rocket-chip/src/main/scala/rocket/DCache.scala:99:7, :257:30]
        s1_read_mask = _RANDOM[7'h35][8:7];	// @[generators/rocket-chip/src/main/scala/rocket/DCache.scala:99:7, :257:30, :258:31]
        s2_valid = _RANDOM[7'h35][9];	// @[generators/rocket-chip/src/main/scala/rocket/DCache.scala:99:7, :257:30, :329:25]
        s2_not_nacked_in_s1 = _RANDOM[7'h35][11];	// @[generators/rocket-chip/src/main/scala/rocket/DCache.scala:99:7, :257:30, :333:36]
        s2_req_addr = {_RANDOM[7'h35][31:12], _RANDOM[7'h36][11:0]};	// @[generators/rocket-chip/src/main/scala/rocket/DCache.scala:99:7, :257:30, :337:19]
        s2_req_tag = _RANDOM[7'h36][18:12];	// @[generators/rocket-chip/src/main/scala/rocket/DCache.scala:99:7, :337:19]
        s2_req_cmd = _RANDOM[7'h36][23:19];	// @[generators/rocket-chip/src/main/scala/rocket/DCache.scala:99:7, :337:19]
        s2_req_size = _RANDOM[7'h36][25:24];	// @[generators/rocket-chip/src/main/scala/rocket/DCache.scala:99:7, :337:19]
        s2_req_signed = _RANDOM[7'h36][26];	// @[generators/rocket-chip/src/main/scala/rocket/DCache.scala:99:7, :337:19]
        s2_req_dprv = _RANDOM[7'h36][28:27];	// @[generators/rocket-chip/src/main/scala/rocket/DCache.scala:99:7, :337:19]
        s2_req_dv = _RANDOM[7'h36][29];	// @[generators/rocket-chip/src/main/scala/rocket/DCache.scala:99:7, :337:19]
        s2_req_no_xcpt = _RANDOM[7'h37][1];	// @[generators/rocket-chip/src/main/scala/rocket/DCache.scala:99:7, :337:19]
        s2_tlb_xcpt_pf_ld = _RANDOM[7'h3A][8];	// @[generators/rocket-chip/src/main/scala/rocket/DCache.scala:99:7, :340:24]
        s2_tlb_xcpt_pf_st = _RANDOM[7'h3A][9];	// @[generators/rocket-chip/src/main/scala/rocket/DCache.scala:99:7, :340:24]
        s2_tlb_xcpt_ae_ld = _RANDOM[7'h3A][14];	// @[generators/rocket-chip/src/main/scala/rocket/DCache.scala:99:7, :340:24]
        s2_tlb_xcpt_ae_st = _RANDOM[7'h3A][15];	// @[generators/rocket-chip/src/main/scala/rocket/DCache.scala:99:7, :340:24]
        s2_tlb_xcpt_ma_ld = _RANDOM[7'h3A][17];	// @[generators/rocket-chip/src/main/scala/rocket/DCache.scala:99:7, :340:24]
        s2_tlb_xcpt_ma_st = _RANDOM[7'h3A][18];	// @[generators/rocket-chip/src/main/scala/rocket/DCache.scala:99:7, :340:24]
        s2_pma_cacheable = _RANDOM[7'h3D][12];	// @[generators/rocket-chip/src/main/scala/rocket/DCache.scala:99:7, :341:19]
        s2_uncached_resp_addr = {_RANDOM[7'h3D][31:22], _RANDOM[7'h3E][21:0]};	// @[generators/rocket-chip/src/main/scala/rocket/DCache.scala:99:7, :341:19, :342:34]
        s2_vaddr_r = {_RANDOM[7'h3E][31:22], _RANDOM[7'h3F][21:0]};	// @[generators/rocket-chip/src/main/scala/rocket/DCache.scala:99:7, :342:34, :349:31]
        s2_data_r = {_RANDOM[7'h40][31:13], _RANDOM[7'h41][12:0]};	// @[generators/rocket-chip/src/main/scala/rocket/DCache.scala:99:7, :377:18]
        s2_data_r_1 = {_RANDOM[7'h41][31:13], _RANDOM[7'h42][12:0]};	// @[generators/rocket-chip/src/main/scala/rocket/DCache.scala:99:7, :377:18]
        s2_hit_state_state = _RANDOM[7'h42][18:17];	// @[generators/rocket-chip/src/main/scala/rocket/DCache.scala:99:7, :377:18, :384:31]
        pstore1_cmd = _RANDOM[7'h43][27:23];	// @[generators/rocket-chip/src/main/scala/rocket/DCache.scala:99:7, :490:30]
        pstore1_addr = {_RANDOM[7'h43][31:28], _RANDOM[7'h44][27:0]};	// @[generators/rocket-chip/src/main/scala/rocket/DCache.scala:99:7, :490:30, :491:31]
        pstore1_data = {_RANDOM[7'h44][31:28], _RANDOM[7'h45][27:0]};	// @[generators/rocket-chip/src/main/scala/rocket/DCache.scala:99:7, :491:31, :492:31]
        pstore1_mask = {_RANDOM[7'h45][31:29], _RANDOM[7'h46][0]};	// @[generators/rocket-chip/src/main/scala/rocket/DCache.scala:99:7, :492:31, :494:31]
        pstore1_rmw = _RANDOM[7'h46][1];	// @[generators/rocket-chip/src/main/scala/rocket/DCache.scala:99:7, :494:31, :496:44]
        pstore2_valid = _RANDOM[7'h46][2];	// @[generators/rocket-chip/src/main/scala/rocket/DCache.scala:99:7, :494:31, :499:30]
        pstore_drain_on_miss_REG = _RANDOM[7'h46][3];	// @[generators/rocket-chip/src/main/scala/rocket/DCache.scala:99:7, :494:31, :501:56]
        pstore1_held = _RANDOM[7'h46][4];	// @[generators/rocket-chip/src/main/scala/rocket/DCache.scala:99:7, :494:31, :502:29]
        pstore2_addr = {_RANDOM[7'h46][31:5], _RANDOM[7'h47][4:0]};	// @[generators/rocket-chip/src/main/scala/rocket/DCache.scala:99:7, :494:31, :522:31]
        pstore2_storegen_data_r = _RANDOM[7'h47][13:6];	// @[generators/rocket-chip/src/main/scala/rocket/DCache.scala:99:7, :522:31, :526:22]
        pstore2_storegen_data_r_1 = _RANDOM[7'h47][21:14];	// @[generators/rocket-chip/src/main/scala/rocket/DCache.scala:99:7, :522:31, :526:22]
        pstore2_storegen_data_r_2 = _RANDOM[7'h47][29:22];	// @[generators/rocket-chip/src/main/scala/rocket/DCache.scala:99:7, :522:31, :526:22]
        pstore2_storegen_data_r_3 = {_RANDOM[7'h47][31:30], _RANDOM[7'h48][5:0]};	// @[generators/rocket-chip/src/main/scala/rocket/DCache.scala:99:7, :522:31, :526:22]
        pstore2_storegen_mask = _RANDOM[7'h48][9:6];	// @[generators/rocket-chip/src/main/scala/rocket/DCache.scala:99:7, :526:22, :529:19]
        r_counter = _RANDOM[7'h48][19:11];	// @[generators/rocket-chip/src/main/scala/rocket/DCache.scala:99:7, :526:22, generators/rocket-chip/src/main/scala/tilelink/Edges.scala:229:27]
        blockUncachedGrant = _RANDOM[7'h48][24];	// @[generators/rocket-chip/src/main/scala/rocket/DCache.scala:99:7, :526:22, :748:33]
        io_cpu_s2_xcpt_REG = _RANDOM[7'h49][4];	// @[generators/rocket-chip/src/main/scala/rocket/DCache.scala:99:7, :931:32]
        doUncachedResp = _RANDOM[7'h4A][5];	// @[generators/rocket-chip/src/main/scala/rocket/DCache.scala:99:7, :946:31]
      `endif // RANDOMIZE_REG_INIT
    end // initial
    `ifdef FIRRTL_AFTER_INITIAL	// @[generators/rocket-chip/src/main/scala/rocket/DCache.scala:99:7]
      `FIRRTL_AFTER_INITIAL	// @[generators/rocket-chip/src/main/scala/rocket/DCache.scala:99:7]
    `endif // FIRRTL_AFTER_INITIAL
  `endif // ENABLE_INITIAL_REG_
  PMPChecker_s2 tlb_pmp (	// @[generators/rocket-chip/src/main/scala/rocket/TLB.scala:416:19]
    .io_prv         (s1_tlb_req_prv),	// @[generators/rocket-chip/src/main/scala/rocket/DCache.scala:206:29]
    .io_pmp_0_cfg_l (io_ptw_pmp_0_cfg_l),
    .io_pmp_0_cfg_a (io_ptw_pmp_0_cfg_a),
    .io_pmp_0_cfg_x (io_ptw_pmp_0_cfg_x),
    .io_pmp_0_cfg_w (io_ptw_pmp_0_cfg_w),
    .io_pmp_0_cfg_r (io_ptw_pmp_0_cfg_r),
    .io_pmp_0_addr  (io_ptw_pmp_0_addr),
    .io_pmp_0_mask  (io_ptw_pmp_0_mask),
    .io_pmp_1_cfg_l (io_ptw_pmp_1_cfg_l),
    .io_pmp_1_cfg_a (io_ptw_pmp_1_cfg_a),
    .io_pmp_1_cfg_x (io_ptw_pmp_1_cfg_x),
    .io_pmp_1_cfg_w (io_ptw_pmp_1_cfg_w),
    .io_pmp_1_cfg_r (io_ptw_pmp_1_cfg_r),
    .io_pmp_1_addr  (io_ptw_pmp_1_addr),
    .io_pmp_1_mask  (io_ptw_pmp_1_mask),
    .io_pmp_2_cfg_l (io_ptw_pmp_2_cfg_l),
    .io_pmp_2_cfg_a (io_ptw_pmp_2_cfg_a),
    .io_pmp_2_cfg_x (io_ptw_pmp_2_cfg_x),
    .io_pmp_2_cfg_w (io_ptw_pmp_2_cfg_w),
    .io_pmp_2_cfg_r (io_ptw_pmp_2_cfg_r),
    .io_pmp_2_addr  (io_ptw_pmp_2_addr),
    .io_pmp_2_mask  (io_ptw_pmp_2_mask),
    .io_pmp_3_cfg_l (io_ptw_pmp_3_cfg_l),
    .io_pmp_3_cfg_a (io_ptw_pmp_3_cfg_a),
    .io_pmp_3_cfg_x (io_ptw_pmp_3_cfg_x),
    .io_pmp_3_cfg_w (io_ptw_pmp_3_cfg_w),
    .io_pmp_3_cfg_r (io_ptw_pmp_3_cfg_r),
    .io_pmp_3_addr  (io_ptw_pmp_3_addr),
    .io_pmp_3_mask  (io_ptw_pmp_3_mask),
    .io_pmp_4_cfg_l (io_ptw_pmp_4_cfg_l),
    .io_pmp_4_cfg_a (io_ptw_pmp_4_cfg_a),
    .io_pmp_4_cfg_x (io_ptw_pmp_4_cfg_x),
    .io_pmp_4_cfg_w (io_ptw_pmp_4_cfg_w),
    .io_pmp_4_cfg_r (io_ptw_pmp_4_cfg_r),
    .io_pmp_4_addr  (io_ptw_pmp_4_addr),
    .io_pmp_4_mask  (io_ptw_pmp_4_mask),
    .io_pmp_5_cfg_l (io_ptw_pmp_5_cfg_l),
    .io_pmp_5_cfg_a (io_ptw_pmp_5_cfg_a),
    .io_pmp_5_cfg_x (io_ptw_pmp_5_cfg_x),
    .io_pmp_5_cfg_w (io_ptw_pmp_5_cfg_w),
    .io_pmp_5_cfg_r (io_ptw_pmp_5_cfg_r),
    .io_pmp_5_addr  (io_ptw_pmp_5_addr),
    .io_pmp_5_mask  (io_ptw_pmp_5_mask),
    .io_pmp_6_cfg_l (io_ptw_pmp_6_cfg_l),
    .io_pmp_6_cfg_a (io_ptw_pmp_6_cfg_a),
    .io_pmp_6_cfg_x (io_ptw_pmp_6_cfg_x),
    .io_pmp_6_cfg_w (io_ptw_pmp_6_cfg_w),
    .io_pmp_6_cfg_r (io_ptw_pmp_6_cfg_r),
    .io_pmp_6_addr  (io_ptw_pmp_6_addr),
    .io_pmp_6_mask  (io_ptw_pmp_6_mask),
    .io_pmp_7_cfg_l (io_ptw_pmp_7_cfg_l),
    .io_pmp_7_cfg_a (io_ptw_pmp_7_cfg_a),
    .io_pmp_7_cfg_x (io_ptw_pmp_7_cfg_x),
    .io_pmp_7_cfg_w (io_ptw_pmp_7_cfg_w),
    .io_pmp_7_cfg_r (io_ptw_pmp_7_cfg_r),
    .io_pmp_7_addr  (io_ptw_pmp_7_addr),
    .io_pmp_7_mask  (io_ptw_pmp_7_mask),
    .io_addr        (s1_tlb_req_vaddr),	// @[generators/rocket-chip/src/main/scala/rocket/DCache.scala:206:29]
    .io_r           (_tlb_pmp_io_r),
    .io_w           (_tlb_pmp_io_w),
    .io_x           (/* unused */)
  );	// @[generators/rocket-chip/src/main/scala/rocket/TLB.scala:416:19]
  PMAChecker tlb_pma (	// @[generators/rocket-chip/src/main/scala/rocket/TLB.scala:422:19]
    .io_paddr    (s1_tlb_req_vaddr),	// @[generators/rocket-chip/src/main/scala/rocket/DCache.scala:206:29]
    .io_resp_r   (_tlb_pma_io_resp_r),
    .io_resp_w   (_tlb_pma_io_resp_w),
    .io_resp_pp  (_tlb_pma_io_resp_pp),
    .io_resp_al  (_tlb_pma_io_resp_al),
    .io_resp_aa  (_tlb_pma_io_resp_aa),
    .io_resp_x   (/* unused */),
    .io_resp_eff (_tlb_pma_io_resp_eff)
  );	// @[generators/rocket-chip/src/main/scala/rocket/TLB.scala:422:19]
  OptimizationBarrier_TLBEntryData tlb_entries_barrier (	// @[generators/rocket-chip/src/main/scala/util/package.scala:268:25]
    .io_x_u        (1'h0),
    .io_x_ae_ptw   (1'h0),
    .io_x_ae_final (1'h0),
    .io_x_pf       (1'h0),
    .io_x_gf       (1'h0),
    .io_x_sw       (1'h0),
    .io_x_sx       (1'h0),
    .io_x_sr       (1'h0),
    .io_x_pw       (1'h0),
    .io_x_px       (1'h0),
    .io_x_pr       (1'h0),
    .io_x_ppp      (1'h0),
    .io_x_pal      (1'h0),
    .io_x_paa      (1'h0),
    .io_x_eff      (1'h0),
    .io_x_c        (1'h0),
    .io_y_u        (/* unused */),
    .io_y_ae_ptw   (/* unused */),
    .io_y_ae_final (/* unused */),
    .io_y_pf       (/* unused */),
    .io_y_gf       (/* unused */),
    .io_y_sw       (/* unused */),
    .io_y_sx       (/* unused */),
    .io_y_sr       (/* unused */),
    .io_y_pw       (/* unused */),
    .io_y_px       (/* unused */),
    .io_y_pr       (/* unused */),
    .io_y_ppp      (/* unused */),
    .io_y_pal      (/* unused */),
    .io_y_paa      (/* unused */),
    .io_y_eff      (/* unused */),
    .io_y_c        (/* unused */)
  );	// @[generators/rocket-chip/src/main/scala/util/package.scala:268:25]
  OptimizationBarrier_TLBEntryData tlb_entries_barrier_1 (	// @[generators/rocket-chip/src/main/scala/util/package.scala:268:25]
    .io_x_u        (1'h0),
    .io_x_ae_ptw   (1'h0),
    .io_x_ae_final (1'h0),
    .io_x_pf       (1'h0),
    .io_x_gf       (1'h0),
    .io_x_sw       (1'h0),
    .io_x_sx       (1'h0),
    .io_x_sr       (1'h0),
    .io_x_pw       (1'h0),
    .io_x_px       (1'h0),
    .io_x_pr       (1'h0),
    .io_x_ppp      (1'h0),
    .io_x_pal      (1'h0),
    .io_x_paa      (1'h0),
    .io_x_eff      (1'h0),
    .io_x_c        (1'h0),
    .io_y_u        (/* unused */),
    .io_y_ae_ptw   (/* unused */),
    .io_y_ae_final (/* unused */),
    .io_y_pf       (/* unused */),
    .io_y_gf       (/* unused */),
    .io_y_sw       (/* unused */),
    .io_y_sx       (/* unused */),
    .io_y_sr       (/* unused */),
    .io_y_pw       (/* unused */),
    .io_y_px       (/* unused */),
    .io_y_pr       (/* unused */),
    .io_y_ppp      (/* unused */),
    .io_y_pal      (/* unused */),
    .io_y_paa      (/* unused */),
    .io_y_eff      (/* unused */),
    .io_y_c        (/* unused */)
  );	// @[generators/rocket-chip/src/main/scala/util/package.scala:268:25]
  OptimizationBarrier_TLBEntryData tlb_entries_barrier_2 (	// @[generators/rocket-chip/src/main/scala/util/package.scala:268:25]
    .io_x_u        (1'h0),
    .io_x_ae_ptw   (1'h0),
    .io_x_ae_final (1'h0),
    .io_x_pf       (1'h0),
    .io_x_gf       (1'h0),
    .io_x_sw       (1'h0),
    .io_x_sx       (1'h0),
    .io_x_sr       (1'h0),
    .io_x_pw       (1'h0),
    .io_x_px       (1'h0),
    .io_x_pr       (1'h0),
    .io_x_ppp      (1'h0),
    .io_x_pal      (1'h0),
    .io_x_paa      (1'h0),
    .io_x_eff      (1'h0),
    .io_x_c        (1'h0),
    .io_y_u        (/* unused */),
    .io_y_ae_ptw   (/* unused */),
    .io_y_ae_final (/* unused */),
    .io_y_pf       (/* unused */),
    .io_y_gf       (/* unused */),
    .io_y_sw       (/* unused */),
    .io_y_sx       (/* unused */),
    .io_y_sr       (/* unused */),
    .io_y_pw       (/* unused */),
    .io_y_px       (/* unused */),
    .io_y_pr       (/* unused */),
    .io_y_ppp      (/* unused */),
    .io_y_pal      (/* unused */),
    .io_y_paa      (/* unused */),
    .io_y_eff      (/* unused */),
    .io_y_c        (/* unused */)
  );	// @[generators/rocket-chip/src/main/scala/util/package.scala:268:25]
  OptimizationBarrier_TLBEntryData tlb_entries_barrier_3 (	// @[generators/rocket-chip/src/main/scala/util/package.scala:268:25]
    .io_x_u        (1'h0),
    .io_x_ae_ptw   (1'h0),
    .io_x_ae_final (1'h0),
    .io_x_pf       (1'h0),
    .io_x_gf       (1'h0),
    .io_x_sw       (1'h0),
    .io_x_sx       (1'h0),
    .io_x_sr       (1'h0),
    .io_x_pw       (1'h0),
    .io_x_px       (1'h0),
    .io_x_pr       (1'h0),
    .io_x_ppp      (1'h0),
    .io_x_pal      (1'h0),
    .io_x_paa      (1'h0),
    .io_x_eff      (1'h0),
    .io_x_c        (1'h0),
    .io_y_u        (/* unused */),
    .io_y_ae_ptw   (/* unused */),
    .io_y_ae_final (/* unused */),
    .io_y_pf       (/* unused */),
    .io_y_gf       (/* unused */),
    .io_y_sw       (/* unused */),
    .io_y_sx       (/* unused */),
    .io_y_sr       (/* unused */),
    .io_y_pw       (/* unused */),
    .io_y_px       (/* unused */),
    .io_y_pr       (/* unused */),
    .io_y_ppp      (/* unused */),
    .io_y_pal      (/* unused */),
    .io_y_paa      (/* unused */),
    .io_y_eff      (/* unused */),
    .io_y_c        (/* unused */)
  );	// @[generators/rocket-chip/src/main/scala/util/package.scala:268:25]
  OptimizationBarrier_TLBEntryData tlb_entries_barrier_4 (	// @[generators/rocket-chip/src/main/scala/util/package.scala:268:25]
    .io_x_u        (1'h0),
    .io_x_ae_ptw   (1'h0),
    .io_x_ae_final (1'h0),
    .io_x_pf       (1'h0),
    .io_x_gf       (1'h0),
    .io_x_sw       (1'h0),
    .io_x_sx       (1'h0),
    .io_x_sr       (1'h0),
    .io_x_pw       (1'h0),
    .io_x_px       (1'h0),
    .io_x_pr       (1'h0),
    .io_x_ppp      (1'h0),
    .io_x_pal      (1'h0),
    .io_x_paa      (1'h0),
    .io_x_eff      (1'h0),
    .io_x_c        (1'h0),
    .io_y_u        (/* unused */),
    .io_y_ae_ptw   (/* unused */),
    .io_y_ae_final (/* unused */),
    .io_y_pf       (/* unused */),
    .io_y_gf       (/* unused */),
    .io_y_sw       (/* unused */),
    .io_y_sx       (/* unused */),
    .io_y_sr       (/* unused */),
    .io_y_pw       (/* unused */),
    .io_y_px       (/* unused */),
    .io_y_pr       (/* unused */),
    .io_y_ppp      (/* unused */),
    .io_y_pal      (/* unused */),
    .io_y_paa      (/* unused */),
    .io_y_eff      (/* unused */),
    .io_y_c        (/* unused */)
  );	// @[generators/rocket-chip/src/main/scala/util/package.scala:268:25]
  OptimizationBarrier_TLBEntryData tlb_entries_barrier_5 (	// @[generators/rocket-chip/src/main/scala/util/package.scala:268:25]
    .io_x_u        (1'h0),
    .io_x_ae_ptw   (1'h0),
    .io_x_ae_final (1'h0),
    .io_x_pf       (1'h0),
    .io_x_gf       (1'h0),
    .io_x_sw       (1'h0),
    .io_x_sx       (1'h0),
    .io_x_sr       (1'h0),
    .io_x_pw       (1'h0),
    .io_x_px       (1'h0),
    .io_x_pr       (1'h0),
    .io_x_ppp      (1'h0),
    .io_x_pal      (1'h0),
    .io_x_paa      (1'h0),
    .io_x_eff      (1'h0),
    .io_x_c        (1'h0),
    .io_y_u        (/* unused */),
    .io_y_ae_ptw   (/* unused */),
    .io_y_ae_final (/* unused */),
    .io_y_pf       (/* unused */),
    .io_y_gf       (/* unused */),
    .io_y_sw       (/* unused */),
    .io_y_sx       (/* unused */),
    .io_y_sr       (/* unused */),
    .io_y_pw       (/* unused */),
    .io_y_px       (/* unused */),
    .io_y_pr       (/* unused */),
    .io_y_ppp      (/* unused */),
    .io_y_pal      (/* unused */),
    .io_y_paa      (/* unused */),
    .io_y_eff      (/* unused */),
    .io_y_c        (/* unused */)
  );	// @[generators/rocket-chip/src/main/scala/util/package.scala:268:25]
  OptimizationBarrier_TLBEntryData pma_checker_entries_barrier (	// @[generators/rocket-chip/src/main/scala/util/package.scala:268:25]
    .io_x_u        (1'h0),
    .io_x_ae_ptw   (1'h0),
    .io_x_ae_final (1'h0),
    .io_x_pf       (1'h0),
    .io_x_gf       (1'h0),
    .io_x_sw       (1'h0),
    .io_x_sx       (1'h0),
    .io_x_sr       (1'h0),
    .io_x_pw       (1'h0),
    .io_x_px       (1'h0),
    .io_x_pr       (1'h0),
    .io_x_ppp      (1'h0),
    .io_x_pal      (1'h0),
    .io_x_paa      (1'h0),
    .io_x_eff      (1'h0),
    .io_x_c        (1'h0),
    .io_y_u        (/* unused */),
    .io_y_ae_ptw   (/* unused */),
    .io_y_ae_final (/* unused */),
    .io_y_pf       (/* unused */),
    .io_y_gf       (/* unused */),
    .io_y_sw       (/* unused */),
    .io_y_sx       (/* unused */),
    .io_y_sr       (/* unused */),
    .io_y_pw       (/* unused */),
    .io_y_px       (/* unused */),
    .io_y_pr       (/* unused */),
    .io_y_ppp      (/* unused */),
    .io_y_pal      (/* unused */),
    .io_y_paa      (/* unused */),
    .io_y_eff      (/* unused */),
    .io_y_c        (/* unused */)
  );	// @[generators/rocket-chip/src/main/scala/util/package.scala:268:25]
  OptimizationBarrier_TLBEntryData pma_checker_entries_barrier_1 (	// @[generators/rocket-chip/src/main/scala/util/package.scala:268:25]
    .io_x_u        (1'h0),
    .io_x_ae_ptw   (1'h0),
    .io_x_ae_final (1'h0),
    .io_x_pf       (1'h0),
    .io_x_gf       (1'h0),
    .io_x_sw       (1'h0),
    .io_x_sx       (1'h0),
    .io_x_sr       (1'h0),
    .io_x_pw       (1'h0),
    .io_x_px       (1'h0),
    .io_x_pr       (1'h0),
    .io_x_ppp      (1'h0),
    .io_x_pal      (1'h0),
    .io_x_paa      (1'h0),
    .io_x_eff      (1'h0),
    .io_x_c        (1'h0),
    .io_y_u        (/* unused */),
    .io_y_ae_ptw   (/* unused */),
    .io_y_ae_final (/* unused */),
    .io_y_pf       (/* unused */),
    .io_y_gf       (/* unused */),
    .io_y_sw       (/* unused */),
    .io_y_sx       (/* unused */),
    .io_y_sr       (/* unused */),
    .io_y_pw       (/* unused */),
    .io_y_px       (/* unused */),
    .io_y_pr       (/* unused */),
    .io_y_ppp      (/* unused */),
    .io_y_pal      (/* unused */),
    .io_y_paa      (/* unused */),
    .io_y_eff      (/* unused */),
    .io_y_c        (/* unused */)
  );	// @[generators/rocket-chip/src/main/scala/util/package.scala:268:25]
  OptimizationBarrier_TLBEntryData pma_checker_entries_barrier_2 (	// @[generators/rocket-chip/src/main/scala/util/package.scala:268:25]
    .io_x_u        (1'h0),
    .io_x_ae_ptw   (1'h0),
    .io_x_ae_final (1'h0),
    .io_x_pf       (1'h0),
    .io_x_gf       (1'h0),
    .io_x_sw       (1'h0),
    .io_x_sx       (1'h0),
    .io_x_sr       (1'h0),
    .io_x_pw       (1'h0),
    .io_x_px       (1'h0),
    .io_x_pr       (1'h0),
    .io_x_ppp      (1'h0),
    .io_x_pal      (1'h0),
    .io_x_paa      (1'h0),
    .io_x_eff      (1'h0),
    .io_x_c        (1'h0),
    .io_y_u        (/* unused */),
    .io_y_ae_ptw   (/* unused */),
    .io_y_ae_final (/* unused */),
    .io_y_pf       (/* unused */),
    .io_y_gf       (/* unused */),
    .io_y_sw       (/* unused */),
    .io_y_sx       (/* unused */),
    .io_y_sr       (/* unused */),
    .io_y_pw       (/* unused */),
    .io_y_px       (/* unused */),
    .io_y_pr       (/* unused */),
    .io_y_ppp      (/* unused */),
    .io_y_pal      (/* unused */),
    .io_y_paa      (/* unused */),
    .io_y_eff      (/* unused */),
    .io_y_c        (/* unused */)
  );	// @[generators/rocket-chip/src/main/scala/util/package.scala:268:25]
  OptimizationBarrier_TLBEntryData pma_checker_entries_barrier_3 (	// @[generators/rocket-chip/src/main/scala/util/package.scala:268:25]
    .io_x_u        (1'h0),
    .io_x_ae_ptw   (1'h0),
    .io_x_ae_final (1'h0),
    .io_x_pf       (1'h0),
    .io_x_gf       (1'h0),
    .io_x_sw       (1'h0),
    .io_x_sx       (1'h0),
    .io_x_sr       (1'h0),
    .io_x_pw       (1'h0),
    .io_x_px       (1'h0),
    .io_x_pr       (1'h0),
    .io_x_ppp      (1'h0),
    .io_x_pal      (1'h0),
    .io_x_paa      (1'h0),
    .io_x_eff      (1'h0),
    .io_x_c        (1'h0),
    .io_y_u        (/* unused */),
    .io_y_ae_ptw   (/* unused */),
    .io_y_ae_final (/* unused */),
    .io_y_pf       (/* unused */),
    .io_y_gf       (/* unused */),
    .io_y_sw       (/* unused */),
    .io_y_sx       (/* unused */),
    .io_y_sr       (/* unused */),
    .io_y_pw       (/* unused */),
    .io_y_px       (/* unused */),
    .io_y_pr       (/* unused */),
    .io_y_ppp      (/* unused */),
    .io_y_pal      (/* unused */),
    .io_y_paa      (/* unused */),
    .io_y_eff      (/* unused */),
    .io_y_c        (/* unused */)
  );	// @[generators/rocket-chip/src/main/scala/util/package.scala:268:25]
  OptimizationBarrier_TLBEntryData pma_checker_entries_barrier_4 (	// @[generators/rocket-chip/src/main/scala/util/package.scala:268:25]
    .io_x_u        (1'h0),
    .io_x_ae_ptw   (1'h0),
    .io_x_ae_final (1'h0),
    .io_x_pf       (1'h0),
    .io_x_gf       (1'h0),
    .io_x_sw       (1'h0),
    .io_x_sx       (1'h0),
    .io_x_sr       (1'h0),
    .io_x_pw       (1'h0),
    .io_x_px       (1'h0),
    .io_x_pr       (1'h0),
    .io_x_ppp      (1'h0),
    .io_x_pal      (1'h0),
    .io_x_paa      (1'h0),
    .io_x_eff      (1'h0),
    .io_x_c        (1'h0),
    .io_y_u        (/* unused */),
    .io_y_ae_ptw   (/* unused */),
    .io_y_ae_final (/* unused */),
    .io_y_pf       (/* unused */),
    .io_y_gf       (/* unused */),
    .io_y_sw       (/* unused */),
    .io_y_sx       (/* unused */),
    .io_y_sr       (/* unused */),
    .io_y_pw       (/* unused */),
    .io_y_px       (/* unused */),
    .io_y_pr       (/* unused */),
    .io_y_ppp      (/* unused */),
    .io_y_pal      (/* unused */),
    .io_y_paa      (/* unused */),
    .io_y_eff      (/* unused */),
    .io_y_c        (/* unused */)
  );	// @[generators/rocket-chip/src/main/scala/util/package.scala:268:25]
  DCacheDataArray data (	// @[generators/rocket-chip/src/main/scala/rocket/DCache.scala:143:20]
    .clock                (clock),
    .io_req_valid         (dataArb_io_out_valid),	// @[src/main/scala/chisel3/util/Arbiter.scala:154:31]
    .io_req_bits_addr     (_GEN_1 ? _dataArb_io_in_0_bits_wordMask_wordMask_T : dataArb_io_in_3_bits_addr),	// @[generators/rocket-chip/src/main/scala/rocket/DCache.scala:243:30, :547:36, src/main/scala/chisel3/util/Arbiter.scala:145:26, :147:19]
    .io_req_bits_write    (dataArb_io_in_0_valid & pstore_drain),	// @[generators/rocket-chip/src/main/scala/rocket/DCache.scala:515:44, src/main/scala/chisel3/util/Arbiter.scala:145:26, :147:19]
    .io_req_bits_wdata    ({2{pstore2_valid ? {pstore2_storegen_data_r_3, pstore2_storegen_data_r_2, pstore2_storegen_data_r_1, pstore2_storegen_data_r} : pstore1_data}}),	// @[generators/rocket-chip/src/main/scala/rocket/DCache.scala:492:31, :499:30, :526:22, :549:{49,63}, generators/rocket-chip/src/main/scala/util/package.scala:46:27]
    .io_req_bits_wordMask (_GEN_1 ? dataArb_io_in_1_bits_wordMask : dataArb_io_in_3_bits_wordMask),	// @[generators/rocket-chip/src/main/scala/rocket/DCache.scala:244:34, :553:55, src/main/scala/chisel3/util/Arbiter.scala:145:26, :147:19]
    .io_req_bits_eccMask  (_GEN_1 ? dataArb_io_in_1_bits_eccMask : 4'hF),	// @[generators/rocket-chip/src/main/scala/rocket/DCache.scala:555:47, src/main/scala/chisel3/util/Arbiter.scala:145:26, :147:19]
    .io_resp_0            (_data_io_resp_0)
  );	// @[generators/rocket-chip/src/main/scala/rocket/DCache.scala:143:20]
  AMOALU amoalus_0 (	// @[generators/rocket-chip/src/main/scala/rocket/DCache.scala:980:26]
    .io_cmd          (pstore1_cmd),	// @[generators/rocket-chip/src/main/scala/rocket/DCache.scala:490:30]
    .io_lhs          (s2_data_word),	// @[generators/rocket-chip/src/main/scala/rocket/DCache.scala:968:106]
    .io_rhs          (pstore1_data),	// @[generators/rocket-chip/src/main/scala/rocket/DCache.scala:492:31]
    .io_out_unmasked (_amoalus_0_io_out_unmasked)
  );	// @[generators/rocket-chip/src/main/scala/rocket/DCache.scala:980:26]
  assign auto_out_a_valid = tl_out_a_valid;	// @[generators/rocket-chip/src/main/scala/rocket/DCache.scala:99:7, :602:32]
  assign auto_out_a_bits_opcode = s2_pma_cacheable ? 3'h0 : s2_write ? (_io_cpu_store_pending_T_1 ? 3'h1 : s2_read ? (_io_cpu_store_pending_T_16 | _io_cpu_store_pending_T_15 | _io_cpu_store_pending_T_14 | _io_cpu_store_pending_T_13 | _io_cpu_store_pending_T_12 ? 3'h2 : _io_cpu_store_pending_T_8 | _io_cpu_store_pending_T_7 | _io_cpu_store_pending_T_6 | _io_cpu_store_pending_T_5 ? 3'h3 : 3'h0) : 3'h0) : 3'h4;	// @[generators/rocket-chip/src/main/scala/rocket/Consts.scala:87:44, :89:68, :90:{42,49,59,76}, generators/rocket-chip/src/main/scala/rocket/DCache.scala:99:7, :341:19, :585:81, :606:23, :607:8, :608:8, :609:8, generators/rocket-chip/src/main/scala/util/package.scala:17:47, :82:59]
  assign auto_out_a_bits_param = s2_pma_cacheable | ~s2_write | _io_cpu_store_pending_T_1 | ~s2_read ? 3'h0 : _io_cpu_store_pending_T_16 ? 3'h3 : _io_cpu_store_pending_T_15 ? 3'h2 : _io_cpu_store_pending_T_14 ? 3'h1 : _io_cpu_store_pending_T_13 ? 3'h0 : _io_cpu_store_pending_T_12 ? 3'h4 : _io_cpu_store_pending_T_8 ? 3'h2 : _io_cpu_store_pending_T_7 ? 3'h1 : _io_cpu_store_pending_T_6 | ~_io_cpu_store_pending_T_5 ? 3'h0 : 3'h3;	// @[generators/rocket-chip/src/main/scala/rocket/Consts.scala:87:44, :89:68, :90:{42,49,59,76}, generators/rocket-chip/src/main/scala/rocket/DCache.scala:99:7, :341:19, :585:81, :606:23, :607:{8,9}, :608:8, :609:{8,9}, generators/rocket-chip/src/main/scala/util/package.scala:17:47, :82:59]
  assign auto_out_a_bits_size = _GEN_4 ? 4'h0 : {2'h0, s2_req_size};	// @[generators/rocket-chip/src/main/scala/rocket/DCache.scala:99:7, :337:19, :606:23, generators/rocket-chip/src/main/scala/tilelink/Edges.scala:463:15]
  assign auto_out_a_bits_address = _GEN_4 ? 32'h0 : s2_req_addr;	// @[generators/rocket-chip/src/main/scala/rocket/DCache.scala:99:7, :337:19, :606:23]
  assign auto_out_a_bits_mask = s2_pma_cacheable ? 8'h0 : s2_write ? (_io_cpu_store_pending_T_1 ? a_mask[7:0] : s2_read ? atomics_mask : {put_a_mask_sub_3_1 | put_a_mask_sub_3_2 & s2_req_addr[0], put_a_mask_sub_3_1 | put_a_mask_sub_3_2 & ~(s2_req_addr[0]), put_a_mask_sub_2_1 | put_a_mask_sub_2_2 & s2_req_addr[0], put_a_mask_sub_2_1 | put_a_mask_sub_2_2 & ~(s2_req_addr[0]), put_a_mask_sub_1_1 | put_a_mask_sub_1_2 & s2_req_addr[0], put_a_mask_sub_1_1 | put_a_mask_sub_1_2 & ~(s2_req_addr[0]), put_a_mask_sub_0_1 | put_a_mask_sub_0_2 & s2_req_addr[0], put_a_mask_sub_0_1 | put_a_mask_sub_0_2 & ~(s2_req_addr[0])}) : {get_a_mask_sub_3_1 | get_a_mask_sub_3_2 & s2_req_addr[0], get_a_mask_sub_3_1 | get_a_mask_sub_3_2 & ~(s2_req_addr[0]), get_a_mask_sub_2_1 | get_a_mask_sub_2_2 & s2_req_addr[0], get_a_mask_sub_2_1 | get_a_mask_sub_2_2 & ~(s2_req_addr[0]), get_a_mask_sub_1_1 | get_a_mask_sub_1_2 & s2_req_addr[0], get_a_mask_sub_1_1 | get_a_mask_sub_1_2 & ~(s2_req_addr[0]), get_a_mask_sub_0_1 | get_a_mask_sub_0_2 & s2_req_addr[0], get_a_mask_sub_0_1 | get_a_mask_sub_0_2 & ~(s2_req_addr[0])};	// @[generators/rocket-chip/src/main/scala/rocket/Consts.scala:87:44, :89:68, :90:{42,49,59,76}, generators/rocket-chip/src/main/scala/rocket/DCache.scala:99:7, :337:19, :341:19, :580:29, :585:81, :606:23, :607:8, :608:8, :609:8, generators/rocket-chip/src/main/scala/tilelink/Edges.scala:508:15, generators/rocket-chip/src/main/scala/util/Misc.scala:210:26, :211:20, :214:27, :215:29, :222:10, generators/rocket-chip/src/main/scala/util/package.scala:82:59]
  assign auto_out_a_bits_data = s2_pma_cacheable | ~s2_write | ~(_io_cpu_store_pending_T_1 | ~s2_read | _io_cpu_store_pending_T_16 | _io_cpu_store_pending_T_15 | _io_cpu_store_pending_T_14 | _io_cpu_store_pending_T_13 | _io_cpu_store_pending_T_12 | _io_cpu_store_pending_T_8 | _io_cpu_store_pending_T_7 | _io_cpu_store_pending_T_6 | _io_cpu_store_pending_T_5) ? 64'h0 : {2{pstore1_data}};	// @[generators/rocket-chip/src/main/scala/rocket/Consts.scala:87:44, :89:68, :90:{42,49,59,76}, generators/rocket-chip/src/main/scala/rocket/DCache.scala:99:7, :341:19, :492:31, :579:20, :585:81, :606:23, :607:{8,9}, :608:8, :609:8, generators/rocket-chip/src/main/scala/util/package.scala:17:47, :82:59]
  assign auto_out_d_ready = ~_GEN_0;	// @[generators/rocket-chip/src/main/scala/rocket/DCache.scala:99:7, :669:18, :720:51, :722:20, :750:{31,68}, :751:22]
  assign io_cpu_req_ready = io_cpu_req_ready_0;	// @[generators/rocket-chip/src/main/scala/rocket/DCache.scala:99:7, :273:79, :750:68, :753:29]
  assign io_cpu_s2_nack = io_cpu_s2_nack_0;	// @[generators/rocket-chip/src/main/scala/rocket/DCache.scala:99:7, :443:{38,64,86}]
  assign io_cpu_resp_valid = s2_valid_hit_pre_data_ecc_and_waw | doUncachedResp;	// @[generators/rocket-chip/src/main/scala/rocket/DCache.scala:99:7, :395:89, :416:89, :946:31, :947:51]
  assign io_cpu_resp_bits_addr = doUncachedResp ? s2_uncached_resp_addr : s2_req_addr;	// @[generators/rocket-chip/src/main/scala/rocket/DCache.scala:99:7, :337:19, :342:34, :915:37, :946:31, :949:25, :952:27]
  assign io_cpu_resp_bits_tag = s2_req_tag;	// @[generators/rocket-chip/src/main/scala/rocket/DCache.scala:99:7, :337:19]
  assign io_cpu_resp_bits_cmd = s2_req_cmd;	// @[generators/rocket-chip/src/main/scala/rocket/DCache.scala:99:7, :337:19]
  assign io_cpu_resp_bits_size = s2_req_size;	// @[generators/rocket-chip/src/main/scala/rocket/DCache.scala:99:7, :337:19]
  assign io_cpu_resp_bits_signed = s2_req_signed;	// @[generators/rocket-chip/src/main/scala/rocket/DCache.scala:99:7, :337:19]
  assign io_cpu_resp_bits_dprv = s2_req_dprv;	// @[generators/rocket-chip/src/main/scala/rocket/DCache.scala:99:7, :337:19]
  assign io_cpu_resp_bits_dv = s2_req_dv;	// @[generators/rocket-chip/src/main/scala/rocket/DCache.scala:99:7, :337:19]
  assign io_cpu_resp_bits_data = {s2_req_size == 2'h0 ? {24{s2_req_signed & io_cpu_resp_bits_data_zeroed_1[7]}} : {s2_req_size == 2'h1 ? {16{s2_req_signed & io_cpu_resp_bits_data_zeroed[15]}} : s2_data_word[31:16], io_cpu_resp_bits_data_zeroed[15:8]}, io_cpu_resp_bits_data_zeroed_1};	// @[generators/rocket-chip/src/main/scala/rocket/AMOALU.scala:42:{24,37}, :45:{16,20,26,49,72,81,94}, generators/rocket-chip/src/main/scala/rocket/DCache.scala:99:7, :337:19, :968:106]
  assign io_cpu_resp_bits_mask = 4'h0;	// @[generators/rocket-chip/src/main/scala/rocket/DCache.scala:99:7]
  assign io_cpu_resp_bits_replay = doUncachedResp;	// @[generators/rocket-chip/src/main/scala/rocket/DCache.scala:99:7, :946:31]
  assign io_cpu_resp_bits_has_data = s2_read;	// @[generators/rocket-chip/src/main/scala/rocket/Consts.scala:87:44, :89:68, generators/rocket-chip/src/main/scala/rocket/DCache.scala:99:7, generators/rocket-chip/src/main/scala/util/package.scala:82:59]
  assign io_cpu_resp_bits_data_word_bypass = s2_data_word;	// @[generators/rocket-chip/src/main/scala/rocket/DCache.scala:99:7, :968:106]
  assign io_cpu_resp_bits_data_raw = s2_data_word;	// @[generators/rocket-chip/src/main/scala/rocket/DCache.scala:99:7, :968:106]
  assign io_cpu_resp_bits_store_data = pstore1_data;	// @[generators/rocket-chip/src/main/scala/rocket/DCache.scala:99:7, :492:31]
  assign io_cpu_replay_next = io_cpu_replay_next_0;	// @[generators/rocket-chip/src/main/scala/rocket/DCache.scala:99:7, :948:39]
  assign io_cpu_s2_xcpt_ma_ld = io_cpu_s2_xcpt_ma_ld_0;	// @[generators/rocket-chip/src/main/scala/rocket/DCache.scala:99:7, :931:24]
  assign io_cpu_s2_xcpt_ma_st = io_cpu_s2_xcpt_ma_st_0;	// @[generators/rocket-chip/src/main/scala/rocket/DCache.scala:99:7, :931:24]
  assign io_cpu_s2_xcpt_pf_ld = io_cpu_s2_xcpt_pf_ld_0;	// @[generators/rocket-chip/src/main/scala/rocket/DCache.scala:99:7, :931:24]
  assign io_cpu_s2_xcpt_pf_st = io_cpu_s2_xcpt_pf_st_0;	// @[generators/rocket-chip/src/main/scala/rocket/DCache.scala:99:7, :931:24]
  assign io_cpu_s2_xcpt_ae_ld = io_cpu_s2_xcpt_ae_ld_0;	// @[generators/rocket-chip/src/main/scala/rocket/DCache.scala:99:7, :931:24]
  assign io_cpu_s2_xcpt_ae_st = io_cpu_s2_xcpt_ae_st_0;	// @[generators/rocket-chip/src/main/scala/rocket/DCache.scala:99:7, :931:24]
  assign io_cpu_ordered = ~(s1_valid & ~s1_req_no_xcpt | s2_valid & ~s2_req_no_xcpt | cached_grant_wait | uncachedInFlight_0);	// @[generators/rocket-chip/src/main/scala/rocket/DCache.scala:99:7, :180:25, :194:25, :221:34, :234:33, :329:25, :337:19, :927:{21,32,35,57,69,72,94,115}]
  assign io_cpu_perf_grant = auto_out_d_valid & d_last;	// @[generators/rocket-chip/src/main/scala/rocket/DCache.scala:99:7, :1076:39, generators/rocket-chip/src/main/scala/tilelink/Edges.scala:232:33]
  assign io_ptw_req_bits_bits_need_gpa = 1'h0;	// @[generators/rocket-chip/src/main/scala/rocket/DCache.scala:99:7]
  assign io_ptw_req_bits_bits_stage2 = 1'h0;	// @[generators/rocket-chip/src/main/scala/rocket/DCache.scala:99:7]
endmodule

